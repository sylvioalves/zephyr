## boards/espressif/esp32_devkitc_wroom/Kconfig.esp32_devkitc_wroom
```kconfig
# Copyright (c) 2023 Espressif Systems (Shanghai) Co., Ltd.
# SPDX-License-Identifier: Apache-2.0

config BOARD_ESP32_DEVKITC_WROOM
	select SOC_SERIES_ESP32
```

## boards/espressif/esp32_devkitc_wroom/Kconfig.esp32_devkitc_wroom_appcpu
```kconfig
# Copyright (c) 2023 Espressif Systems (Shanghai) Co., Ltd.
# SPDX-License-Identifier: Apache-2.0

config BOARD_ESP32_DEVKITC_WROOM_APPCPU
	select SOC_SERIES_ESP32
	select SOC_ESP32_APPCPU
```

## boards/espressif/esp32_devkitc_wroom/board.yml
```yaml
boards:
  - name: esp32_devkitc_wroom
    vendor: espressif
    socs:
      - name: esp32
  - name: esp32_devkitc_wroom_appcpu
    vendor: espressif
    socs:
      - name: esp32
```

## boards/espressif/esp32_devkitc_wrover/Kconfig.esp32_devkitc_wrover_appcpu
```kconfig
# Copyright (c) 2023 Espressif Systems (Shanghai) Co., Ltd.
# SPDX-License-Identifier: Apache-2.0

config BOARD_ESP32_DEVKITC_WROVER_APPCPU
	select SOC_ESP32_WROVER_E_N4R8
	select SOC_ESP32_APPCPU
```

## boards/espressif/esp32_devkitc_wrover/board.yml
```yaml
boards:
  - name: esp32_devkitc_wrover
    vendor: espressif
    socs:
      - name: esp32
  - name: esp32_devkitc_wrover_appcpu
    vendor: espressif
    socs:
      - name: esp32
```

## boards/espressif/esp32_ethernet_kit/board.yml
```yaml
board:
  name: esp32_ethernet_kit
  vendor: espressif
  socs:
  - name: esp32_wrover_e_n4r8
```

## boards/espressif/esp32s2_saola/board.yml
```yaml
board:
  name: esp32s2_saola
  vendor: espressif
  socs:
  - name: esp32s2_wrover_n4r2
```

## boards/espressif/esp32s3_devkitm/Kconfig.esp32s3_devkitm_appcpu
```kconfig
# Copyright (c) 2022 Espressif Systems (Shanghai) Co., Ltd.
# SPDX-License-Identifier: Apache-2.0

config BOARD_ESP32S3_DEVKITM_APPCPU
	select SOC_ESP32S3_MINI_N8
	select SOC_ESP32S3_APPCPU
```

## boards/espressif/esp32s3_devkitm/board.yml
```yaml
boards:
  - name: esp32s3_devkitm
    vendor: espressif
    socs:
      - name: esp32s3
  - name: esp32s3_devkitm_appcpu
    vendor: espressif
    socs:
      - name: esp32s3
```

## boards/kincony/kincony_kc868_a32/Kconfig.defconfig
```kconfig
# Copyright (c) 2023 Bartosz Bilas
# SPDX-License-Identifier: Apache-2.0

config ENTROPY_GENERATOR
	default y

config HEAP_MEM_POOL_SIZE
	default 65535 if WIFI && BT
	default 51200 if WIFI
	default 40960 if BT
	default 4096
```

## boards/m5stack/m5stack_stamps3/Kconfig.defconfig
```kconfig
# M5Stack StampS3 board configuration
# Copyright (c) 2023 Martin Kiepfer <mrmarteng@teleschirm.org>
# SPDX-License-Identifier: Apache-2.0

config ENTROPY_GENERATOR
	default y

config HEAP_MEM_POOL_ADD_SIZE_BOARD
	int
	default 98304 if WIFI
	default 65536 if BT
	default 4096

config KERNEL_MEM_POOL
	default y

choice BT_HCI_BUS_TYPE
	default BT_ESP32 if BT
endchoice
```

## boards/olimex/olimex_esp32_evb/Kconfig.defconfig
```kconfig
# Olimex ESP32-EVB board configuration

# Copyright (c) 2022 Henrik Brix Andersen <henrik@brixandersen.dk>
# SPDX-License-Identifier: Apache-2.0

config ENTROPY_GENERATOR
	default y

config HEAP_MEM_POOL_ADD_SIZE_BOARD
	int
	default 65535 if WIFI && BT
	default 51200 if WIFI
	default 40960 if BT
	default 4096

choice BT_HCI_BUS_TYPE
	default BT_ESP32 if BT
endchoice
```

## boards/xtensa/esp32s3_box_lite/Kconfig.board
```kconfig
# ESP32S3 DevKitM board configuration

# Copyright (c) 2022 Espressif Systems (Shanghai) Co., Ltd.
# SPDX-License-Identifier: Apache-2.0

config BOARD_ESP32S3_BOX_LITE
	bool "ESP32S3 BOX Lite Board"
	depends on SOC_ESP32S3
```

## boards/xtensa/esp32s3_devkitm/Kconfig.board
```kconfig
# Copyright (c) 2022 Espressif Systems (Shanghai) Co., Ltd.
# SPDX-License-Identifier: Apache-2.0

# ESP32S3 DevKitM board configuration
config BOARD_ESP32S3_DEVKITM
	bool "ESP32S3 DevKitM Board"
	depends on SOC_ESP32S3

config BOARD_ESP32S3_APPCPU
	bool "ESP32S3 Board configuration for APPCPU (2nd core) running stand alone application"
	depends on SOC_ESP32S3_APPCPU

choice SOC_PART_NUMBER
	default SOC_ESP32S3_MINI_N8
endchoice
```

## boards/xtensa/esp32s3_net/Kconfig.board
```kconfig
# ESP32 board configuration

# Copyright (c) 2022 Espressif Systems (Shanghai) Co., Ltd.
# SPDX-License-Identifier: Apache-2.0

config BOARD_ESP32S3_NET
	bool "ESP32S3 Board configuration for APP_CPU"
	depends on SOC_ESP32S3_NET
```

## drivers/adc/Kconfig.esp32
```kconfig
# ESP32 ADC configuration options

# Copyright (c) 2021 Espressif Systems (Shanghai) Co., Ltd.
# SPDX-License-Identifier: Apache-2.0

DT_COMPAT_ESP32_ADC := espressif,esp32-adc

config ADC_ESP32
	bool "ESP32 ADC driver"
	depends on SOC_ESP32 || SOC_ESP32S2 || SOC_ESP32C3
	default $(dt_compat_enabled,$(DT_COMPAT_ESP32_ADC))
	select GPIO_ESP32
	help
	  Enable the driver implementation for the ESP32 ADC
```

## dts/bindings/wifi/espressif,esp32-wifi.yaml
```yaml
# Copyright 2020 Espressif Systems (Shanghai) PTE LTD
#
# SPDX-License-Identifier: Apache-2.0

description: ESP32 WiFi SoC interface

compatible: "espressif,esp32-wifi"

include: base.yaml

properties:
    reg:
      required: true

    label:
      required: true

    interrupts:
      required: false
```
