## subsys/app_platform/Kconfig
```kconfig
# Copyright (c) 2026 Espressif Systems (Shanghai) Co., Ltd.
# SPDX-License-Identifier: Apache-2.0

menuconfig APP_PLATFORM
	bool "Application platform"
	depends on TASK_WDT
	imply USERSPACE
	help
	  A runtime that launches applications as supervised groups that reach
	  the system only through application-provided services and are
	  reclaimed if they fault or hang.

	  With USERSPACE each application runs as a user-mode thread in its own
	  memory domain, isolated from the system and the other applications.
	  Without it applications run as supervisor threads: capabilities and
	  grants still gate the services, but nothing stops an application
	  from reaching memory or kernel functions directly, so only trusted
	  applications should be run. USERSPACE is enabled by default where the
	  architecture supports it.

if APP_PLATFORM

config APP_PLATFORM_MAX_APPS
	int "Maximum concurrent application groups"
	default 4
	help
	  Number of application groups that can run at once. Each reserves a
	  thread stack, and a memory domain with USERSPACE.

config APP_PLATFORM_MAX_RESTARTS
	int "Times a resilient application may be relaunched after a fault"
	default 10
	help
	  Budget for the supervisor's automatic restart of an application
	  marked resilient. An application that keeps faulting is left stopped
	  once it is exhausted, instead of respawning without end. Zero means
	  no limit.

config APP_PLATFORM_APP_STACK_SIZE
	int "Per-application stack size"
	default 2048
	help
	  Stack reserved for each application thread. One is allocated per
	  slot at build time, so this multiplies by APP_PLATFORM_MAX_APPS.

config APP_PLATFORM_APP_PRIORITY
	int "Application thread priority"
	default 5
	help
	  Preemptible priority every application thread runs at. Keep it below
	  the supervisor so a busy application cannot delay a reclaim.

config APP_PLATFORM_APP_THREADS
	int "Worker threads per application"
	default 0
	range 0 8
	help
	  Threads an application with APP_CAP_THREAD may run next to the one
	  its entry point runs on. Their stacks are reserved per slot at build
	  time, so this multiplies by APP_PLATFORM_MAX_APPS. Zero leaves worker
	  threads out.

config APP_PLATFORM_APP_THREAD_STACK_SIZE
	int "Worker thread stack size"
	default APP_PLATFORM_APP_STACK_SIZE
	depends on APP_PLATFORM_APP_THREADS > 0
	help
	  Stack reserved for each worker thread of each application slot.

config APP_PLATFORM_APP_SEMS
	int "Semaphores per application"
	default 4 if APP_PLATFORM_APP_THREADS > 0
	default 0
	range 0 16
	help
	  Semaphores an application with APP_CAP_THREAD can create to
	  coordinate its threads. They are reserved per slot at build time and
	  released when the application ends.

config APP_PLATFORM_CPU_AFFINITY
	bool "Per-application CPU affinity"
	depends on SMP
	select SCHED_CPU_MASK
	help
	  Run an application only on the CPUs the firmware assigns it, with
	  app_def.cpu_mask for a built-in application or with
	  app_launch_opts.cpu_mask and app_platform_launch_llext_opts() for a
	  loaded one. The entry thread and every worker thread keep the
	  assignment, also across a stop and start or a restart after a fault.
	  Without it an application runs on any CPU and launching one with a
	  CPU mask fails.

config APP_PLATFORM_APP_HEAP_POOL_SIZE
	int "Internal RAM for per-application heaps (bytes)"
	default 0
	help
	  Pool the heaps applications declare are carved from: the heap_size
	  of a loaded module's signed manifest, or app_def.heap_size for a
	  built-in application. A heap is carved at launch, zeroed, mapped
	  into the application's memory domain, and zeroed and returned when
	  the application is removed. A region is rounded up to what the
	  memory protection hardware maps, a naturally aligned power of two
	  with an MPU or whole pages with an MMU, so leave room for that.
	  Zero leaves the feature out, and an application that declares a
	  heap then fails to launch.

config APP_PLATFORM_APP_HEAP_MAX_BYTES
	int "Largest heap one application may declare (bytes)"
	default 16384
	range 256 16777216
	depends on APP_PLATFORM_APP_HEAP_POOL_SIZE > 0
	help
	  An application that declares a larger heap is refused at launch.

config APP_PLATFORM_SUPERVISOR_STACK_SIZE
	int "Supervisor thread stack size"
	default 2048
	help
	  Stack for the thread that launches applications and acts on fault
	  and watchdog reports. Launching creates threads, and a memory domain
	  with USERSPACE, so this is not a trivial frame.

config APP_PLATFORM_WATCHER_STACK_SIZE
	int "Per-application death-watcher stack size"
	default 512
	help
	  Each application group has a small watcher thread blocked until the
	  application terminates, giving passive crash and exit detection with no
	  cooperation from the application.

config APP_PLATFORM_SUPERVISOR_PRIORITY
	int "Supervisor thread priority"
	default 2
	help
	  Cooperative priority of the supervisor, the reaper and the per
	  application death watchers. Higher than any application so a
	  reclaim always makes progress.

config APP_PLATFORM_REAPER_PRIORITY
	int "Reaper-helper thread priority"
	default 6
	help
	  Priority of the reaper-helper thread that runs per-application cleanup
	  (service reclaim hooks and module unload) after the supervisor aborts a
	  faulted or finished application. It runs below the supervisor so the
	  safety-critical supervisor never blocks on cleanup that touches drivers,
	  heaps or service locks.

config APP_PLATFORM_REAPER_STACK_SIZE
	int "Reaper-helper thread stack size"
	default 2048

config APP_PLATFORM_STOP_WAIT_MS
	int "Wait for a stopped application to leave a service (ms)"
	default 5000
	help
	  An application stopped while it holds a service lock keeps running
	  until it releases the last one, so no lock is left owned by a dead
	  thread. After this long it is stopped anyway, and each service whose
	  lock it still holds is disabled.

config APP_PLATFORM_TEST_FAULT_POINTS
	bool
	help
	  Call app_platform_test_point() at fixed points where a service holds
	  its lock, so a test can make an application fault there. Only tests
	  enable it.

config APP_PLATFORM_WDT_TIMEOUT_MS
	int "Application liveness watchdog timeout (ms)"
	default 2000
	help
	  An application proves liveness by calling app_platform_heartbeat(); a
	  group that stops feeding within this window is reclaimed.

config APP_PLATFORM_LOADER
	bool "Verified llext application loader"
	depends on LLEXT
	depends on !LLEXT_EXPORT_BUILTINS_BY_SLID
	depends on PSA_CRYPTO
	imply LLEXT_CONTIGUOUS_REGIONS
	imply LLEXT_HEAP_EXECUTABLE
	help
	  Verify a downloaded module by SHA-256 and load it as an llext, so a
	  tampered or corrupted module is rejected and never linked. Enable a
	  PSA crypto provider (for example CONFIG_PSA_CRYPTO and
	  CONFIG_PSA_WANT_ALG_SHA_256) for the SHA-256 implementation.

	  Without USERSPACE a module runs from the llext heap as kernel code,
	  so LLEXT_HEAP_EXECUTABLE is enabled where the Arm MPU or RISC-V PMP
	  data execution prevention would make the heap non-executable.

	  A module that imports a symbol outside the functions exported to
	  modules and the few listed in subsys/app_platform/abi/app_imports.txt
	  is refused. The check reads symbol names, so it is not available
	  when built-in symbols are linked by SLID.

config APP_PLATFORM_LOADER_FILE_IN_RAM
	bool "Verify a module from a file as one private copy in RAM"
	depends on APP_PLATFORM_LOADER
	default y
	help
	  Read a module stored in a file into a buffer allocated from the
	  system heap, verify that buffer and link the extension from it, so
	  the bytes that are linked are the bytes that were verified. The heap
	  must hold the largest module once. When disabled, the module is
	  hashed as a stream and linked from the file, which is re-hashed
	  afterwards; a writer that changes the file between the reads and
	  restores it before the re-hash is not detected.

config APP_PLATFORM_LOADER_MAX_MODULE_BYTES
	int "Per-application loadable-extension memory budget (bytes)"
	depends on APP_PLATFORM_LOADER
	default 65536
	help
	  Maximum total loadable-extension memory a single application may
	  allocate when loaded. A verified module whose footprint exceeds this
	  is unloaded and rejected, so one (even authentic) module cannot
	  exhaust the shared loadable-extension heap and starve the platform or
	  the other applications. 0 disables the check.

config APP_PLATFORM_KEYS_FILE
	string "Publisher key list"
	depends on APP_PLATFORM_LOADER
	help
	  YAML file listing the public keys trusted to sign application
	  modules, each with its key id, capability ceiling, allowed
	  application name prefix and revocation state. A relative path is
	  taken from the application source directory. The build compiles
	  the list into the firmware, and a manifest signed with a key the
	  list does not hold is refused. Empty for no publisher key.

config APP_PLATFORM_DEV_KEY
	bool "Accept modules signed with the development key"
	depends on APP_PLATFORM_LOADER
	help
	  Trust the development key, key id 0, with every capability and any
	  application name. Its private key is generated unprotected next to
	  the application sources on the first build, so a signature made
	  with it says nothing about who built a module. Samples and tests
	  enable it; it must be disabled in products, which list their
	  publisher keys in APP_PLATFORM_KEYS_FILE instead. The firmware logs
	  a warning at boot while it is enabled.

config APP_PLATFORM_DEV_KEY_FILE
	string "Development private key"
	depends on APP_PLATFORM_DEV_KEY
	default "keys/app_signing_key.pem"
	help
	  PEM file holding the development private key, generated when
	  missing. A relative path is taken from the application source
	  directory. The signing script uses the same file when it is given
	  no other key.

config APP_PLATFORM_EDK
	bool "Application module development kit"
	depends on APP_PLATFORM_LOADER && LLEXT_EDK
	default y
	select LLEXT_EDK_HEADERS_SELECTED
	help
	  Make the LLEXT EDK, built with the llext-edk target into
	  zephyr/app-platform-edk.tar.xz, the kit an application module is
	  built, checked and signed with outside the tree: the module SDK
	  header and the headers it includes, without kernel headers, the
	  target options of the firmware in place of its configuration, the
	  module compiler flags of this target, the interface lock, the
	  importable symbols, the firmware facts and public key table the
	  signer uses, the signer and a CMake helper. A module built with the
	  kit loads on this firmware and on later builds with the same
	  interface major version and target fingerprint. The toolchain is
	  not part of the kit.

config LLEXT_EDK_NAME
	default "app-platform-edk" if APP_PLATFORM_EDK

config LLEXT_EXPORT_SYMBOL_GROUP_APP_ABI
	bool "Export the application module interface"
	depends on LLEXT
	default y
	help
	  Export the app_abi_* functions listed in
	  subsys/app_platform/abi/app_abi.txt, through which a loadable
	  application module reaches the services and the platform. Only the
	  functions of the services built into this firmware are exported, so
	  a module that needs another service fails to load on an unresolved
	  symbol.

config APP_PLATFORM_FATAL_HANDLER
	bool "Provide the system fatal error handler"
	default y
	help
	  Define k_sys_fatal_error_handler() so a fault in an application
	  thread reclaims that application instead of halting the system.
	  Disable this when the application or another subsystem defines the
	  handler itself; that handler must then call
	  app_platform_handle_fatal_error() first and return when it reports
	  the fault as handled.

config APP_PLATFORM_RECLAIM_HOOKS
	int "Number of reclaim-hook slots"
	default 10
	help
	  How many services can register a hook to release per-application
	  resources when an application is reclaimed (the network, PSRAM,
	  key/value, timer-slot, UART, motor, ring and BLE GATT services each
	  register one). A
	  service whose registration does not fit is left without cleanup, so
	  raise this when adding one rather than letting it fail quietly.

config APP_PLATFORM_SENSOR
	bool "Typed sensor catalog service"
	depends on APP_PLATFORM_SERVICES
	depends on SENSOR
	help
	  Announce a catalog of typed sensor kinds and let an application read
	  one by index, in milli-units, without reaching the device, the bus or
	  the driver. A kind the board has no device for stays announced and
	  reads answer -ENODEV, so an application written against the catalog
	  keeps working on a board that gains the hardware later.

config APP_PLATFORM_SENSOR_READ_N_MAX
	int "Most samples in one multi-sample sensor read"
	depends on APP_PLATFORM_SENSOR
	default 32
	range 1 64
	help
	  Upper bound on the sample count of app_svc_sensor_read_n. The
	  samples of one call are staged on the caller's privileged stack,
	  four bytes each.

config APP_PLATFORM_COUNTER
	bool "Hardware counter service"
	depends on APP_PLATFORM_SERVICES
	depends on COUNTER
	help
	  Hand an application a granted hardware counter instance by index so it
	  can time an interval against real hardware. Reading is the whole
	  surface: alarms stay with the platform, because a counter callback
	  cannot cross into user mode.

config APP_PLATFORM_DAC
	bool "Analog output service"
	depends on APP_PLATFORM_SERVICES
	depends on DAC
	help
	  Drive a granted analog output channel by index. The channel is set up
	  on first use, because the platform does not know in advance which
	  application will be granted which channel.

config APP_PLATFORM_DAC_RESOLUTION
	int "Analog output resolution in bits"
	depends on APP_PLATFORM_DAC
	default 8
	help
	  Resolution the platform configures a channel with. It bounds the raw
	  code an application may write.

config APP_PLATFORM_EEPROM
	bool "EEPROM window service"
	depends on APP_PLATFORM_SERVICES
	depends on EEPROM
	help
	  Confine an application to a byte window of the shared EEPROM. Offsets
	  are relative to the window, so an application cannot name a byte
	  outside it, including another application's.

config APP_PLATFORM_EEPROM_XFER_MAX
	int "Maximum bytes per EEPROM read or write"
	depends on APP_PLATFORM_EEPROM
	default 64
	help
	  Bound on a single transfer. The bytes are copied through a supervisor
	  buffer of this size, so it is also the stack cost of the call.

config APP_PLATFORM_RTC
	bool "Real-time clock service"
	depends on APP_PLATFORM_SERVICES
	depends on RTC
	help
	  Read the wall clock, and set it under a separate capability because
	  setting it changes state every other application observes.

config APP_PLATFORM_W1
	bool "1-Wire service"
	depends on APP_PLATFORM_SERVICES
	depends on W1
	help
	  Reset the 1-Wire bus and move single bytes over it. The bus is shared,
	  so this is a capability rather than a per-device grant.

config APP_PLATFORM_POWER
	bool "Battery state service"
	depends on APP_PLATFORM_SERVICES
	depends on CHARGER && FUEL_GAUGE
	help
	  Report whether external power is present and how much charge is left.
	  Read-only: changing the charge policy stays with the system.

config APP_PLATFORM_REGULATOR
	bool "Regulator service"
	depends on APP_PLATFORM_SERVICES
	depends on REGULATOR
	help
	  Enable or disable a granted regulator instance by index.

config APP_PLATFORM_STEPPER
	bool "Stepper motor service"
	depends on APP_PLATFORM_SERVICES
	depends on STEPPER
	help
	  Move a granted stepper instance and read its position. Completion is
	  reported by a driver callback, which cannot cross into user mode, so
	  an application polls the position instead of being notified.

config APP_PLATFORM_FS
	bool "Per-application sandboxed file service"
	depends on APP_PLATFORM_SERVICES
	depends on FILE_SYSTEM
	help
	  Give each application a private subtree of one shared filesystem and
	  confine it there. An application names a file relative to its own root
	  and cannot reach another application's files: a path that is absolute
	  or holds a ".." component is refused, and an open handle is usable
	  only by the application that opened it.

if APP_PLATFORM_FS

config APP_PLATFORM_FS_MOUNT_POINT
	string "File service mount point"
	default APP_PLATFORM_REGISTRY_MOUNT_POINT if APP_PLATFORM_REGISTRY
	default "/lfs"
	help
	  Where the per-application roots live. With the registry enabled this
	  must name the mount the registry already owns: two filesystems over
	  one storage area corrupt each other.

config APP_PLATFORM_FS_OPEN_FILES
	int "Open files shared by all applications"
	default 4
	help
	  Size of the platform's open-file table. Every handle records its owner,
	  so this bounds the total number of files open at once, not the number
	  one application may hold.

config APP_PLATFORM_FS_PATH_MAX
	int "Maximum resolved file path length"
	default 64
	help
	  Bound on the absolute path built from an application's root and the
	  relative name it supplied. A longer path is refused.

config APP_PLATFORM_FS_XFER_MAX
	int "Maximum bytes per file read or write"
	default 256
	help
	  Bound on a single transfer. The bytes are copied through a supervisor
	  buffer of this size, so it is also the stack cost of a file call.

endif # APP_PLATFORM_FS

config APP_PLATFORM_PSRAM
	bool "Shared external RAM (PSRAM) mapping service"
	depends on APP_PLATFORM_SERVICES
	depends on SHARED_MULTI_HEAP
	help
	  Map a region of external RAM into an application's own memory domain
	  so the application accesses it directly at full speed, with no per-
	  access syscall. The region is freed when the application is reclaimed.

	  Needs a shared-multi-heap region advertising external memory, which
	  the board or SoC registers; without one the service answers -ENOTSUP.

config APP_PLATFORM_PSRAM_MAX_BYTES
	int "Largest external RAM region one application may map"
	depends on APP_PLATFORM_PSRAM
	default 1048576
	help
	  Upper bound on a single app_svc_psram_map request. The size an
	  application asks for is rounded up to a power of two for the memory
	  partition, so this bound also keeps that rounding finite. Requests
	  above it are refused with -EINVAL.

config APP_PLATFORM_SERVICES
	bool "Shared capability-gated service library"
	help
	  Provide the platform's services (logging, crypto, random, time and
	  more) as typed, capability-gated syscalls implemented once in the
	  platform. An application calls them without linking any driver code,
	  so a loadable application that uses only these stays small. Each
	  service enforces its capability bit and is safe under concurrent
	  callers. The crypto service needs a PSA provider (CONFIG_PSA_CRYPTO
	  with CONFIG_PSA_WANT_ALG_SHA_256); without it the rest still build.

config APP_PLATFORM_HAS_RANDOM
	bool
	default y if ENTROPY_HAS_DRIVER || TEST_RANDOM_GENERATOR || ARM64_RNG
	help
	  The system provides a random number generator, which the random
	  service needs. Without one the service returns -ENOTSUP.

config APP_PLATFORM_RING
	bool "Bulk transfer through an application-owned ring"
	depends on APP_PLATFORM_SERVICES
	depends on APP_PLATFORM_BUS
	help
	  Map a ring buffer into an application's own memory so it moves a
	  batch of bytes per syscall instead of one buffer per syscall. The
	  indices live in application memory and are range-checked by the
	  platform on every use, so a corrupt ring costs the application only
	  its own data. Each bound ring takes one memory-partition slot.

config APP_PLATFORM_RING_MAX_BYTES
	int "Largest ring an application may bind"
	depends on APP_PLATFORM_RING
	default 4096
	help
	  Upper bound on a single app_svc_ring_bind request. The size is rounded up
	  to a power of two for the memory partition, so this bound also keeps
	  that rounding finite.

config APP_PLATFORM_NET
	bool "Shared networking and MQTT service"
	depends on APP_PLATFORM_SERVICES
	depends on NETWORKING && MQTT_LIB
	select NET_MGMT
	select NET_MGMT_EVENT
	select ZVFS_EVENTFD
	help
	  Bring up the network link once in the platform and give
	  each application its own MQTT session, reached through capability-
	  gated app_svc_net_ready / svc_mqtt_ calls. An application that publishes
	  over MQTT then links none of the network code.

if APP_PLATFORM_NET

choice APP_PLATFORM_NET_LINK
	prompt "Link of the net service"
	default APP_PLATFORM_NET_LINK_WIFI if WIFI
	default APP_PLATFORM_NET_LINK_IFACE

config APP_PLATFORM_NET_LINK_WIFI
	bool "Wi-Fi station"
	depends on WIFI
	select NET_MGMT_EVENT_INFO
	help
	  The platform associates the first Wi-Fi interface with the
	  configured network and the link is up once it holds an IPv4
	  address and the MQTT broker name resolves.

config APP_PLATFORM_NET_LINK_IFACE
	bool "Any interface with an address"
	help
	  The link is up once an interface that is up holds an IPv4 address,
	  the default interface first, such as Ethernet or loopback. The
	  platform configures no interface and the Wi-Fi connect and
	  disconnect services return -ENOTSUP. The MQTT broker name is
	  resolved when an application opens a session.

endchoice

config ZVFS_EVENTFD_ADD_SIZE_APP_PLATFORM_NET
	int
	default 1
	help
	  The net thread waits for application requests on one eventfd.

config APP_PLATFORM_NET_WIFI_SSID
	string "Wi-Fi SSID"
	default ""
	help
	  Network the platform associates with when it brings the link up.
	  Empty leaves the link down until an application calls the connect
	  service with credentials of its own.

config APP_PLATFORM_NET_WIFI_PSK
	string "Wi-Fi PSK"
	default ""
	help
	  Pre-shared key for APP_PLATFORM_NET_WIFI_SSID. Empty means an open
	  network. Credentials belong in a private overlay, not in a
	  configuration file that is committed.

config APP_PLATFORM_NET_BROKER_HOST
	string "MQTT broker hostname"
	default "test.mosquitto.org"
	help
	  Broker an application reaches through the MQTT service. Resolved at
	  connect time, so a name or a literal address both work.

config APP_PLATFORM_NET_DGRAM_MAX
	int "Maximum socket datagram size"
	default 256
	range 64 1472
	help
	  Largest UDP datagram an application can send or receive, and the
	  chunk size of a TCP send or receive. A longer UDP send is refused
	  and a longer received datagram is truncated. Each application
	  holds one send buffer and five receive buffers of this size.

endif # APP_PLATFORM_NET

config APP_PLATFORM_GPIO
	bool "Shared GPIO service"
	depends on APP_PLATFORM_SERVICES
	depends on GPIO
	help
	  Expose the lines in the "gpios" property of the zephyr,app-platform
	  devicetree node as a capability-gated service. An application
	  holding APP_CAP_GPIO drives only the lines it is granted
	  (app_platform_grant_gpio), so the capability admits the service
	  and a per-line mask scopes it to specific pins.

config APP_PLATFORM_PERIPH
	bool "Shared PWM and ADC services"
	depends on APP_PLATFORM_SERVICES
	depends on PWM && ADC
	help
	  Expose PWM channels and ADC channels as capability-gated services
	  with per-channel grants, the same second-level grant pattern as the
	  GPIO service. Channels come from devicetree and each service is a
	  no-op when its node is absent.

config APP_PLATFORM_IO
	bool "Shared LED, button and checkpoint services"
	depends on APP_PLATFORM_SERVICES
	depends on GPIO
	help
	  Expose status LEDs and a button as capability-gated services (LEDs by
	  a per-application pin grant, button presses delivered one at a time)
	  plus a per-application checkpoint value the platform retains across a
	  crash and restart. The LED and button services are no-ops when their
	  devicetree alias is absent.

config APP_PLATFORM_EVENTS
	bool "Per-application event queue"
	depends on APP_PLATFORM_IO
	help
	  Deliver input events to an application through a queue of its own
	  rather than a single shared semaphore, so one application waiting
	  does not consume another's events and one application can wait on
	  several sources at once. Adds app_svc_event_wait(), on which the
	  app_events dispatcher builds registered callbacks.

config APP_PLATFORM_INPUT_KEYS
	bool "Take key events from the input subsystem"
	depends on APP_PLATFORM_EVENTS
	depends on INPUT
	default y if INPUT_GPIO_KEYS
	help
	  Source key events from the input subsystem rather than from a GPIO
	  interrupt on the sw0 alias. The driver debounces and reports a key
	  code, so applications see one event per press and can tell keys
	  apart. Without this the button is read directly and every raw edge is
	  reported.

config APP_PLATFORM_EVENT_QUEUE_LEN
	int "Events buffered per application"
	default 8
	range 1 64
	depends on APP_PLATFORM_EVENTS
	help
	  How many events one application may fall behind before the oldest
	  are dropped.

config APP_PLATFORM_RGB
	bool "Addressable RGB LED service"
	depends on APP_PLATFORM_SERVICES
	depends on LED_STRIP
	depends on $(dt_alias_enabled,led-strip)
	default y
	help
	  Expose the pixels of the LED strip on the led-strip devicetree alias
	  as a capability-gated service with a per-application pixel grant.
	  The platform keeps the colors and refreshes the whole strip on every
	  change. At most the first 32 pixels of the strip are exposed.

DT_CHOSEN_Z_DISPLAY := zephyr,display

config APP_PLATFORM_DISPLAY
	bool "Shared display service"
	depends on APP_PLATFORM_SERVICES
	depends on DISPLAY
	depends on $(dt_chosen_enabled,$(DT_CHOSEN_Z_DISPLAY))
	default y
	select EVENTS
	help
	  Let applications draw on the zephyr,display panel, each only
	  inside the viewport the platform granted it. The platform owns
	  the panel and serializes every access to it. A reclaimed
	  application's viewport is filled with
	  APP_PLATFORM_DISPLAY_CLEAR_COLOR.

config APP_PLATFORM_DISPLAY_XFER_MAX
	int "Bytes staged per display write chunk"
	default 4096
	range 256 65536
	depends on APP_PLATFORM_DISPLAY
	help
	  An application's pixel data is copied into a per-application
	  supervisor buffer of this size, one chunk of whole rows at a
	  time, and written to the panel under the display lock. The cost
	  is this size times APP_PLATFORM_MAX_APPS.

config APP_PLATFORM_DISPLAY_CLEAR_COLOR
	hex "Color written over a reclaimed application's viewport"
	default 0x0
	depends on APP_PLATFORM_DISPLAY
	help
	  Pixel value in the panel's format, with the same encoding as the
	  color argument of app_svc_display_fill().

config APP_PLATFORM_MOTION
	bool "Shared pulse-counter and motor-control PWM services"
	depends on APP_PLATFORM_SERVICES
	depends on PWM && SENSOR
	help
	  Expose a hardware pulse counter and a motor-control PWM (MCPWM) output
	  as capability-gated services. Each service is a no-op when its
	  devicetree node is absent.

config APP_PLATFORM_BUS
	bool "Shared I2C, SPI and UART services"
	depends on APP_PLATFORM_SERVICES
	depends on I2C && SPI && SERIAL
	help
	  Expose the I2C and SPI controllers and a secondary UART as
	  capability-gated services. I2C is scoped by a per-application address
	  grant and SPI by a per-application grant, so an application reaches
	  only the bus devices it was given. Each service is a no-op when its
	  devicetree node is absent.

if APP_PLATFORM_BUS

config APP_PLATFORM_BUS_XFER_MAX
	int "Largest I2C, SPI or UART transfer in one call"
	default 256
	range 16 4096
	help
	  Bytes one bus service call may move. A larger bound lets a sensor
	  FIFO be drained in one transfer, at the cost of holding the bus
	  longer against other applications.

config APP_PLATFORM_UART_RX_BUF
	int "Secondary UART receive buffer"
	default 256
	range 32 4096
	depends on UART_INTERRUPT_DRIVEN
	help
	  Bytes the secondary UART keeps for applications between reads, when
	  the port is read through interrupts.

config APP_PLATFORM_I2C_ADDRS
	int "I2C addresses per application"
	default 4
	range 1 16

config APP_PLATFORM_I2C_ERROR_LIMIT
	int "Failed I2C transfers before an application loses its grants"
	default 8
	range 0 255
	help
	  After this many I2C transfers of one application fail in a row, the
	  platform revokes that application's address grants and tries to
	  recover the bus. 0 never revokes.

endif # APP_PLATFORM_BUS

config APP_PLATFORM_BLE
	bool "Shared BLE service"
	depends on APP_PLATFORM_SERVICES
	depends on BT && BT_OBSERVER && BT_CENTRAL && BT_GATT_CLIENT
	help
	  Expose BLE scanning and a heart-rate read as capability-gated
	  services. An application holding APP_CAP_BLE asks the platform to scan
	  for a peer by name, or to connect to a heart-rate peer and read one
	  measurement, without linking any of the BLE stack.

config APP_PLATFORM_BLE_GATT
	bool "Generic GATT client"
	depends on APP_PLATFORM_BLE
	help
	  Add app_svc_ble_gatt_read and app_svc_ble_gatt_write, which let an
	  application name a service and characteristic by UUID instead of
	  being limited to the profiles the platform implements. The platform
	  still owns the connection and the handles: an application passes
	  UUIDs, never a handle, and reaches only the service UUIDs granted to
	  it with app_platform_grant_ble_gatt().

config APP_PLATFORM_BLE_GATT_MAX_SERVICES
	int "Granted service UUIDs per application"
	default 4
	range 1 16
	depends on APP_PLATFORM_BLE_GATT
	help
	  How many distinct service UUIDs one application may be granted.

config APP_PLATFORM_BLE_SERVE
	bool "GATT server for applications"
	depends on APP_PLATFORM_BLE
	depends on APP_PLATFORM_BLE_GATT
	depends on APP_PLATFORM_EVENTS
	depends on BT_PERIPHERAL
	depends on BT_GATT_DYNAMIC_DB
	help
	  Let an application serve a GATT service of its own: the platform
	  registers the service, advertises, owns the values and the
	  connection, and reports a peer's write as an input event. The
	  application declares characteristics by UUID and never sees a
	  connection or an attribute handle.

config APP_PLATFORM_BLE_OTA
	bool "Fetch applications over BLE"
	depends on APP_PLATFORM_BLE
	depends on APP_PLATFORM_LOADER && APP_PLATFORM_REGISTRY
	depends on FILE_SYSTEM
	help
	  Add app_svc_ble_ota_fetch, which pulls a signed application's manifest,
	  signature and module from a BLE peer over GATT and stores them, so a
	  device with no network connection can still be updated. The transfer
	  is untrusted: the caller verifies the signature and the module hash
	  before anything is installed or launched.

config APP_PLATFORM_RADIO
	bool "Shared 802.15.4 messaging service"
	depends on APP_PLATFORM_SERVICES
	depends on NET_L2_IEEE802154 && NET_IPV6 && NET_SOCKETS
	help
	  Expose 802.15.4 UDP messaging as a capability-gated service. The
	  platform owns the radio and the socket; an application holding
	  APP_CAP_RADIO sends and receives datagrams to a peer through copied
	  buffers, without holding the socket or linking the network stack.

if APP_PLATFORM_RADIO

config APP_PLATFORM_RADIO_PEER
	string "802.15.4 peer IPv6 address"
	default "2001:db8::1"
	help
	  Destination the radio service sends datagrams to. The default is a
	  documentation address and is meant to be overridden.

endif # APP_PLATFORM_RADIO

config APP_PLATFORM_CAN
	bool "Shared CAN service"
	depends on APP_PLATFORM_SERVICES
	depends on CAN
	help
	  Expose CAN messaging as a capability-gated service. The platform
	  starts the controller at the bitrate of its devicetree node and runs
	  it on the bus. Each application receives the frames that match its
	  own filters into its own queue, without holding the bus.

if APP_PLATFORM_CAN

config APP_PLATFORM_CAN_LOOPBACK
	bool "Run the CAN controller in loopback"
	help
	  Run the controller in loopback mode, so frames an application sends
	  come back to be received on the same board without a transceiver or
	  another node. For single-board testing only.

config APP_PLATFORM_CAN_FILTERS
	int "CAN receive filters per application"
	default 4
	range 1 16

config APP_PLATFORM_CAN_RX_DEPTH
	int "CAN frames queued per application"
	default 8
	range 1 64
	help
	  How many received frames one application may fall behind before
	  further frames for it are dropped and counted.

endif # APP_PLATFORM_CAN

config APP_PLATFORM_DMA
	bool "Shared memory-to-memory DMA service"
	depends on APP_PLATFORM_SERVICES
	depends on DMA
	help
	  Expose a memory-to-memory DMA copy as a capability-gated service. The
	  platform owns the channel and the DMA buffers and handles cache
	  coherency; the application hands in bytes and gets the copy back.

config APP_PLATFORM_REGISTRY
	bool "Persistent installed-application registry"
	depends on FILE_SYSTEM
	help
	  Persist the set of installed applications to a filesystem so it
	  survives reboots.

if APP_PLATFORM_REGISTRY

config APP_PLATFORM_REGISTRY_MAX_APPS
	int "Maximum installed applications"
	default 8
	help
	  Records the on-flash registry holds. The whole table is one fixed
	  size structure, so this sets the file size.

config APP_PLATFORM_REGISTRY_NAME_MAX
	int "Maximum application name length"
	default 16
	help
	  Bytes a record reserves for the name, terminator included. A
	  manifest carries a longer name, and installing one that does not
	  fit is refused rather than truncated.

config APP_PLATFORM_REGISTRY_MOUNT_POINT
	string "Registry filesystem mount point"
	default "/lfs"
	help
	  Where the registry file and the installed module blobs live. The
	  platform mounts this itself when the registry is enabled.

endif # APP_PLATFORM_REGISTRY

module = APP_PLATFORM
module-str = app_platform
source "subsys/logging/Kconfig.template.log_config"

endif # APP_PLATFORM
```
