## boards/espressif/esp_sensairshuttle/Kconfig.defconfig
```kconfig
# Copyright (c) 2026 Espressif Systems (Shanghai) Co., Ltd.
# SPDX-License-Identifier: Apache-2.0

if BOARD_ESP_SENSAIRSHUTTLE_ESP32C5_HPCORE

config REGULATOR
	default y if DISPLAY || ADC

endif # BOARD_ESP_SENSAIRSHUTTLE_ESP32C5_HPCORE
```

## boards/espressif/esp_sensairshuttle/Kconfig.esp_sensairshuttle
```kconfig
# Copyright (c) 2026 Espressif Systems (Shanghai) Co., Ltd.
# SPDX-License-Identifier: Apache-2.0

config BOARD_ESP_SENSAIRSHUTTLE
	select SOC_ESP32C5
	select SOC_ESP32C5_HPCORE if BOARD_ESP_SENSAIRSHUTTLE_ESP32C5_HPCORE
	select SOC_ESP32C5_LPCORE if BOARD_ESP_SENSAIRSHUTTLE_ESP32C5_LPCORE
```

## boards/espressif/esp_sensairshuttle/board.yml
```yaml
board:
  name: esp_sensairshuttle
  full_name: ESP-SensairShuttle
  vendor: espressif
  socs:
    - name: esp32c5
```

## boards/others/firebeatle/Kconfig.firebeatle_esp32c6
```kconfig
# ESP32C6 devkitc board configuration

# Copyright (c) 2024 Espressif Systems (Shanghai) Co., Ltd.
# SPDX-License-Identifier: Apache-2.0

config BOARD_FIREBEATLE_ESP32C6
	select SOC_ESP32_C6_WROOM_1U_N8
	select SOC_ESP32C6_HPCORE if BOARD_FIREBEATLE_ESP32C6_ESP32C6_HPCORE
	select SOC_ESP32C6_LPCORE if BOARD_FIREBEATLE_ESP32C6_ESP32C6_LPCORE
```

## boards/others/firebeatle/board.yml
```yaml
board:
  name: firebeatle_esp32c6
  full_name: FIREBEATLE-ESP32C6
  vendor: dfrobot
  socs:
  - name: esp32c6
```

## boards/shields/bosch_bmi270_bmm350_shuttle/Kconfig.shield
```kconfig
# Copyright (c) 2026 Espressif Systems (Shanghai) Co., Ltd.
# SPDX-License-Identifier: Apache-2.0

config SHIELD_BOSCH_BMI270_BMM350_SHUTTLE
	def_bool $(shields_list_contains,bosch_bmi270_bmm350_shuttle)
```

## drivers/cache/Kconfig.esp32
```kconfig
# Copyright (c) 2026 Espressif Systems (Shanghai) Co., Ltd.
# SPDX-License-Identifier: Apache-2.0

config CACHE_ESP32
	bool "Espressif ESP32 cache driver"
	default y
	depends on SOC_FAMILY_ESPRESSIF_ESP32 && CACHE_MANAGEMENT
	select CACHE_HAS_DRIVER
	help
	  Enable cache management driver for Espressif SoCs that access
	  internal SRAM through an L2 cache (e.g. ESP32-P4).
```

## drivers/pulse_io/Kconfig
```kconfig
# Pulse IO subsystem
#
# Copyright (c) 2026 Espressif Systems (Shanghai) Co., Ltd.
# SPDX-License-Identifier: Apache-2.0

menuconfig PULSE_IO
	bool "Pulse IO drivers"
	help
	  Enable support for the Pulse IO subsystem, a vendor-neutral
	  abstraction for hardware that generates and captures timed
	  digital edges on a GPIO line.

if PULSE_IO

module = PULSE_IO
module-str = pulse_io
source "subsys/logging/Kconfig.template.log_config"

config PULSE_IO_INIT_PRIORITY
	int "Pulse IO init priority"
	default 80
	help
	  Device driver init priority for Pulse IO devices.

config PULSE_IO_LOOPBACK
	bool "Software loopback Pulse IO backend"
	default y
	depends on DT_HAS_ZEPHYR_PULSE_IO_LOOPBACK_ENABLED
	help
	  Enable the software loopback Pulse IO backend. It loops
	  transmitted symbols back on receive so the subsystem API can
	  be tested without hardware.

config PULSE_IO_ESP32_RMT
	bool "Espressif RMT Pulse IO backend"
	default y
	depends on DT_HAS_ESPRESSIF_ESP32_RMT_ENABLED
	help
	  Enable the Espressif RMT (Remote Control Transceiver) Pulse IO
	  backend.

config PULSE_IO_ESP32_RMT_DMA
	def_bool SOC_SERIES_ESP32S3
	depends on PULSE_IO_ESP32_RMT
	select DMA if DT_HAS_ESPRESSIF_ESP32_GDMA_ENABLED
	help
	  Compile the RMT DMA path on SoCs whose RMT DMA generation the
	  backend supports.

config PULSE_IO_ESP32_RMT_DMA_WORDS
	int "RMT DMA buffer size in RMT words"
	depends on PULSE_IO_ESP32_RMT_DMA
	default 256
	help
	  Size of the static transmit and receive DMA bounce buffers,
	  in RMT symbol words (4 bytes each). Only used by the last
	  transmit and receive channels when DMA is enabled through the
	  dmas devicetree property.

endif # PULSE_IO
```

## dts/bindings/misc/zephyr,app-platform.yaml
```yaml
# Copyright (c) 2026 Espressif Systems (Shanghai) Co., Ltd.
# SPDX-License-Identifier: Apache-2.0

description: |
  Devices the application platform hands out to applications by index.

  Each list is in index order: the first entry is instance 0 of that service.
  A device that is not listed here is never reachable by an application,
  whatever else the board describes.

  Example:

    app-platform {
        compatible = "zephyr,app-platform";
        gpios = <&gpio0 2 GPIO_ACTIVE_HIGH>, <&gpio0 3 GPIO_ACTIVE_HIGH>;
        line-names = "status", "relay";
        counters = <&timer0 &timer1>;
    };

compatible: "zephyr,app-platform"

include: base.yaml

properties:
  gpios:
    type: phandle-array
    description: GPIO lines applications may drive or watch.

  line-names:
    type: string-array
    description: Names of the GPIO lines, in the order of gpios.

  counters:
    type: phandles
    description: Counter devices.

  dacs:
    type: phandles
    description: DAC devices.

  regulators:
    type: phandles
    description: Regulator devices.

  steppers:
    type: phandles
    description: Stepper motor controller devices.

  sensors:
    type: phandles
    description: |
      Sensor devices backing the sensor service's catalog. The first listed
      device that reports a kind's channel backs that kind.
```
