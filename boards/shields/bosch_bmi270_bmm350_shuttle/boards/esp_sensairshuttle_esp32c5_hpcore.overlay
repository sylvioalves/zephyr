/*
 * Copyright (c) 2026 Espressif Systems (Shanghai) Co., Ltd.
 *
 * SPDX-License-Identifier: Apache-2.0
 */

#include <zephyr/dt-bindings/gpio/gpio.h>

&bmi270 {
	irq-gpios = <&gpio0 0 GPIO_ACTIVE_HIGH>;
};
