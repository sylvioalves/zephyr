## CMakeLists.txt
```
# Copyright (c) 2026 Espressif Systems (Shanghai) Co., Ltd.
# SPDX-License-Identifier: Apache-2.0

cmake_minimum_required(VERSION 3.20.0)
find_package(Zephyr REQUIRED HINTS $ENV{ZEPHYR_BASE})
project(app_platform_abi_test)

target_sources(app PRIVATE src/main.c src/renumber_probe.c)

# The module the producer image, another firmware for the same target, built
# and signed, and the facts of that firmware.
set(producer_dir ${CMAKE_BINARY_DIR}/../app_abi_producer/zephyr/include/generated)
set(copy_dir ${ZEPHYR_BINARY_DIR}/include/generated/producer)
foreach(name renumber_mod.inc renumber_mod.manifest.inc renumber_mod.sig.inc
             renumber_facts.h)
  list(APPEND producer_files ${producer_dir}/${name})
  list(APPEND copied_files ${copy_dir}/${name})
endforeach()

add_custom_command(
  OUTPUT ${copied_files}
  COMMAND ${CMAKE_COMMAND} -E make_directory ${copy_dir}
  COMMAND ${CMAKE_COMMAND} -E copy ${producer_files} ${copy_dir}
  DEPENDS ${producer_files}
)
add_custom_target(producer_files DEPENDS ${copied_files})
add_dependencies(app producer_files)
```

## prj.conf
```kconfig
CONFIG_ZTEST=y

# Adds the syscall declared in src/renumber_probe.h.
CONFIG_APPLICATION_DEFINED_SYSCALL=y

CONFIG_APP_PLATFORM=y
CONFIG_APP_PLATFORM_MAX_APPS=2
CONFIG_APP_PLATFORM_LOADER=y
# The producer image signs the module with the development key of the
# app_platform test.
CONFIG_APP_PLATFORM_DEV_KEY=y
CONFIG_APP_PLATFORM_DEV_KEY_FILE="../app_platform/keys/app_signing_key.pem"
CONFIG_APP_PLATFORM_SERVICES=y
# The test counts the application faults in its own handler.
CONFIG_APP_PLATFORM_FATAL_HANDLER=n

CONFIG_TASK_WDT=y
CONFIG_TASK_WDT_HW_FALLBACK=n

CONFIG_LLEXT=y
CONFIG_LLEXT_HEAP_SIZE=32
CONFIG_LLEXT_TYPE_ELF_RELOCATABLE=y

CONFIG_PSA_CRYPTO=y
CONFIG_MBEDTLS_ENABLE_HEAP=y
CONFIG_MBEDTLS_HEAP_SIZE=4096
CONFIG_PSA_WANT_ALG_SHA_256=y
CONFIG_PSA_WANT_ALG_ECDSA=y
CONFIG_PSA_WANT_ECC_SECP_R1_256=y
CONFIG_PSA_WANT_KEY_TYPE_ECC_PUBLIC_KEY=y
CONFIG_MBEDTLS_PSA_P256M_DRIVER_ENABLED=y
CONFIG_ENTROPY_GENERATOR=y

CONFIG_LOG=y
CONFIG_LOG_MODE_MINIMAL=y

CONFIG_MAIN_STACK_SIZE=4096
CONFIG_ZTEST_STACK_SIZE=4096
CONFIG_HEAP_MEM_POOL_SIZE=16384

# The producer image runs at 10000 ticks per second.
CONFIG_SYS_CLOCK_TICKS_PER_SEC=100
```

## src/main.c
```c
/*
 * Copyright (c) 2026 Espressif Systems (Shanghai) Co., Ltd.
 *
 * SPDX-License-Identifier: Apache-2.0
 */

/* A module built and signed by another firmware for the same target, one with
 * other syscalls and another tick rate, runs in this firmware.
 */

#include <zephyr/ztest.h>
#include <zephyr/app_platform/app_loader.h>
#include <zephyr/app_platform/app_manifest.h>
#include <zephyr/app_platform/app_platform.h>
#include <zephyr/llext/llext.h>
#include <zephyr/kernel.h>
#include <zephyr/syscall_list.h>
#include <string.h>

#include "renumber_probe.h"
#include "producer/renumber_facts.h"

static const uint8_t mod_bytes[] = {
#include "producer/renumber_mod.inc"
};
static const uint8_t mod_manifest[] = {
#include "producer/renumber_mod.manifest.inc"
};
static const uint8_t mod_sig[] = {
#include "producer/renumber_mod.sig.inc"
};

static uint8_t work[8192] __aligned(8);

static atomic_t app_faults;

void k_sys_fatal_error_handler(unsigned int reason, const struct arch_esf *esf)
{
	if (!app_platform_handle_fatal_error(reason, esf)) {
		k_fatal_halt(reason);
	}
	atomic_inc(&app_faults);
}

static int slot_of(const char *name)
{
	for (int i = 0; i < app_platform_count(); i++) {
		struct app_platform_status st;

		if (app_platform_status(i, &st) == 0 && st.name != NULL &&
		    strcmp(st.name, name) == 0) {
			return i;
		}
	}
	return -1;
}

static bool wait_slot_free(const char *name, int ms)
{
	for (int i = 0; i < ms / 10; i++) {
		if (slot_of(name) < 0) {
			return true;
		}
		k_msleep(10);
	}
	return slot_of(name) < 0;
}

ZTEST(app_abi_renumber, test_firmware_differs)
{
	zassert_equal(aaa_renumber_probe(1), 2);
	zassert_not_equal(K_SYSCALL_APP_SVC_UPTIME_MS, PRODUCER_SYSCALL_APP_SVC_UPTIME_MS,
			  "the service syscalls were not renumbered");
	zassert_not_equal(CONFIG_SYS_CLOCK_TICKS_PER_SEC, PRODUCER_TICKS_PER_SEC,
			  "the tick rate is the producer's");
}

ZTEST(app_abi_renumber, test_foreign_module_runs)
{
	struct app_manifest mf;
	struct llext *ext = NULL;
	void *entry = NULL;
	int id;

	zassert_true(sizeof(mod_bytes) <= sizeof(work), "module too big");
	memcpy(work, mod_bytes, sizeof(mod_bytes));
	memcpy(&mf, mod_manifest, sizeof(mf));
	zassert_equal(app_loader_verify_load_manifest(&mf, sizeof(mf), mod_sig, sizeof(mod_sig),
						      work, sizeof(mod_bytes), "app_main", &ext,
						      &entry),
		      0);

	id = app_platform_launch_llext(mf.name, ext, (app_entry_t)entry, NULL,
				       APP_CAP_LOG | APP_CAP_TIME);
	zassert_true(id >= 0, "launch rc %d", id);
	if (!wait_slot_free(mf.name, 5000)) {
		(void)app_platform_remove(id);
		zassert_true(wait_slot_free(mf.name, 2000), "the module was not removed");
		zassert_unreachable("the module did not measure the sleep");
	}
	zassert_equal(atomic_get(&app_faults), 0, "the module faulted");
}

static void *renumber_setup(void)
{
	zassert_equal(app_platform_init(), 0, "platform init failed");
	return NULL;
}

ZTEST_SUITE(app_abi_renumber, NULL, renumber_setup, NULL, NULL, NULL);
```

## src/renumber_probe.c
```c
/*
 * Copyright (c) 2026 Espressif Systems (Shanghai) Co., Ltd.
 *
 * SPDX-License-Identifier: Apache-2.0
 */

#include <zephyr/kernel.h>
#include <zephyr/internal/syscall_handler.h>

#include "renumber_probe.h"

int z_impl_aaa_renumber_probe(int value)
{
	return value + 1;
}

#ifdef CONFIG_USERSPACE
static inline int z_vrfy_aaa_renumber_probe(int value)
{
	return z_impl_aaa_renumber_probe(value);
}
#include <zephyr/syscalls/aaa_renumber_probe_mrsh.c>
#endif
```

## src/renumber_probe.h
```c
/*
 * Copyright (c) 2026 Espressif Systems (Shanghai) Co., Ltd.
 *
 * SPDX-License-Identifier: Apache-2.0
 */

#ifndef RENUMBER_PROBE_H_
#define RENUMBER_PROBE_H_

/* A syscall sorting before every application service, which moves their
 * numbers away from the ones of the producer firmware.
 */
__syscall int aaa_renumber_probe(int value);

#include <zephyr/syscalls/renumber_probe.h>

#endif
```
