## CMakeLists.txt
```
# Copyright (c) 2026 Espressif Systems (Shanghai) Co., Ltd.
# SPDX-License-Identifier: Apache-2.0

cmake_minimum_required(VERSION 3.20.0)
find_package(Zephyr REQUIRED HINTS $ENV{ZEPHYR_BASE})
project(app_abi_producer)

target_sources(app PRIVATE src/main.c)

set(gen_dir ${ZEPHYR_BINARY_DIR}/include/generated)
set(bin ${PROJECT_BINARY_DIR}/llext/renumber_mod.llext)
set(mf  ${gen_dir}/renumber_mod.manifest.inc)
set(sig ${gen_dir}/renumber_mod.sig.inc)
set(facts ${gen_dir}/renumber_facts.h)

app_platform_add_module(renumber_ext OUTPUT ${bin}
  SOURCES ${CMAKE_CURRENT_SOURCE_DIR}/../module/renumber_mod.c)
generate_inc_file_for_target(app ${bin} ${gen_dir}/renumber_mod.inc)

add_custom_command(
  OUTPUT  ${mf} ${sig}
  COMMAND ${CMAKE_COMMAND}
    -DMODULE_BIN=${bin}
    -DKEY_DIR=${ZEPHYR_BASE}/tests/subsys/app_platform/keys
    -DAPP_NAME=renumber
    -DAPP_VERSION=1
    -DAPP_REQUESTED_CAPS=LOG,TIME
    -DABI_FILE=${APP_PLATFORM_ABI_FILE}
    -DOUT_MF_INC=${mf}
    -DOUT_SIG_INC=${sig}
    -DPYTHON_EXECUTABLE=${PYTHON_EXECUTABLE}
    -P ${ZEPHYR_BASE}/subsys/app_platform/cmake/sign_module.cmake
  DEPENDS ${bin} ${APP_PLATFORM_ABI_FILE}
)
add_custom_target(renumber_sign DEPENDS ${mf} ${sig})
add_dependencies(renumber_sign app_platform_abi)
add_dependencies(app renumber_sign)

# The syscall number and tick rate the module would have baked in had it
# called the services through syscalls.
set(syscall_list ${gen_dir}/zephyr/syscall_list.h)
add_custom_command(
  OUTPUT ${facts}
  COMMAND ${CMAKE_COMMAND}
    -DSYSCALL_LIST=${syscall_list}
    -DTICKS=${CONFIG_SYS_CLOCK_TICKS_PER_SEC}
    -DOUT=${facts}
    -P ${CMAKE_CURRENT_SOURCE_DIR}/facts.cmake
  DEPENDS ${syscall_list} ${CMAKE_CURRENT_SOURCE_DIR}/facts.cmake
)
add_custom_target(renumber_facts DEPENDS ${facts})
add_dependencies(renumber_facts ${SYSCALL_LIST_H_TARGET})
add_dependencies(app renumber_facts)
```

## prj.conf
```kconfig
CONFIG_APP_PLATFORM=y
CONFIG_APP_PLATFORM_MAX_APPS=1
CONFIG_APP_PLATFORM_LOADER=y
# The module is signed with the development key of the app_platform test.
CONFIG_APP_PLATFORM_DEV_KEY=y
CONFIG_APP_PLATFORM_DEV_KEY_FILE="../../app_platform/keys/app_signing_key.pem"
CONFIG_APP_PLATFORM_SERVICES=y

CONFIG_TASK_WDT=y
CONFIG_TASK_WDT_HW_FALLBACK=n

CONFIG_LLEXT=y
CONFIG_LLEXT_HEAP_SIZE=32
CONFIG_LLEXT_TYPE_ELF_RELOCATABLE=y

CONFIG_PSA_CRYPTO=y
CONFIG_MBEDTLS_ENABLE_HEAP=y
CONFIG_MBEDTLS_HEAP_SIZE=4096
CONFIG_PSA_WANT_ALG_SHA_256=y
CONFIG_PSA_WANT_ALG_ECDSA=y
CONFIG_PSA_WANT_ECC_SECP_R1_256=y
CONFIG_PSA_WANT_KEY_TYPE_ECC_PUBLIC_KEY=y
CONFIG_MBEDTLS_PSA_P256M_DRIVER_ENABLED=y
CONFIG_ENTROPY_GENERATOR=y

CONFIG_SYS_CLOCK_TICKS_PER_SEC=10000
```

## src/main.c
```c
/*
 * Copyright (c) 2026 Espressif Systems (Shanghai) Co., Ltd.
 *
 * SPDX-License-Identifier: Apache-2.0
 */

int main(void)
{
	return 0;
}
```
