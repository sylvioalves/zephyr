## CMakeLists.txt
```
# Copyright (c) 2026 Espressif Systems (Shanghai) Co., Ltd.
# SPDX-License-Identifier: Apache-2.0

cmake_minimum_required(VERSION 3.20.0)
find_package(Zephyr REQUIRED HINTS $ENV{ZEPHYR_BASE})
project(app_platform_edk_test)

target_sources(app PRIVATE src/main.c)
if(CONFIG_APPLICATION_DEFINED_SYSCALL)
  target_sources(app PRIVATE src/edk_probe.c)
endif()

# The modules of the module project, built and signed with the development kit
# of this firmware by a writer holding the key listed under key id 1.
set(writer_key ${CMAKE_CURRENT_SOURCE_DIR}/keys/writer.pem)
app_platform_edk_project(edk_modules
  SOURCE_DIR ${CMAKE_CURRENT_SOURCE_DIR}/module
  OUTPUTS hello.llext hello.manifest unlisted.llext unlisted.manifest
  DEPENDS ${writer_key}
  CMAKE_ARGS -DAPP_SIGNING_KEY=${writer_key} -DAPP_SIGNING_KEY_ID=1
)

# The test image also loads the modules built with the kit of the other
# firmware image, edk_peer, and compares the two firmwares. The other image
# uses its own modules and facts in their place.
set(own_dir ${CMAKE_CURRENT_BINARY_DIR}/edk_modules/build)
set(own_gen ${ZEPHYR_BINARY_DIR}/include/generated/zephyr)
if(SYSBUILD_MAIN_APP)
  set(peer_dir ${CMAKE_BINARY_DIR}/../edk_peer/edk_modules/build)
  set(peer_gen ${CMAKE_BINARY_DIR}/../edk_peer/zephyr/include/generated/zephyr)
else()
  set(peer_dir ${own_dir})
  set(peer_gen ${own_gen})
endif()

# The tick rate and a syscall number of each firmware.
set(gen_dir ${ZEPHYR_BINARY_DIR}/include/generated/edk)
foreach(fw own peer)
  string(TOUPPER ${fw} prefix)
  add_custom_command(
    OUTPUT ${gen_dir}/${fw}_facts.h
    COMMAND ${CMAKE_COMMAND}
      -DSYSCALL_LIST=${${fw}_gen}/syscall_list.h
      -DAUTOCONF=${${fw}_gen}/autoconf.h
      -DPREFIX=${prefix}
      -DOUT=${gen_dir}/${fw}_facts.h
      -P ${CMAKE_CURRENT_SOURCE_DIR}/facts.cmake
    DEPENDS ${${fw}_gen}/syscall_list.h ${${fw}_gen}/autoconf.h
      ${CMAKE_CURRENT_SOURCE_DIR}/facts.cmake
  )
  add_custom_target(edk_${fw}_facts DEPENDS ${gen_dir}/${fw}_facts.h)
  add_dependencies(edk_${fw}_facts ${SYSCALL_LIST_H_TARGET})
  add_dependencies(app edk_${fw}_facts)
endforeach()

foreach(file hello.llext hello.manifest unlisted.llext unlisted.manifest)
  generate_inc_file_for_target(app ${own_dir}/${file} ${gen_dir}/own_${file}.inc)
endforeach()
foreach(file hello.llext hello.manifest)
  generate_inc_file_for_target(app ${peer_dir}/${file} ${gen_dir}/peer_${file}.inc)
endforeach()
add_dependencies(app edk_modules)
```

## prj.conf
```kconfig
CONFIG_ZTEST=y

CONFIG_APP_PLATFORM=y
CONFIG_APP_PLATFORM_MAX_APPS=2
CONFIG_APP_PLATFORM_LOADER=y
CONFIG_APP_PLATFORM_SERVICES=y
# Modules are signed by the writer key of the list, outside the tree.
CONFIG_APP_PLATFORM_KEYS_FILE="edk_keys.yaml"
CONFIG_APP_PLATFORM_DEV_KEY=n
CONFIG_APP_PLATFORM_EDK=y
# The test counts the application faults in its own handler.
CONFIG_APP_PLATFORM_FATAL_HANDLER=n

CONFIG_USERSPACE=y

CONFIG_TASK_WDT=y
CONFIG_TASK_WDT_HW_FALLBACK=n

CONFIG_LLEXT=y
CONFIG_LLEXT_HEAP_SIZE=32
CONFIG_LLEXT_TYPE_ELF_RELOCATABLE=y

CONFIG_PSA_CRYPTO=y
CONFIG_MBEDTLS_ENABLE_HEAP=y
CONFIG_MBEDTLS_HEAP_SIZE=4096
CONFIG_PSA_WANT_ALG_SHA_256=y
CONFIG_PSA_WANT_ALG_ECDSA=y
CONFIG_PSA_WANT_ECC_SECP_R1_256=y
CONFIG_PSA_WANT_KEY_TYPE_ECC_PUBLIC_KEY=y
CONFIG_MBEDTLS_PSA_P256M_DRIVER_ENABLED=y
CONFIG_ENTROPY_GENERATOR=y

CONFIG_LOG=y
CONFIG_LOG_MODE_MINIMAL=y

CONFIG_MAIN_STACK_SIZE=4096
CONFIG_ZTEST_STACK_SIZE=4096
CONFIG_HEAP_MEM_POOL_SIZE=16384
```

## firmware_b.conf
```kconfig
CONFIG_SYS_CLOCK_TICKS_PER_SEC=100
# Adds the syscall declared in src/edk_probe.h, which renumbers the others.
CONFIG_APPLICATION_DEFINED_SYSCALL=y
```

## src/main.c
```c
/*
 * Copyright (c) 2026 Espressif Systems (Shanghai) Co., Ltd.
 *
 * SPDX-License-Identifier: Apache-2.0
 */

/* Modules built and signed outside the tree with the development kit of this
 * firmware and with the kit of another firmware for the same target, one with
 * other syscalls and another tick rate, run in this firmware.
 */

#include <zephyr/ztest.h>
#include <zephyr/app_platform/app_loader.h>
#include <zephyr/app_platform/app_manifest.h>
#include <zephyr/app_platform/app_platform.h>
#include <zephyr/llext/llext.h>
#include <zephyr/kernel.h>
#include <zephyr/syscall_list.h>
#include <string.h>

#include "edk/own_facts.h"
#include "edk/peer_facts.h"

static const uint8_t own_mod[] = {
#include "edk/own_hello.llext.inc"
};
static const uint8_t own_bundle[] = {
#include "edk/own_hello.manifest.inc"
};
static const uint8_t peer_mod[] = {
#include "edk/peer_hello.llext.inc"
};
static const uint8_t peer_bundle[] = {
#include "edk/peer_hello.manifest.inc"
};
static const uint8_t unlisted_mod[] = {
#include "edk/own_unlisted.llext.inc"
};
static const uint8_t unlisted_bundle[] = {
#include "edk/own_unlisted.manifest.inc"
};

static uint8_t work[8192] __aligned(8);

static atomic_t app_faults;

void k_sys_fatal_error_handler(unsigned int reason, const struct arch_esf *esf)
{
	if (!app_platform_handle_fatal_error(reason, esf)) {
		k_fatal_halt(reason);
	}
	atomic_inc(&app_faults);
}

static int slot_of(const char *name)
{
	for (int i = 0; i < app_platform_count(); i++) {
		struct app_platform_status st;

		if (app_platform_status(i, &st) == 0 && st.name != NULL &&
		    strcmp(st.name, name) == 0) {
			return i;
		}
	}
	return -1;
}

static bool wait_slot_free(const char *name, int ms)
{
	for (int i = 0; i < ms / 10; i++) {
		if (slot_of(name) < 0) {
			return true;
		}
		k_msleep(10);
	}
	return slot_of(name) < 0;
}

static int load(const uint8_t *mod, size_t mod_len, const uint8_t *bundle, size_t bundle_len,
		struct app_manifest *mf, struct llext **ext, void **entry)
{
	size_t mf_len = bundle_len - APP_MANIFEST_SIG_LEN;

	zassert_true(mod_len <= sizeof(work), "module too big");
	zassert_equal(mf_len, sizeof(*mf), "manifest length %zu", mf_len);
	memcpy(work, mod, mod_len);
	memcpy(mf, bundle, mf_len);
	return app_loader_verify_load_manifest(mf, mf_len, bundle + mf_len, APP_MANIFEST_SIG_LEN,
					       work, mod_len, "app_main", ext, entry);
}

static void run(const uint8_t *mod, size_t mod_len, const uint8_t *bundle, size_t bundle_len)
{
	struct app_manifest mf;
	struct llext *ext = NULL;
	void *entry = NULL;
	int id;

	zassert_equal(load(mod, mod_len, bundle, bundle_len, &mf, &ext, &entry), 0);
	zassert_equal(mf.key_id, 1U, "signed with key id %u", mf.key_id);

	id = app_platform_launch_llext(mf.name, ext, (app_entry_t)entry, NULL,
				       APP_CAP_LOG | APP_CAP_TIME);
	zassert_true(id >= 0, "launch rc %d", id);
	if (!wait_slot_free(mf.name, 5000)) {
		(void)app_platform_remove(id);
		zassert_true(wait_slot_free(mf.name, 2000), "the module was not removed");
		zassert_unreachable("the module did not measure the sleep");
	}
	zassert_equal(atomic_get(&app_faults), 0, "the module faulted");
}

ZTEST(app_edk, test_firmware_differs)
{
	zassert_equal(CONFIG_SYS_CLOCK_TICKS_PER_SEC, OWN_TICKS_PER_SEC);
	zassert_equal(K_SYSCALL_APP_SVC_UPTIME_MS, OWN_SYSCALL_APP_SVC_UPTIME_MS);
	zassert_not_equal(OWN_TICKS_PER_SEC, PEER_TICKS_PER_SEC,
			  "the two firmwares have the same tick rate");
	zassert_not_equal(OWN_SYSCALL_APP_SVC_UPTIME_MS, PEER_SYSCALL_APP_SVC_UPTIME_MS,
			  "the service syscalls of the two firmwares have the same numbers");
}

ZTEST(app_edk, test_kits_build_the_same_module)
{
	zassert_equal(sizeof(own_mod), sizeof(peer_mod));
	zassert_mem_equal(own_mod, peer_mod, sizeof(own_mod),
			  "the kits of the two firmwares build different modules");
}

ZTEST(app_edk, test_own_kit_module_runs)
{
	run(own_mod, sizeof(own_mod), own_bundle, sizeof(own_bundle));
}

ZTEST(app_edk, test_peer_kit_module_runs)
{
	run(peer_mod, sizeof(peer_mod), peer_bundle, sizeof(peer_bundle));
}

ZTEST(app_edk, test_unlisted_key_refused)
{
	struct app_manifest mf;
	struct llext *ext = NULL;
	void *entry = NULL;

	zassert_equal(load(unlisted_mod, sizeof(unlisted_mod), unlisted_bundle,
			   sizeof(unlisted_bundle), &mf, &ext, &entry),
		      -ENXIO);
	zassert_equal(mf.key_id, 7U);
	zassert_is_null(ext);
}

static void *edk_setup(void)
{
	zassert_equal(app_platform_init(), 0, "platform init failed");
	return NULL;
}

ZTEST_SUITE(app_edk, NULL, edk_setup, NULL, NULL, NULL);
```

## src/edk_probe.c
```c
/*
 * Copyright (c) 2026 Espressif Systems (Shanghai) Co., Ltd.
 *
 * SPDX-License-Identifier: Apache-2.0
 */

#include <zephyr/kernel.h>
#include <zephyr/internal/syscall_handler.h>

#include "edk_probe.h"

int z_impl_aaa_edk_probe(int value)
{
	return value + 1;
}

#ifdef CONFIG_USERSPACE
static inline int z_vrfy_aaa_edk_probe(int value)
{
	return z_impl_aaa_edk_probe(value);
}
#include <zephyr/syscalls/aaa_edk_probe_mrsh.c>
#endif
```

## src/edk_probe.h
```c
/*
 * Copyright (c) 2026 Espressif Systems (Shanghai) Co., Ltd.
 *
 * SPDX-License-Identifier: Apache-2.0
 */

#ifndef EDK_PROBE_H_
#define EDK_PROBE_H_

/* A syscall sorting before every application service, which moves their
 * syscall numbers in the firmware built with it.
 */
__syscall int aaa_edk_probe(int value);

#include <zephyr/syscalls/edk_probe.h>

#endif
```
