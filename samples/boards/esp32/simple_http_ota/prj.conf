## CMakeLists.txt
```
# SPDX-License-Identifier: Apache-2.0

cmake_minimum_required(VERSION 3.13.1)

include($ENV{ZEPHYR_BASE}/cmake/app/boilerplate.cmake NO_POLICY_SCOPE)
project(simple_http_ota)

FILE(GLOB app_sources src/*.c)
target_sources(app PRIVATE ${app_sources})

set(gen_dir ${ZEPHYR_BINARY_DIR}/include/generated/)
```

## Kconfig
```
mainmenu "simple_http_ota"

# Copyright (c) 2021 Espressif Systems (Shanghai) Co., Ltd.
# SPDX -License-Identifier: Apache-2.0

config SIMPLE_HTTP_OTA_FILE_URL
	string "Download URL"
	default "http://192.168.15.11/hello.bin"
	help
	  URL to download.

config SIMPLE_HTTP_OTA_DOWNLOAD_TIMEOUT
	int "File download timeout"
	default 30
	help
	  Defines the max download time in seconds of the update file before returning error.

source "Kconfig.zephyr"
```

## sample.yaml
```
sample:
  description: Simple HTTP Over-The-Air Update
  name: simple_http_ota
tests:
  sample.board.esp32:
    platform_allow: esp32
    tags: esp32
```

## prj.conf
```kconfig
# ESP32 config
CONFIG_WIFI=y
CONFIG_WIFI_ESP32=y
CONFIG_HEAP_MEM_POOL_SIZE=32768

CONFIG_NETWORKING=y
CONFIG_NET_L2_ETHERNET=y

CONFIG_NET_IPV6=n
CONFIG_NET_IPV4=y
CONFIG_NET_DHCPV4=y

CONFIG_NET_MGMT=y
CONFIG_NET_MGMT_EVENT=y

CONFIG_NET_LOG=y
CONFIG_NET_SHELL=n

CONFIG_ESP32_WIFI_STA_AUTO=y
CONFIG_ESP32_WIFI_SSID="Sogra"
CONFIG_ESP32_WIFI_PASSWORD="sograsemfio"

CONFIG_MBEDTLS=y
CONFIG_MBEDTLS_ENTROPY_ENABLED=y
CONFIG_MBEDTLS_KEY_EXCHANGE_ECDHE_ECDSA_ENABLED=y
CONFIG_MBEDTLS_ECP_ALL_ENABLED=y

CONFIG_MCUBOOT_IMG_MANAGER=y

# Shell
CONFIG_SHELL=y
CONFIG_KERNEL_SHELL=y
CONFIG_SHELL_STACK_SIZE=4096

CONFIG_FLASH=y
CONFIG_REBOOT=y
CONFIG_HWINFO=y
CONFIG_NET_TCP=y
CONFIG_NET_SOCKETS=y
CONFIG_IMG_MANAGER=y
CONFIG_HTTP_CLIENT=y
CONFIG_BOOTLOADER_MCUBOOT=y
CONFIG_MPU_ALLOW_FLASH_WRITE=y
CONFIG_IMG_ERASE_PROGRESSIVELY=y

CONFIG_SIMPLE_HTTP_OTA_FILE_URL="<your-ip-address>/hello.bin"
```

## src/main.c
```c
/*
 * Copyright (c) 2021 Espressif Systems (Shanghai) Co., Ltd.
 *
 * SPDX-License-Identifier: Apache-2.0
 */

#include <stdio.h>
#include <string.h>
#include <stdlib.h>
#include <zephyr.h>
#include <sys/printk.h>
#include <logging/log.h>
LOG_MODULE_REGISTER(main);

#include "simple_http_ota.h"
#include "dhcp.h"

void main(void)
{
	int ret = -1;

	LOG_INF("OTA sample app started");

	ret = simple_http_ota_init();

	LOG_INF("Waiting IP address from network..");
	app_dhcpv4_startup();

	if (ret < 0) {
		LOG_ERR("Failed to init esp http ota application");
	}
}
```

## src/dhcp.c
```c
/*
 * Copyright (c) 2021 Espressif Systems (Shanghai) Co., Ltd.
 *
 * SPDX-License-Identifier: Apache-2.0
 */

#include <zephyr.h>

#include <net/net_if.h>
#include <net/net_core.h>
#include <net/net_context.h>
#include <net/net_mgmt.h>
#include <logging/log.h>
LOG_MODULE_REGISTER(dhcp);

#include "dhcp.h"

static struct net_mgmt_event_callback mgmt_cb;

/* Semaphore to indicate a lease has been acquired */
static K_SEM_DEFINE(got_address, 0, 1);

static void handler(struct net_mgmt_event_callback *cb,
		    uint32_t mgmt_event,
		    struct net_if *iface)
{
	int i;
	bool notified = false;

	ARG_UNUSED(cb);

	if (mgmt_event != NET_EVENT_IPV4_ADDR_ADD) {
		return;
	}

	for (i = 0; i < NET_IF_MAX_IPV4_ADDR; i++) {
		if (iface->config.ip.ipv4->unicast[i].addr_type !=
		    NET_ADDR_DHCP) {
			continue;
		}

		if (!notified) {
			k_sem_give(&got_address);
			notified = true;
		}
		break;
	}
}

/**
 * Start a DHCP client, and wait for a lease to be acquired.
 */
void app_dhcpv4_startup(void)
{
	struct net_if *iface;

	net_mgmt_init_event_callback(&mgmt_cb, handler,
				     NET_EVENT_IPV4_ADDR_ADD);
	net_mgmt_add_event_callback(&mgmt_cb);

	iface = net_if_get_default();
	if (!iface) {
		LOG_ERR("wifi interface not available");
		return;
	}

	net_dhcpv4_start(iface);

	/* Wait for a lease */
	if (k_sem_take(&got_address, DHCP_TIMEOUT) != 0) {
		LOG_ERR("could not attach to network");
	}
}
```

## src/dhcp.h
```c
/*
 * Copyright (c) 2021 Espressif Systems (Shanghai) Co., Ltd.
 *
 * SPDX-License-Identifier: Apache-2.0
 */

#ifndef __DHCP_H__
#define __DHCP_H__

#define DHCP_TIMEOUT K_SECONDS(30)

/**
 * @brief Init DHCPv4 interface
 *
 * Start DHCP interface and wait DHCP_TIMEOUT seconds to
 * get IP address assignement.
 *
 * @return N/A
 */
void app_dhcpv4_startup(void);

#endif
```

## src/shell.c
```c
/*
 * Copyright (c) 2021 Espressif Systems (Shanghai) Co., Ltd.
 *
 * SPDX-License-Identifier: Apache-2.0
 */

#include <zephyr.h>
#include <shell/shell.h>
#include <drivers/flash.h>
#include <storage/flash_map.h>
#include <dfu/mcuboot.h>
#include <dfu/flash_img.h>
#include <sys/reboot.h>
#include <string.h>
#include <drivers/hwinfo.h>

#include "simple_http_ota.h"

#define DEVICE_ID_BIN_MAX_SIZE	16
#define DEVICE_ID_HEX_MAX_SIZE	((DEVICE_ID_BIN_MAX_SIZE * 2) + 1)

static void cmd_run(const struct shell *shell, size_t argc, char **argv)
{
	ARG_UNUSED(argc);
	ARG_UNUSED(argv);

	shell_fprintf(shell, SHELL_INFO, "Starting SIMPLE HTTP OTA...\n");
	simple_http_ota_run();
	k_sleep(K_MSEC(1));
}

static void esp_get_firmware_version(char *version, int version_len)
{
	snprintk(version, version_len, "%d.%d",
		SIMPLE_HTTP_OTA_MAJOR_VERSION, SIMPLE_HTTP_OTA_MINOR_VERSION);
}

bool esp_get_device_identity(char *id, int id_max_len)
{
	uint8_t hwinfo_id[DEVICE_ID_BIN_MAX_SIZE];
	ssize_t length;

	length = hwinfo_get_device_id(hwinfo_id, DEVICE_ID_BIN_MAX_SIZE);
	if (length <= 0) {
		return false;
	}

	memset(id, 0, id_max_len);
	length = bin2hex(hwinfo_id, (size_t)length, id, id_max_len - 1);

	return length > 0;
}

static int cmd_info(const struct shell *shell, size_t argc, char *argv)
{
	ARG_UNUSED(argc);
	ARG_UNUSED(argv);

	char device_id[DEVICE_ID_HEX_MAX_SIZE] = {0};
	char firmware_version[BOOT_IMG_VER_STRLEN_MAX] = {0};

	esp_get_firmware_version(firmware_version, BOOT_IMG_VER_STRLEN_MAX);
	esp_get_device_identity(device_id, DEVICE_ID_HEX_MAX_SIZE);

	shell_fprintf(shell, SHELL_NORMAL, "Device macaddress: %s\n", device_id);
	shell_fprintf(shell, SHELL_NORMAL, "Firmware Version: %s\n", firmware_version);

	return 0;
}

SHELL_STATIC_SUBCMD_SET_CREATE(
	simple_http_ota,
	SHELL_CMD(info, NULL, "Display board information", cmd_info),
	SHELL_CMD(run, NULL, "Start firmware update", cmd_run),
	SHELL_SUBCMD_SET_END);

SHELL_CMD_REGISTER(ota, &simple_http_ota, "Shell commands", NULL);
```

## src/simple_http_ota.c
```c
/*
 * Copyright (c) 2021 Espressif Systems (Shanghai) Co., Ltd.
 *
 * SPDX-License-Identifier: Apache-2.0
 */

#include <stdio.h>
#include <string.h>
#include <stdlib.h>
#include <zephyr.h>
#include <net/net_ip.h>
#include <net/socket.h>
#include <net/net_mgmt.h>
#include <drivers/flash.h>
#include <storage/flash_map.h>
#include <dfu/mcuboot.h>
#include <dfu/flash_img.h>
#include <net/http_client.h>
#include <net/http_parser_url.h>

#include <logging/log.h>
LOG_MODULE_REGISTER(simple_http_ota);

#define SLOT_SIZE FLASH_AREA_SIZE(image_1)
#define MAX_RECV_BUF_LEN 512

#define HTTP_TIMEOUT (CONFIG_SIMPLE_HTTP_OTA_DOWNLOAD_TIMEOUT * MSEC_PER_SEC)

/* Copy URL locally so we can parse it */
static char download_url[] = CONFIG_SIMPLE_HTTP_OTA_FILE_URL;

enum simple_http_ota_response {
	SIMPLE_HTTP_OTA_OK,
	SIMPLE_HTTP_OTA_ERROR,
};

static struct simple_http_ota_context {
	int sock;
	struct flash_img_context flash_ctx;
	uint8_t recv_buf[MAX_RECV_BUF_LEN];
	enum simple_http_ota_response status;
	size_t content_length;
} ota_context;

static int setup_socket(sa_family_t family, const char *server, int port,
			int *sock, struct sockaddr *addr, socklen_t addr_len)
{
	int ret = 0;

	memset(addr, 0, addr_len);

	if (family == AF_INET) {
		net_sin(addr)->sin_family = AF_INET;
		net_sin(addr)->sin_port = htons(port);
		inet_pton(family, server, &net_sin(addr)->sin_addr);
	}

	*sock = socket(family, SOCK_STREAM, IPPROTO_TCP);

	if (*sock < 0) {
		LOG_ERR("Failed to create HTTP socket (%d)", -errno);
	}

	return ret;
}

static int connect_socket(sa_family_t family, const char *server, int port,
			  int *sock, struct sockaddr *addr, socklen_t addr_len)
{
	int ret;

	ret = setup_socket(family, server, port, sock, addr, addr_len);
	if (ret < 0 || *sock < 0) {
		LOG_ERR("could create socket (%d)", ret);
		return -1;
	}

	ret = connect(*sock, addr, addr_len);
	if (ret < 0) {
		LOG_ERR("Cannot connect to remote (%d)", -errno);
		ret = -errno;
	}

	return ret;
}

static void response_cb(struct http_response *rsp,
			enum http_final_call final_data,
			void *user_data)
{
	static size_t body_len;
	uint8_t *body_data = NULL;
	int ret = 0;

	/* check if file exists and its size */
	if (rsp->http_status_code != 200) {
		ota_context.status = SIMPLE_HTTP_OTA_ERROR;
		LOG_ERR("Could not download file: HTTP error %d", rsp->http_status_code);
		return;
	}

	if (rsp->content_length > SLOT_SIZE) {
		ota_context.status = SIMPLE_HTTP_OTA_ERROR;
		LOG_ERR("File size too big (got %d, max is %d)",
				rsp->content_length, SLOT_SIZE);
		return;
	}

	if (ota_context.content_length == 0) {
		body_data = rsp->body_frag_start;
		body_len = rsp->data_len;
		body_len -= (rsp->body_frag_start - rsp->recv_buf);

		ota_context.content_length = rsp->content_length;
	} else {
		body_data = rsp->body_frag_start;
		body_len = rsp->data_len;
	}

	if ((rsp->body_found == 1) && (body_data == NULL)) {
		body_data = rsp->recv_buf;
		body_len = rsp->data_len;
	}

	if (body_data != NULL) {
		ret = flash_img_buffered_write(&ota_context.flash_ctx, body_data, body_len, false);
		if (ret < 0) {
			ota_context.status = SIMPLE_HTTP_OTA_ERROR;
			LOG_ERR("Flash write error %d", ret);
			return;
		}
	}
}

int simple_http_ota_run(void)
{
	struct sockaddr_in addr4;
	int ret = 0;
	char uri[64];
	char host[64];
	int port = 80;

	struct http_parser_url parser;
	uint16_t off, len;

	flash_img_init(&ota_context.flash_ctx);

	http_parser_url_init(&parser);
	ret = http_parser_parse_url(download_url, strlen(download_url), 0, &parser);
	if (ret < 0) {
		LOG_ERR("Invalid url: %s", download_url);
		return -ENOTSUP;
	}

	/* parse URL schema address */
	off = parser.field_data[UF_SCHEMA].off;
	len = parser.field_data[UF_SCHEMA].len;

	/* check for supported protocol */
	if (strncmp(download_url + off, "http://", len) != 0) {
		LOG_ERR("Only http URL is supported");
		return -EPROTONOSUPPORT;
	}

	/* parse host address */
	off = parser.field_data[UF_HOST].off;
	len = parser.field_data[UF_HOST].len;
	strncpy(host, download_url+off, len);
	host[len] = '\0';

	/* parse uri address */
	off = parser.field_data[UF_PATH].off;
	len = parser.field_data[UF_PATH].len;
	strncpy(uri, download_url+off, len);
	uri[len] = '\0';

	/* set custom port */
	if ((parser.field_set & (1 << UF_PORT))) {
		port = parser.port;
	}

	LOG_INF("URL: http://%s:%d%s", host, port, uri);

	connect_socket(AF_INET, host, port, &ota_context.sock,
					(struct sockaddr *)&addr4, sizeof(addr4));

	if (ota_context.sock < 0) {
		LOG_ERR("Cannot create HTTP connection.");
		return -ECONNABORTED;
	}

	if (ota_context.sock >= 0) {
		struct http_request req;

		memset(&req, 0, sizeof(req));

		req.method = HTTP_GET;
		req.url = uri;
		req.host = host;
		req.protocol = "HTTP/1.1";
		req.response = response_cb;
		req.recv_buf = ota_context.recv_buf;
		req.recv_buf_len = sizeof(ota_context.recv_buf);

		ota_context.content_length = 0;
		ota_context.status = SIMPLE_HTTP_OTA_OK;

		ret = http_client_req(ota_context.sock, &req, HTTP_TIMEOUT, NULL);
		if (ret < 0 || ota_context.status != SIMPLE_HTTP_OTA_OK) {
			LOG_ERR("Error downloading file ret = %d", ret);
		} else {
			/* finish image flashing in here */
			int ret = flash_img_buffered_write(&ota_context.flash_ctx, NULL, 0, true);

			if (ret < 0) {
				LOG_ERR("Flash write error %d", ret);
			}

			/* perform boot upgrade check */
			if (boot_request_upgrade(BOOT_UPGRADE_TEST) == 0) {
				LOG_INF("Update installed. Restart the board to complete.");
			} else {
				LOG_ERR("Update not installed. File is corrupted or invalid.");
			}
		}
	}

	if (ota_context.sock >= 0) {
		close(ota_context.sock);
	}

	return ret;
}

int simple_http_ota_init(void)
{
	bool image_ok = false;
	int ret = 0;

	image_ok = boot_is_img_confirmed();
	LOG_INF("Image is%s confirmed OK", image_ok ? "" : " not");
	if (!image_ok) {
		ret = boot_write_img_confirmed();
		if (ret < 0) {
			LOG_ERR("Couldn't confirm this image: %d", ret);
			return ret;
		}

		LOG_INF("Erasing bank in slot 1...");
		ret = boot_erase_img_bank(FLASH_AREA_ID(image_1));
		if (ret) {
			LOG_ERR("Failed to erase second slot");
			return ret;
		}
	}

	return ret;
}
```

## src/simple_http_ota.h
```c
/*
 * Copyright (c) 2021 Espressif Systems (Shanghai) Co., Ltd.
 *
 * SPDX-License-Identifier: Apache-2.0
 */

#ifndef __SIMPLE_HTTP_OTA_H__
#define __SIMPLE_HTTP_OTA_H__

#define SIMPLE_HTTP_OTA_MAJOR_VERSION 1
#define SIMPLE_HTTP_OTA_MINOR_VERSION 0

/**
 * @brief Init application
 *
 * Performs MCUBoot image check
 *
 * @return 0 on success
 * @return other error code returned by MCUBoot initialization
 */
int simple_http_ota_init(void);

/**
 * @brief Init over-the-air update
 *
 * This call starts http client to retrieve file information, performs
 * download and proper flashing into slot 1.
 *
 * @return 0 on success
 * @return other error code returned by HTTP and Flash API.
 */
int simple_http_ota_run(void);

#endif /* __SIMPLE_HTTP_OTA_H__ */
```
