## CMakeLists.txt
```
# SPDX-License-Identifier: Apache-2.0

cmake_minimum_required(VERSION 3.20.0)
find_package(Zephyr REQUIRED HINTS $ENV{ZEPHYR_BASE})
project(app_wifi_scenarios)

target_sources(app PRIVATE src/main.c)

set(ext_src ${PROJECT_SOURCE_DIR}/module/src/net_app.c)
set(bin ${PROJECT_BINARY_DIR}/llext/net_app.llext)
set(inc ${ZEPHYR_BINARY_DIR}/include/generated/net_app.inc)
set(sha ${ZEPHYR_BINARY_DIR}/include/generated/net_app.sha256.inc)

app_platform_add_module(net_ext OUTPUT ${bin} SOURCES ${ext_src})
llext_include_directories(net_ext ${ZEPHYR_BINARY_DIR}/include/generated)
generate_inc_file_for_target(app ${bin} ${inc})

add_custom_command(
  OUTPUT  ${sha}
  COMMAND ${CMAKE_COMMAND}
    -DMODULE_BIN=${bin}
    -DOUT_INC=${sha}
    -P ${CMAKE_CURRENT_SOURCE_DIR}/cmake/gen_sha256_inc.cmake
  DEPENDS ${bin}
)
add_custom_target(net_sha DEPENDS ${sha})
add_dependencies(app net_sha)
```

## prj.conf
```kconfig
CONFIG_APPLICATION_DEFINED_SYSCALL=y

CONFIG_APP_PLATFORM=y
CONFIG_APP_PLATFORM_MAX_APPS=4
CONFIG_APP_PLATFORM_LOADER=y
CONFIG_APP_PLATFORM_SERVICES=y
CONFIG_APP_PLATFORM_NET=y

# Wi-Fi for the network service (set to your 2.4GHz network).
CONFIG_APP_PLATFORM_NET_WIFI_SSID="CHANGE_ME_SSID"
CONFIG_APP_PLATFORM_NET_WIFI_PSK="CHANGE_ME_PSK"

CONFIG_TASK_WDT=y
CONFIG_TASK_WDT_CHANNELS=8

CONFIG_LLEXT=y
CONFIG_LLEXT_HEAP_SIZE=64
CONFIG_LLEXT_TYPE_ELF_RELOCATABLE=y
CONFIG_PSA_CRYPTO=y
CONFIG_MBEDTLS_ENABLE_HEAP=y
CONFIG_PSA_WANT_ALG_SHA_256=y


CONFIG_WIFI=y
CONFIG_WIFI_USAGE_MODE_STA=y
CONFIG_WIFI_STA_AUTO_DHCPV4=y

CONFIG_NETWORKING=y
CONFIG_NET_IPV4=y
CONFIG_NET_IPV6=n
CONFIG_NET_DHCPV4=y
CONFIG_NET_DHCPV4_OPTION_DNS_ADDRESS=y
CONFIG_NET_UDP=y
CONFIG_NET_TCP=y
CONFIG_NET_SOCKETS=y
CONFIG_DNS_RESOLVER=y
CONFIG_DNS_SERVER_IP_ADDRESSES=y
CONFIG_DNS_SERVER1="8.8.8.8"
CONFIG_NET_MAX_CONTEXTS=10

CONFIG_NET_MGMT=y
CONFIG_NET_MGMT_EVENT=y
CONFIG_NET_MGMT_EVENT_INFO=y
CONFIG_NET_MGMT_EVENT_STACK_SIZE=4096

CONFIG_MQTT_LIB=y

CONFIG_LOG=y
CONFIG_LOG_MODE_MINIMAL=y
CONFIG_NET_LOG=y
CONFIG_THREAD_NAME=y

CONFIG_MAIN_STACK_SIZE=6144
CONFIG_HEAP_MEM_POOL_SIZE=153600
```

## boards/esp32c5_devkitc_esp32c5_hpcore.conf
```kconfig
# The ESP32-C5 has 378 KB of internal SRAM: shrink the system heap and the
# loadable-extension heap (one module) so the image links.
CONFIG_HEAP_MEM_POOL_SIZE=40960
CONFIG_LLEXT_HEAP_SIZE=24
```

## src/main.c
```c
/*
 * Copyright (c) 2026 Espressif Systems (Shanghai) Co., Ltd.
 *
 * SPDX-License-Identifier: Apache-2.0
 */

/*
 * Wi-Fi scenarios the other samples do not cover: a TCP round trip over the
 * shared link, and losing the access point while an application is running.
 *
 * Everything runs inside the loadable application, because the services are
 * reachable only from an application thread that holds the capabilities; the
 * supervisor here just loads it. Power the access point off and on while the
 * application is watching to see the platform notice the loss and recover.
 */

#include <zephyr/app_platform/app_platform.h>
#include <zephyr/app_platform/app_loader.h>
#include <zephyr/app_platform/app_caps.h>
#include <zephyr/kernel.h>
#include <zephyr/sys/printk.h>

#define APP_CAPS (APP_CAP_LOG | APP_CAP_TIME | APP_CAP_NET | APP_CAP_SOCKET)

static const uint8_t net_app[] __aligned(8) = {
#include "net_app.inc"
};
static const uint8_t net_hash[32] = {
#include "net_app.sha256.inc"
};

int main(void)
{
	printk("\n*** Wi-Fi scenarios: link up, TCP round trip, AP loss ***\n");

	if (app_platform_init() != 0) {
		printk("platform init failed\n");
		return 0;
	}

	struct llext *ext = NULL;
	void *entry = NULL;
	int rc = app_loader_verify_load("netwatch", net_app, ARRAY_SIZE(net_app),
					net_hash, "app_main", &ext, &entry);

	if (rc != 0) {
		printk("verify/load failed (%d)\n", rc);
		return 0;
	}
	rc = app_platform_launch_llext("netwatch", ext, (app_entry_t)entry, NULL,
				       APP_CAPS);
	if (rc < 0) {
		printk("launch refused (%d)\n", rc);
		return 0;
	}
	printk("netwatch running as app %d\n", rc);
	return 0;
}
```
