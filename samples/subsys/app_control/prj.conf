## CMakeLists.txt
```
# SPDX-License-Identifier: Apache-2.0

cmake_minimum_required(VERSION 3.20.0)
find_package(Zephyr REQUIRED HINTS $ENV{ZEPHYR_BASE})
project(app_control)

zephyr_syscall_header(${CMAKE_CURRENT_SOURCE_DIR}/src/svc.h)

target_sources(app PRIVATE
  src/main.c
  src/svc.c
  src/apps.c
)
```

## prj.conf
```kconfig
CONFIG_APPLICATION_DEFINED_SYSCALL=y

CONFIG_APP_PLATFORM=y
CONFIG_APP_PLATFORM_MAX_APPS=4

CONFIG_TASK_WDT=y
CONFIG_TASK_WDT_CHANNELS=6

CONFIG_LOG=y
CONFIG_LOG_MODE_MINIMAL=y
CONFIG_THREAD_NAME=y

CONFIG_MAIN_STACK_SIZE=4096
CONFIG_HEAP_MEM_POOL_SIZE=8192
```

## src/main.c
```c
/*
 * Copyright (c) 2026 Espressif Systems (Shanghai) Co., Ltd.
 *
 * SPDX-License-Identifier: Apache-2.0
 */

/*
 * Runtime lifecycle control. A manager app - itself an isolated app, but holding
 * the control capability - starts and stops other apps while the system runs.
 * The platform is a controllable OS: launching and reclaiming apps is driven by
 * an app through brokered, capability-gated calls, not hardcoded at boot.
 */

#include "app_caps.h"

#include <zephyr/app_platform/app_platform.h>
#include <zephyr/kernel.h>
#include <zephyr/sys/printk.h>

extern void app_manager(void *arg);

int main(void)
{
	printk("\n*** app platform: runtime lifecycle control (C6) ***\n");

	if (app_platform_init() != 0) {
		printk("platform init failed\n");
		return 0;
	}

	/* The manager app holds the control capability; the workers do not. */
	const struct app_def manager = {
		.name = "manager", .source = APP_BUILTIN,
		.entry = app_manager, .caps = CAP_CONTROL,
	};
	app_platform_launch(&manager);

	k_msleep(5000);

	printk("\n*** done: an app started and stopped other apps at runtime ***\n");
	return 0;
}
```

## src/app_caps.h
```c
/*
 * Copyright (c) 2026 Espressif Systems (Shanghai) Co., Ltd.
 *
 * SPDX-License-Identifier: Apache-2.0
 */

#ifndef APP_CONTROL_APP_CAPS_H_
#define APP_CONTROL_APP_CAPS_H_

#include <zephyr/sys/util.h>

/* Application-defined capability: permission to manage other apps. */
#define CAP_CONTROL  BIT(0)

#endif /* APP_CONTROL_APP_CAPS_H_ */
```

## src/apps.c
```c
/*
 * Copyright (c) 2026 Espressif Systems (Shanghai) Co., Ltd.
 *
 * SPDX-License-Identifier: Apache-2.0
 */

/*
 * The manager app and the workers it controls. The manager is just another
 * isolated app, but it holds the control capability, so it can start and stop
 * workers at runtime through brokered service calls - a launcher built as an
 * app, not baked into the kernel.
 */

#include "svc.h"
#include "app_caps.h"

#include <zephyr/app_platform/app_platform.h>
#include <zephyr/kernel.h>
#include <string.h>

/* worker: a plain app that ticks until it is stopped. */
static void app_worker(void *arg)
{
	ARG_UNUSED(arg);

	app_log("worker: started");
	for (;;) {
		app_log("worker: tick");
		k_msleep(500);
	}
}

/* The workers the manager may start, resolved by name by the broker. */
static const struct app_def workers[] = {
	{ "worker-a", APP_BUILTIN, app_worker, 0 },
	{ "worker-b", APP_BUILTIN, app_worker, 0 },
};

const struct app_def *control_catalog_find(const char *name)
{
	for (size_t i = 0; i < ARRAY_SIZE(workers); i++) {
		if (strcmp(workers[i].name, name) == 0) {
			return &workers[i];
		}
	}
	return NULL;
}

/*
 * manager: starts two workers, lets them run, stops one, then the other. It is
 * an ordinary (unmonitored) app, so it sleeps freely between actions without
 * any heartbeat - the platform reclaims it only if it crashes or exits, not for
 * being busy or idle.
 */
void app_manager(void *arg)
{
	ARG_UNUSED(arg);

	app_log("manager: starting worker-a and worker-b");
	int a = svc_ctrl_start("worker-a");
	int b = svc_ctrl_start("worker-b");

	k_msleep(1500);

	app_log("manager: stopping worker-a");
	svc_ctrl_stop(a);

	k_msleep(1500);

	app_log("manager: stopping worker-b");
	svc_ctrl_stop(b);

	app_log("manager: done - managed the workers at runtime");
}
```

## src/svc.c
```c
/*
 * Copyright (c) 2026 Espressif Systems (Shanghai) Co., Ltd.
 *
 * SPDX-License-Identifier: Apache-2.0
 */

#include "svc.h"
#include "app_caps.h"

#include <zephyr/kernel.h>
#include <zephyr/sys/printk.h>
#include <zephyr/internal/syscall_handler.h>
#include <zephyr/app_platform/app_platform.h>
#include <string.h>
#include <errno.h>

/* The catalog of workers the manager app may start, resolved by name. */
extern const struct app_def *control_catalog_find(const char *name);

void z_impl_app_log(const char *msg)
{
	printk("    [app %d] %s\n", app_platform_id_current(), msg);
}

void z_impl_app_beat(void)
{
	app_platform_heartbeat();
}

int z_impl_svc_ctrl_start(const char *name)
{
	if ((app_platform_caps_current() & CAP_CONTROL) == 0U) {
		return -EPERM;
	}

	const struct app_def *def = control_catalog_find(name);

	if (def == NULL) {
		return -ENOENT;
	}
	return app_platform_launch(def);
}

int z_impl_svc_ctrl_stop(int id)
{
	if ((app_platform_caps_current() & CAP_CONTROL) == 0U) {
		return -EPERM;
	}
	return app_platform_stop(id);
}

#ifdef CONFIG_USERSPACE
static inline void z_vrfy_app_log(const char *msg)
{
	char buf[64];

	if (k_usermode_string_copy(buf, (char *)msg, sizeof(buf)) == 0) {
		z_impl_app_log(buf);
	}
}
#include <zephyr/syscalls/app_log_mrsh.c>

static inline void z_vrfy_app_beat(void)
{
	z_impl_app_beat();
}
#include <zephyr/syscalls/app_beat_mrsh.c>

static inline int z_vrfy_svc_ctrl_start(const char *name)
{
	char buf[16];

	if (k_usermode_string_copy(buf, (char *)name, sizeof(buf)) != 0) {
		return -EFAULT;
	}
	return z_impl_svc_ctrl_start(buf);
}
#include <zephyr/syscalls/svc_ctrl_start_mrsh.c>

static inline int z_vrfy_svc_ctrl_stop(int id)
{
	return z_impl_svc_ctrl_stop(id);
}
#include <zephyr/syscalls/svc_ctrl_stop_mrsh.c>
#endif
```

## src/svc.h
```c
/*
 * Copyright (c) 2026 Espressif Systems (Shanghai) Co., Ltd.
 *
 * SPDX-License-Identifier: Apache-2.0
 */

#ifndef APP_CONTROL_SVC_H_
#define APP_CONTROL_SVC_H_

#include <zephyr/kernel.h>

/*
 * Runtime lifecycle control: a privileged "manager" app drives the platform to
 * start and stop other apps while the system runs. The control operations are
 * brokered and gated by a control capability, so only a trusted app can manage
 * the others - an app store / launcher front-end built as just another app.
 *
 *   app_log        - log a line.
 *   svc_ctrl_start - start a worker by catalog name; returns its group id.
 *   svc_ctrl_stop  - stop a running group by id. Needs CAP_CONTROL.
 */

__syscall void app_log(const char *msg);
__syscall void app_beat(void);

/* Scoped (CAP_CONTROL): start a catalog worker by name. Returns group id. */
__syscall int svc_ctrl_start(const char *name);

/* Scoped (CAP_CONTROL): stop the running group @id. */
__syscall int svc_ctrl_stop(int id);

#include <zephyr/syscalls/svc.h>

#endif /* APP_CONTROL_SVC_H_ */
```
