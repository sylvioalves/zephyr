## CMakeLists.txt
```
# SPDX-License-Identifier: Apache-2.0

cmake_minimum_required(VERSION 3.20.0)
find_package(Zephyr REQUIRED HINTS $ENV{ZEPHYR_BASE})
project(llext_many)

target_sources(app PRIVATE
  src/main.c
)

set(ext_src ${PROJECT_SOURCE_DIR}/module/src/hello_loop.c)
set(bin ${PROJECT_BINARY_DIR}/llext/hello.llext)
set(inc ${ZEPHYR_BINARY_DIR}/include/generated/hello.inc)
set(sha ${ZEPHYR_BINARY_DIR}/include/generated/hello.sha256.inc)

app_platform_add_module(hello_ext OUTPUT ${bin} SOURCES ${ext_src})
llext_include_directories(hello_ext ${ZEPHYR_BINARY_DIR}/include/generated)
generate_inc_file_for_target(app ${bin} ${inc})

add_custom_command(
  OUTPUT  ${sha}
  COMMAND ${CMAKE_COMMAND}
    -DMODULE_BIN=${bin}
    -DOUT_INC=${sha}
    -P ${CMAKE_CURRENT_SOURCE_DIR}/cmake/gen_sha256_inc.cmake
  DEPENDS ${bin}
)
add_custom_target(hello_sha DEPENDS ${sha})
add_dependencies(app hello_sha)
```

## prj.conf
```kconfig
CONFIG_APPLICATION_DEFINED_SYSCALL=y

CONFIG_APP_PLATFORM=y
# Number of parallel loadable apps. Raise this to launch more (and bump
# CONFIG_MAX_THREAD_BYTES with it). With the loadable-extension heap placed in
# external RAM (see below) the limit becomes the per-app thread stacks in
# internal SRAM, not the loaded module images.
CONFIG_APP_PLATFORM_MAX_APPS=16
CONFIG_APP_PLATFORM_LOADER=y
CONFIG_APP_PLATFORM_SERVICES=y

CONFIG_TASK_WDT=y
CONFIG_TASK_WDT_CHANNELS=60
CONFIG_TASK_WDT_HW_FALLBACK=n

# Use a runtime llext heap so the sample can place it in external RAM (PSRAM)
# instead of reserving a fixed block of internal SRAM.
CONFIG_LLEXT=y
CONFIG_LLEXT_HEAP_DYNAMIC=y
CONFIG_LLEXT_TYPE_ELF_RELOCATABLE=y

# External RAM (PSRAM) holds the loadable-extension heap.
CONFIG_ESP_SPIRAM=y
CONFIG_ESP_SPIRAM_SIZE=8388608
CONFIG_SHARED_MULTI_HEAP=y

CONFIG_PSA_CRYPTO=y
CONFIG_MBEDTLS_ENABLE_HEAP=y
CONFIG_PSA_WANT_ALG_SHA_256=y

CONFIG_ENTROPY_GENERATOR=y

CONFIG_LOG=y
CONFIG_LOG_MODE_MINIMAL=y
CONFIG_THREAD_NAME=y

CONFIG_MAIN_STACK_SIZE=4096
CONFIG_HEAP_MEM_POOL_SIZE=32768
```

## src/main.c
```c
/*
 * Copyright (c) 2026 Espressif Systems (Shanghai) Co., Ltd.
 *
 * SPDX-License-Identifier: Apache-2.0
 */

/*
 * Launch as many parallel loadable applications as the platform allows. Each
 * is an independent instance of the same verified llext module, loaded and run
 * as an isolated user-mode app that loops with a one-second period. The number
 * of instances is CONFIG_APP_PLATFORM_MAX_APPS; this sample reports how many
 * actually started so the concurrent-app ceiling can be measured.
 */

#include <zephyr/app_platform/app_platform.h>
#include <zephyr/app_platform/app_loader.h>
#include <zephyr/app_platform/app_caps.h>
#include <zephyr/kernel.h>
#include <zephyr/sys/printk.h>
#include <zephyr/llext/llext.h>
#include <zephyr/multi_heap/shared_multi_heap.h>

static const uint8_t hello_app[] __aligned(8) = {
#include "hello.inc"
};
static const uint8_t hello_hash[32] = {
#include "hello.sha256.inc"
};

#define APP_CAPS (APP_CAP_LOG | APP_CAP_TIME)
#define N_APPS   CONFIG_APP_PLATFORM_MAX_APPS

/*
 * Size of the loadable-extension heap to carve from external RAM. Holding the
 * loaded modules' code and data here keeps them out of the limited internal
 * SRAM, so many more apps fit. Only the modules live in PSRAM; their thread
 * stacks stay in internal SRAM, where the trap path needs them.
 */
#define LLEXT_PSRAM_HEAP (512 * 1024)

int main(void)
{
	printk("\n*** many parallel loadable apps (C5) ***\n");

#ifdef CONFIG_LLEXT_HEAP_DYNAMIC
	void *heap = shared_multi_heap_aligned_alloc(SMH_REG_ATTR_EXTERNAL, 64,
						     LLEXT_PSRAM_HEAP);

	if (heap == NULL || llext_heap_init(heap, LLEXT_PSRAM_HEAP) != 0) {
		printk("llext PSRAM heap init failed\n");
		return 0;
	}
	printk("llext heap: %u KB in external RAM at %p\n",
	       LLEXT_PSRAM_HEAP / 1024, heap);
#endif

	if (app_platform_init() != 0) {
		printk("platform init failed\n");
		return 0;
	}

	int launched = 0;

	for (int i = 0; i < N_APPS; i++) {
		char name[12];

		name[0] = 'a'; name[1] = 'p'; name[2] = 'p';
		name[3] = '0' + (i / 10);
		name[4] = '0' + (i % 10);
		name[5] = '\0';

		struct llext *ext = NULL;
		void *entry = NULL;
		int rc = app_loader_verify_load(name, hello_app,
						ARRAY_SIZE(hello_app), hello_hash,
						"app_main", &ext, &entry);

		if (rc != 0) {
			printk("load #%d failed: %d\n", i, rc);
			break;
		}

		rc = app_platform_launch_llext(name, ext, (app_entry_t)entry, NULL,
					       APP_CAPS);
		if (rc < 0) {
			printk("launch #%d failed: %d\n", i, rc);
			break;
		}
		launched++;
	}

	printk("*** launched %d / %d parallel loadable apps ***\n", launched,
	       N_APPS);

	k_msleep(8000);

	printk("*** %d apps alive after 8 s ***\n", launched);
	return 0;
}
```
