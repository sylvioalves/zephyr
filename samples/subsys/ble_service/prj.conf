## CMakeLists.txt
```
# SPDX-License-Identifier: Apache-2.0

cmake_minimum_required(VERSION 3.20.0)
find_package(Zephyr REQUIRED HINTS $ENV{ZEPHYR_BASE})
project(ble_service)

zephyr_syscall_header(${CMAKE_CURRENT_SOURCE_DIR}/src/ble_svc.h)

target_sources(app PRIVATE
  src/main.c
  src/ble_broker.c
  src/ble_svc.c
)
```

## prj.conf
```kconfig
CONFIG_USERSPACE=y
CONFIG_APPLICATION_DEFINED_SYSCALL=y

CONFIG_BT=y
CONFIG_BT_OBSERVER=y

CONFIG_LOG=y
CONFIG_LOG_MODE_MINIMAL=y
CONFIG_THREAD_NAME=y

CONFIG_MAIN_STACK_SIZE=4096
CONFIG_HEAP_MEM_POOL_SIZE=32768
```

## src/main.c
```c
/*
 * Copyright (c) 2026 Espressif Systems (Shanghai) Co., Ltd.
 *
 * SPDX-License-Identifier: Apache-2.0
 */

/*
 * BLE scan service: the broker owns the single controller and runs one shared
 * scan; discovered devices are fanned out to every app. Two isolated user-mode
 * apps both "scan" in parallel - each receives the same stream of devices on its
 * own event queue - exactly how a phone delivers one radio scan to many apps.
 */

#include "ble_svc.h"
#include "ble_broker.h"

#include <zephyr/kernel.h>
#include <zephyr/sys/printk.h>

#define STACK_SIZE 2048
#define APP_PRIO   5
#define QDEPTH     8

K_THREAD_STACK_DEFINE(stack_a, STACK_SIZE);
K_THREAD_STACK_DEFINE(stack_b, STACK_SIZE);
static struct k_thread th_a, th_b;

/* One event queue per app (the async-event channel into each isolated app). */
K_MSGQ_DEFINE(q_a, sizeof(struct ble_scan_event), QDEPTH, 4);
K_MSGQ_DEFINE(q_b, sizeof(struct ble_scan_event), QDEPTH, 4);

/* A BLE app: subscribe to the scan service, then consume devices in user mode. */
static void scanner_app(void *name_p, void *p2, void *p3)
{
	ARG_UNUSED(p2); ARG_UNUSED(p3);
	const char *name = name_p;

	int sub = svc_ble_scan_start();

	printk("  [%s] subscribed to BLE scan (sub %d)\n", name, sub);

	int seen = 0;

	for (;;) {
		struct ble_scan_event ev;
		int rc = svc_ble_next_device(&ev, 3000);

		if (rc == 0) {
			printk("  [%s] device %s rssi %d type %u adlen %u (#%d)\n",
			       name, ev.addr, ev.rssi, ev.adv_type, ev.ad_len,
			       ++seen);
		} else {
			printk("  [%s] (no device in 3s)\n", name);
		}
	}
}

int main(void)
{
	printk("\n*** BLE scan service: one radio, two apps scanning in parallel (C6) ***\n");

	if (ble_broker_init() != 0) {
		printk("ble_broker_init failed\n");
		return 0;
	}

	k_tid_t ta = k_thread_create(&th_a, stack_a, STACK_SIZE, scanner_app,
				     "app-A", NULL, NULL, APP_PRIO, K_USER,
				     K_FOREVER);
	k_tid_t tb = k_thread_create(&th_b, stack_b, STACK_SIZE, scanner_app,
				     "app-B", NULL, NULL, APP_PRIO, K_USER,
				     K_FOREVER);

	/* Grant each app its own event queue and register it with the broker. */
	k_thread_access_grant(ta, &q_a);
	k_thread_access_grant(tb, &q_b);
	ble_svc_register(ta, &q_a);
	ble_svc_register(tb, &q_b);

	k_thread_start(ta);
	k_thread_start(tb);
	return 0;
}
```

## src/ble_broker.c
```c
/*
 * Copyright (c) 2026 Espressif Systems (Shanghai) Co., Ltd.
 *
 * SPDX-License-Identifier: Apache-2.0
 */

#include "ble_broker.h"

#include <zephyr/kernel.h>
#include <zephyr/sys/printk.h>
#include <zephyr/bluetooth/bluetooth.h>
#include <zephyr/bluetooth/addr.h>

/* Per-app subscriber: an event queue the app drains. */
static struct k_msgq *subscribers[BLE_MAX_APPS];
static int subscriber_count;
static bool scanning;
static struct k_mutex lock;

/*
 * The single scan callback. One radio scans once; each discovered device is
 * copied into every subscriber's queue (drop if full - apps that fall behind
 * just miss events, they are never blocked on). This is the fan-out that lets
 * many isolated apps "all scan" through one controller.
 */
static void device_found(const bt_addr_le_t *addr, int8_t rssi, uint8_t type,
			 struct net_buf_simple *ad)
{
	struct ble_scan_event ev = {
		.rssi = rssi,
		.adv_type = type,
		.ad_len = ad ? ad->len : 0,
	};

	bt_addr_le_to_str(addr, ev.addr, sizeof(ev.addr));

	k_mutex_lock(&lock, K_FOREVER);
	for (int i = 0; i < BLE_MAX_APPS; i++) {
		if (subscribers[i] != NULL) {
			(void)k_msgq_put(subscribers[i], &ev, K_NO_WAIT);
		}
	}
	k_mutex_unlock(&lock);
}

static int scan_start(void)
{
	struct bt_le_scan_param param = {
		.type    = BT_LE_SCAN_TYPE_ACTIVE,
		.options = BT_LE_SCAN_OPT_FILTER_DUPLICATE,
		.interval = BT_GAP_SCAN_FAST_INTERVAL_MIN,
		.window  = BT_GAP_SCAN_FAST_WINDOW,
	};

	return bt_le_scan_start(&param, device_found);
}

int ble_broker_init(void)
{
	k_mutex_init(&lock);

	int err = bt_enable(NULL);

	if (err) {
		printk("ble-broker: bt_enable failed: %d\n", err);
		return err;
	}
	printk("ble-broker: Bluetooth ready, broker owns the controller\n");
	return 0;
}

int ble_broker_subscribe(struct k_msgq *out_q)
{
	int id = -ENOSPC;

	k_mutex_lock(&lock, K_FOREVER);
	for (int i = 0; i < BLE_MAX_APPS; i++) {
		if (subscribers[i] == NULL) {
			subscribers[i] = out_q;
			subscriber_count++;
			id = i;
			break;
		}
	}

	if (id >= 0 && !scanning) {
		if (scan_start() == 0) {
			scanning = true;
			printk("ble-broker: shared scan started\n");
		}
	}
	k_mutex_unlock(&lock);
	return id;
}

void ble_broker_unsubscribe(int sub_id)
{
	if (sub_id < 0 || sub_id >= BLE_MAX_APPS) {
		return;
	}

	k_mutex_lock(&lock, K_FOREVER);
	if (subscribers[sub_id] != NULL) {
		subscribers[sub_id] = NULL;
		subscriber_count--;
	}
	if (subscriber_count == 0 && scanning) {
		bt_le_scan_stop();
		scanning = false;
	}
	k_mutex_unlock(&lock);
}
```

## src/ble_broker.h
```c
/*
 * Copyright (c) 2026 Espressif Systems (Shanghai) Co., Ltd.
 *
 * SPDX-License-Identifier: Apache-2.0
 */

#ifndef BLE_SERVICE_BLE_BROKER_H_
#define BLE_SERVICE_BLE_BROKER_H_

#include <zephyr/kernel.h>

/*
 * BLE scan service - the daemon model, like bluetoothd or Android's Bluetooth
 * service. The broker owns the single controller and runs ONE scan; every
 * discovered device is fanned out to each subscribed app. Apps never touch the
 * controller or HCI; they receive scan events asynchronously through a per-app
 * event queue, which is how BLE's unsolicited events cross into isolated apps.
 *
 * This is the async-event seam the higher BLE tiers (GATT client notifications,
 * server requests) build on.
 */

#define BLE_MAX_APPS    4
#define BLE_ADDR_STRLEN 30

/* One scan event delivered to an app. */
struct ble_scan_event {
	char    addr[BLE_ADDR_STRLEN];
	int8_t  rssi;
	uint8_t adv_type;
	uint8_t ad_len;
};

/* Initialize Bluetooth and the broker. Call once at startup. */
int ble_broker_init(void);

/*
 * Subscribe the calling context to scan events; returns a subscriber id (>=0)
 * or negative on error. Starts the shared scan on the first subscriber.
 */
int ble_broker_subscribe(struct k_msgq *out_q);

/* Stop scanning if no subscribers remain. */
void ble_broker_unsubscribe(int sub_id);

#endif /* BLE_SERVICE_BLE_BROKER_H_ */
```

## src/ble_svc.c
```c
/*
 * Copyright (c) 2026 Espressif Systems (Shanghai) Co., Ltd.
 *
 * SPDX-License-Identifier: Apache-2.0
 */

#include "ble_svc.h"
#include "ble_broker.h"

#include <zephyr/kernel.h>
#include <zephyr/internal/syscall_handler.h>

/*
 * Per-app event-queue registry. The supervisor registers each app's thread and
 * its granted message queue before starting it; the broker syscalls resolve the
 * calling thread back to its queue, so the app never passes a kernel pointer.
 */
struct ble_app_reg {
	k_tid_t        tid;
	struct k_msgq *q;
	int            sub_id;
};

static struct ble_app_reg regs[BLE_MAX_APPS];

void ble_svc_register(k_tid_t tid, struct k_msgq *q)
{
	for (int i = 0; i < BLE_MAX_APPS; i++) {
		if (regs[i].tid == NULL) {
			regs[i].tid = tid;
			regs[i].q = q;
			regs[i].sub_id = -1;
			return;
		}
	}
}

static struct ble_app_reg *reg_of_current(void)
{
	k_tid_t cur = k_current_get();

	for (int i = 0; i < BLE_MAX_APPS; i++) {
		if (regs[i].tid == cur) {
			return &regs[i];
		}
	}
	return NULL;
}

int z_impl_svc_ble_scan_start(void)
{
	struct ble_app_reg *r = reg_of_current();

	if (r == NULL) {
		return -EPERM;
	}
	if (r->sub_id < 0) {
		r->sub_id = ble_broker_subscribe(r->q);
	}
	return r->sub_id;
}

int z_impl_svc_ble_next_device(struct ble_scan_event *out, int32_t timeout_ms)
{
	struct ble_app_reg *r = reg_of_current();

	if (r == NULL || r->q == NULL) {
		return -EPERM;
	}
	if (k_msgq_get(r->q, out, K_MSEC(timeout_ms)) != 0) {
		return -EAGAIN;
	}
	return 0;
}

#ifdef CONFIG_USERSPACE

static inline int z_vrfy_svc_ble_scan_start(void)
{
	return z_impl_svc_ble_scan_start();
}
#include <zephyr/syscalls/svc_ble_scan_start_mrsh.c>

static inline int z_vrfy_svc_ble_next_device(struct ble_scan_event *out,
					     int32_t timeout_ms)
{
	K_OOPS(K_SYSCALL_MEMORY_WRITE(out, sizeof(*out)));
	return z_impl_svc_ble_next_device(out, timeout_ms);
}
#include <zephyr/syscalls/svc_ble_next_device_mrsh.c>

#endif /* CONFIG_USERSPACE */
```

## src/ble_svc.h
```c
/*
 * Copyright (c) 2026 Espressif Systems (Shanghai) Co., Ltd.
 *
 * SPDX-License-Identifier: Apache-2.0
 */

#ifndef BLE_SERVICE_BLE_SVC_H_
#define BLE_SERVICE_BLE_SVC_H_

#include <zephyr/kernel.h>
#include "ble_broker.h"

/*
 * Broker syscalls a user-mode app uses to consume the BLE scan service. The app
 * subscribes once, then pulls scan events from its own queue. The events are
 * pushed by the broker (in supervisor context) as devices are discovered - the
 * async-event seam that brings BLE's unsolicited events into an isolated app.
 */

/* Supervisor-side: register an app thread and its granted event queue. */
void ble_svc_register(k_tid_t tid, struct k_msgq *q);

/* Subscribe the calling app to BLE scan events. Returns a sub id or negative. */
__syscall int svc_ble_scan_start(void);

/*
 * Wait up to @p timeout_ms for the next scan event into @p out. Returns 0 on an
 * event, -EAGAIN on timeout. Read-only consumption: many apps do this in
 * parallel, each draining its own queue.
 */
__syscall int svc_ble_next_device(struct ble_scan_event *out, int32_t timeout_ms);

#include <zephyr/syscalls/ble_svc.h>

#endif /* BLE_SERVICE_BLE_SVC_H_ */
```
