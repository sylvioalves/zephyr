## CMakeLists.txt
```
# SPDX-License-Identifier: Apache-2.0

cmake_minimum_required(VERSION 3.20.0)
find_package(Zephyr REQUIRED HINTS $ENV{ZEPHYR_BASE})
project(app_caps)

zephyr_syscall_header(${CMAKE_CURRENT_SOURCE_DIR}/src/cap.h)

target_sources(app PRIVATE src/main.c src/cap.c)
```

## prj.conf
```kconfig
# USERSPACE is enabled on targets that support it (e.g. esp32c6 via PMP) through
# a board overlay; on native_sim the capability logic runs with plain threads.
CONFIG_APPLICATION_DEFINED_SYSCALL=y

CONFIG_ENTROPY_GENERATOR=y
CONFIG_TEST_RANDOM_GENERATOR=y

CONFIG_LOG=y
CONFIG_LOG_MODE_MINIMAL=y
CONFIG_THREAD_NAME=y

CONFIG_MAX_DOMAIN_PARTITIONS=8
CONFIG_MAIN_STACK_SIZE=4096
```

## boards/esp32c5_devkitc_esp32c5_hpcore.conf
```kconfig
# Copyright (c) 2026 Espressif Systems (Shanghai) Co., Ltd.
# SPDX-License-Identifier: Apache-2.0
CONFIG_USERSPACE=y
```

## src/main.c
```c
/*
 * Copyright (c) 2026 Espressif Systems (Shanghai) Co., Ltd.
 *
 * SPDX-License-Identifier: Apache-2.0
 */

/*
 * Capability layer demo. Apps hold unforgeable capability tokens. This shows
 * the four properties that make it a capability system rather than an access
 * list: a holder may use its capability; a forged token is rejected; the holder
 * may delegate the capability to another app (which then gains it and the
 * sender loses it); and revocation kills every token for the resource.
 *
 * The two app threads step through the flow under supervisor coordination so
 * the cause and effect of each property is visible in order.
 */

#include "cap.h"

#include <zephyr/kernel.h>
#include <zephyr/sys/printk.h>
#if defined(CONFIG_USERSPACE)
#include <zephyr/app_memory/app_memdomain.h>
#endif

#define STACK_SIZE 2048
#define APP_PRIO   5

/*
 * Apps run in user mode where the target supports it (e.g. RISC-V PMP on C6),
 * proving the capability syscalls cross the privilege boundary safely. On
 * targets without userspace (e.g. native_sim), the same capability LOGIC -
 * unforgeable tokens, delegation, revocation - runs with plain threads; the
 * security mechanism is identical, only the isolation boundary differs.
 */
#if defined(CONFIG_USERSPACE)
#define APP_OPTS (K_USER)
K_APPMEM_PARTITION_DEFINE(cap_part);
static struct k_mem_domain cap_domain;
static cap_t K_APP_DMEM(cap_part) the_cap;
static k_tid_t K_APP_DMEM(cap_part) tid_b;
#else
#define APP_OPTS (0)
static cap_t the_cap;
static k_tid_t tid_b;
#endif

K_THREAD_STACK_DEFINE(stack_a, STACK_SIZE);
K_THREAD_STACK_DEFINE(stack_b, STACK_SIZE);
static struct k_thread th_a, th_b;

/* Step gates, given by the supervisor to sequence the demo. */
static K_SEM_DEFINE(go_a_use,      0, 1);
static K_SEM_DEFINE(done_a_use,    0, 1);
static K_SEM_DEFINE(go_a_delegate, 0, 1);
static K_SEM_DEFINE(done_a_deleg,  0, 1);
static K_SEM_DEFINE(go_b_use,      0, 1);
static K_SEM_DEFINE(done_b_use,    0, 1);
static K_SEM_DEFINE(go_b_again,    0, 1);
static K_SEM_DEFINE(done_b_again,  0, 1);

static void app_a(void *p1, void *p2, void *p3)
{
	ARG_UNUSED(p1); ARG_UNUSED(p2); ARG_UNUSED(p3);

	k_sem_take(&go_a_use, K_FOREVER);
	printk("\n[A] (1) use my capability:\n");
	cap_invoke(the_cap);
	printk("[A] (2) try to FORGE a token (made-up slot+nonce):\n");
	cap_invoke(0x0000000512345678ULL);
	k_sem_give(&done_a_use);

	k_sem_take(&go_a_delegate, K_FOREVER);
	printk("\n[A] (3) delegate my capability to app B:\n");
	cap_delegate(the_cap, tid_b);
	printk("[A] (4) try to use it AFTER delegating it away:\n");
	cap_invoke(the_cap);   /* A is no longer the holder -> denied */
	k_sem_give(&done_a_deleg);
}

static void app_b(void *p1, void *p2, void *p3)
{
	ARG_UNUSED(p1); ARG_UNUSED(p2); ARG_UNUSED(p3);

	k_sem_take(&go_b_use, K_FOREVER);
	printk("\n[B] (5) use the capability delegated to me:\n");
	cap_invoke(the_cap);
	k_sem_give(&done_b_use);

	k_sem_take(&go_b_again, K_FOREVER);
	printk("\n[B] (7) try to use it AFTER revocation:\n");
	cap_invoke(the_cap);   /* revoked -> denied */
	k_sem_give(&done_b_again);
}

int main(void)
{
	printk("\n*** capability layer: unforgeable, delegatable, revocable ***\n");

	k_tid_t ta = k_thread_create(&th_a, stack_a, STACK_SIZE, app_a,
				     NULL, NULL, NULL, APP_PRIO, APP_OPTS, K_FOREVER);
	k_tid_t tb = k_thread_create(&th_b, stack_b, STACK_SIZE, app_b,
				     NULL, NULL, NULL, APP_PRIO, APP_OPTS, K_FOREVER);
	tid_b = tb;

#if defined(CONFIG_USERSPACE)
	struct k_mem_partition *parts[] = { &cap_part };

	k_mem_domain_init(&cap_domain, 1, parts);
	k_mem_domain_add_thread(&cap_domain, ta);
	k_mem_domain_add_thread(&cap_domain, tb);
	k_thread_access_grant(ta, &go_a_use, &done_a_use, &go_a_delegate,
			      &done_a_deleg);
	k_thread_access_grant(tb, &go_b_use, &done_b_use, &go_b_again,
			      &done_b_again);
#endif

	/* Mint a capability owned by A. */
	the_cap = cap_mint(CAP_RES_SENSOR, ta);

	k_thread_start(ta);
	k_thread_start(tb);

	/* Drive the sequence. */
	k_sem_give(&go_a_use);      k_sem_take(&done_a_use, K_FOREVER);
	k_sem_give(&go_a_delegate); k_sem_take(&done_a_deleg, K_FOREVER);
	k_sem_give(&go_b_use);      k_sem_take(&done_b_use, K_FOREVER);

	printk("\n[sys] (6) revoke the capability:\n");
	cap_revoke(the_cap);

	k_sem_give(&go_b_again);    k_sem_take(&done_b_again, K_FOREVER);

	printk("\n*** done: used / forge-blocked / delegated / holder-checked / revoked ***\n");
	return 0;
}
```

## src/cap.c
```c
/*
 * Copyright (c) 2026 Espressif Systems (Shanghai) Co., Ltd.
 *
 * SPDX-License-Identifier: Apache-2.0
 */

#include "cap.h"

#include <zephyr/kernel.h>
#include <zephyr/sys/printk.h>
#include <zephyr/random/random.h>
#include <zephyr/internal/syscall_handler.h>

#define CAP_SLOTS 16

/* The kernel-held capability table - the single source of truth. */
struct cap_slot {
	bool              valid;
	enum cap_resource res;
	k_tid_t           holder;
	uint32_t          nonce;   /* kernel-random; the app never sees the table */
};

static struct cap_slot table[CAP_SLOTS];

static inline cap_t make_token(uint32_t slot, uint32_t nonce)
{
	return ((uint64_t)slot << 32) | nonce;
}

static inline uint32_t token_slot(cap_t t)
{
	return (uint32_t)(t >> 32);
}

static inline uint32_t token_nonce(cap_t t)
{
	return (uint32_t)(t & 0xFFFFFFFF);
}

cap_t cap_mint(enum cap_resource res, k_tid_t holder)
{
	for (uint32_t i = 0; i < CAP_SLOTS; i++) {
		if (!table[i].valid) {
			uint32_t nonce;

			sys_rand_get(&nonce, sizeof(nonce));
			if (nonce == 0) {
				nonce = 1;   /* never zero */
			}
			table[i].valid = true;
			table[i].res = res;
			table[i].holder = holder;
			table[i].nonce = nonce;
			return make_token(i, nonce);
		}
	}
	return CAP_NULL;
}

/* Validate a token: in-range, valid, nonce matches, caller is holder. */
static struct cap_slot *resolve(cap_t token, k_tid_t caller, const char **why)
{
	uint32_t slot = token_slot(token);

	if (slot >= CAP_SLOTS) {
		*why = "bad slot";
		return NULL;
	}
	struct cap_slot *s = &table[slot];

	if (!s->valid) {
		*why = "revoked";
		return NULL;
	}
	if (s->nonce != token_nonce(token)) {
		*why = "forged (nonce mismatch)";
		return NULL;
	}
	if (s->holder != caller) {
		*why = "not the holder";
		return NULL;
	}
	return s;
}

int z_impl_cap_invoke(cap_t token)
{
	const char *why = "";
	struct cap_slot *s = resolve(token, k_current_get(), &why);

	if (s == NULL) {
		printk("    [cap] invoke DENIED: %s\n", why);
		return -EPERM;
	}
	printk("    [cap] invoke OK: resource %d used\n", s->res);
	return (int)s->res;
}

int z_impl_cap_delegate(cap_t token, k_tid_t target)
{
	const char *why = "";
	struct cap_slot *s = resolve(token, k_current_get(), &why);

	if (s == NULL) {
		printk("    [cap] delegate DENIED: %s\n", why);
		return -EPERM;
	}
	/* Move ownership: the receiver gains it, the sender loses it. */
	s->holder = target;
	printk("    [cap] delegated resource %d to thread %p\n", s->res,
	       (void *)target);
	return 0;
}

void cap_revoke(cap_t token)
{
	uint32_t slot = token_slot(token);

	if (slot < CAP_SLOTS && table[slot].valid &&
	    table[slot].nonce == token_nonce(token)) {
		table[slot].valid = false;
		table[slot].nonce = 0;
		printk("    [cap] revoked resource %d (all tokens now dead)\n",
		       table[slot].res);
	}
}

#ifdef CONFIG_USERSPACE
static inline int z_vrfy_cap_invoke(cap_t token)
{
	return z_impl_cap_invoke(token);
}
#include <zephyr/syscalls/cap_invoke_mrsh.c>

static inline int z_vrfy_cap_delegate(cap_t token, k_tid_t target)
{
	/* target is an opaque thread handle; the impl validates the caller is
	 * the holder, so a forged target only hands a cap the caller already
	 * owns to some thread - no escalation.
	 */
	return z_impl_cap_delegate(token, target);
}
#include <zephyr/syscalls/cap_delegate_mrsh.c>
#endif
```

## src/cap.h
```c
/*
 * Copyright (c) 2026 Espressif Systems (Shanghai) Co., Ltd.
 *
 * SPDX-License-Identifier: Apache-2.0
 */

#ifndef APP_CAPS_CAP_H_
#define APP_CAPS_CAP_H_

#include <zephyr/kernel.h>

/*
 * A capability layer for Zephyr - unforgeable, transferable, revocable tokens,
 * in the spirit of seL4/object-capability systems, replacing the access-control
 * list keyed by thread id.
 *
 * A capability token is a 64-bit opaque value: (slot << 32) | nonce. The kernel
 * holds the truth in a table; the app holds only the token. Three properties:
 *
 *   - UNFORGEABLE: the nonce is kernel-generated random. An app cannot fabricate
 *     a valid token because it cannot guess the nonce stored for a slot.
 *   - TRANSFERABLE: the holder may delegate a capability to another app; the
 *     kernel moves ownership, so the receiver gains it and the sender keeps it
 *     or not per the delegation. Here delegation MOVES the holder.
 *   - REVOCABLE: revoking clears the slot; every token referencing it dies.
 *
 * Invoking a capability checks: slot valid, nonce matches, and the caller is the
 * current holder. Any of forge / use-after-revoke / use-by-non-holder fails.
 */

typedef uint64_t cap_t;
#define CAP_NULL 0ULL

/* Resource a capability grants (toy resources for the demo). */
enum cap_resource {
	CAP_RES_SENSOR = 1,
	CAP_RES_LED,
	CAP_RES_STORAGE,
};

/* Supervisor: mint a capability for a resource, owned by @holder. */
cap_t cap_mint(enum cap_resource res, k_tid_t holder);

/* Invoke the capability (use the resource). Returns the resource id on success,
 * negative on any failure (forged, revoked, wrong holder).
 */
__syscall int cap_invoke(cap_t token);

/* Delegate: the calling holder transfers the capability to another thread. */
__syscall int cap_delegate(cap_t token, k_tid_t target);

/* Supervisor: revoke a capability; all tokens for it become dead. */
void cap_revoke(cap_t token);

#include <zephyr/syscalls/cap.h>

#endif /* APP_CAPS_CAP_H_ */
```
