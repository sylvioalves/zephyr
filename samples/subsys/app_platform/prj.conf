## CMakeLists.txt
```
# SPDX-License-Identifier: Apache-2.0

cmake_minimum_required(VERSION 3.20.0)
find_package(Zephyr REQUIRED HINTS $ENV{ZEPHYR_BASE})
project(app_platform)

zephyr_syscall_header(${CMAKE_CURRENT_SOURCE_DIR}/src/app_sdk.h)

target_sources(app PRIVATE
  src/main.c
  src/platform.c
  src/app_rt.c
)
```

## prj.conf
```kconfig
CONFIG_USERSPACE=y
CONFIG_APPLICATION_DEFINED_SYSCALL=y

CONFIG_SENSOR=y

CONFIG_LOG=y
CONFIG_LOG_MODE_MINIMAL=y
CONFIG_THREAD_NAME=y

CONFIG_MAX_DOMAIN_PARTITIONS=8
CONFIG_MAIN_STACK_SIZE=4096
```

## boards/qemu_riscv32.overlay
```dts
/*
 * Copyright (c) 2026 Espressif Systems (Shanghai) Co., Ltd.
 *
 * SPDX-License-Identifier: Apache-2.0
 */

/* QEMU has no die temperature sensor: stand in an emulated one. */
/ {
	die_temp: die_temp {
		compatible = "zephyr,generic-emul-sensor";
		status = "okay";
	};

	aliases {
		die-temp0 = &die_temp;
	};
};
```

## src/main.c
```c
/*
 * Copyright (c) 2026 Espressif Systems (Shanghai) Co., Ltd.
 *
 * SPDX-License-Identifier: Apache-2.0
 */

/*
 * The consolidated platform: one SDK, one service registry, three capability
 * tiers, and the multi-threaded app model - all behind a single header. A
 * multi-threaded app discovers what the platform offers, then exercises an open
 * service (sensor), a scoped service (i2c, granted one address), and an admin
 * service (wifi config, denied because the app is not admin).
 */

#include "app_sdk.h"

#include <zephyr/kernel.h>
#include <zephyr/sys/printk.h>
#include <zephyr/app_memory/app_memdomain.h>
#include <stdio.h>

#define STACK_SIZE 2048
#define APP_PRIO   5

extern void platform_app_register(k_tid_t tid, bool admin);
extern void platform_grant_i2c(k_tid_t tid, uint8_t bus, uint16_t addr);
extern void app_rt_set_domain(struct k_mem_domain *dom);

K_APPMEM_PARTITION_DEFINE(app_part);
static struct k_mem_domain app_domain;

K_THREAD_STACK_DEFINE(app_stack, STACK_SIZE);
static struct k_thread app_thread;

static const char *tier_name(int t)
{
	return (t == 0) ? "open" : (t == 1) ? "scoped" : "admin";
}

/* A second thread of the same app - shares the app's domain and capabilities. */
static void app_worker(void *arg)
{
	ARG_UNUSED(arg);
	app_log("worker thread: also part of this app, shares its capabilities");

	int32_t t;

	if (app_sensor_read("temperature", &t) == 0) {
		app_log("worker read the sensor too (shared open capability)");
	}
}

static void app_main(void *p1, void *p2, void *p3)
{
	ARG_UNUSED(p1); ARG_UNUSED(p2); ARG_UNUSED(p3);

	/* 1. Discover what the platform offers (the registry). */
	int n = app_service_count();

	app_log("discovering platform services:");
	for (int i = 0; i < n; i++) {
		char name[20];
		int tier;

		if (app_service_info(i, name, sizeof(name), &tier) == 0) {
			char line[48];

			snprintf(line, sizeof(line), "service '%s' (%s)", name,
				 tier_name(tier));
			app_log(line);
		}
	}

	/* 2. Multi-threaded: spawn another thread in this same app. */
	int worker = app_thread_spawn(app_worker, NULL);

	/* 3. Open capability: read a sensor (any app may). */
	int32_t milli;

	if (app_sensor_read("temperature", &milli) == 0) {
		char line[48];

		snprintf(line, sizeof(line), "[open] temperature read ok (%d milli-C)",
			 milli);
		app_log(line);
	}

	/* 4. Scoped capability: granted i2c0 @ 0x48, denied elsewhere. */
	app_i2c_read(0, 0x48, 0x00);   /* granted */
	app_i2c_read(0, 0x50, 0x00);   /* denied  */

	/* 5. Admin capability: this app is not admin -> denied. */
	app_admin_wifi_set("HomeNet", "secret123");

	/* Reap the worker so it is joined, not self-aborted from user mode. */
	if (worker >= 0) {
		app_thread_join(worker);
	}

	app_log("app done");
}

int main(void)
{
	printk("\n*** unified app platform: one SDK, registry, tiers, threads (C6) ***\n");

	k_mem_domain_init(&app_domain, 0, NULL);
	struct k_mem_partition *p = &app_part;

	k_mem_domain_add_partition(&app_domain, p);
	app_rt_set_domain(&app_domain);

	k_tid_t t = k_thread_create(&app_thread, app_stack, STACK_SIZE, app_main,
				    NULL, NULL, NULL, APP_PRIO, K_USER, K_FOREVER);
	k_mem_domain_add_thread(&app_domain, t);

	/* Manifest: this app is a normal (non-admin) app, granted i2c0 @ 0x48. */
	platform_app_register(t, false);
	platform_grant_i2c(t, 0, 0x48);

	k_thread_start(t);
	k_thread_join(t, K_FOREVER);

	printk("\n*** done: one header, registry-driven, tier-enforced platform ***\n");
	return 0;
}
```

## src/app_rt.c
```c
/*
 * Copyright (c) 2026 Espressif Systems (Shanghai) Co., Ltd.
 *
 * SPDX-License-Identifier: Apache-2.0
 */

/* App runtime: spawn extra threads into the calling app's group. */

#include "app_sdk.h"
#include <zephyr/kernel.h>

#define RT_MAX_THREADS 3
#define RT_STACK_SIZE  2048
#define RT_PRIO        5

static struct k_thread rt_threads[RT_MAX_THREADS];
static K_THREAD_STACK_ARRAY_DEFINE(rt_stacks, RT_MAX_THREADS, RT_STACK_SIZE);
static int rt_count;
static struct k_mem_domain *rt_domain;

void app_rt_set_domain(struct k_mem_domain *dom)
{
	rt_domain = dom;
}

static void rt_trampoline(void *entry, void *arg, void *u2)
{
	ARG_UNUSED(u2);
	void (*fn)(void *) = (void (*)(void *))entry;

	fn(arg);
}

int app_rt_spawn(app_entry_t entry, void *arg)
{
	if (rt_count >= RT_MAX_THREADS) {
		return -ENOSPC;
	}
	int idx = rt_count++;

	k_tid_t t = k_thread_create(&rt_threads[idx], rt_stacks[idx],
				    RT_STACK_SIZE, rt_trampoline,
				    (void *)entry, arg, NULL,
				    RT_PRIO, K_USER | K_INHERIT_PERMS, K_FOREVER);
	if (rt_domain) {
		k_mem_domain_add_thread(rt_domain, t);
	}
	k_thread_start(t);
	return idx;
}

int app_rt_join(int idx)
{
	if (idx < 0 || idx >= rt_count) {
		return -EINVAL;
	}

	return k_thread_join(&rt_threads[idx], K_FOREVER);
}
```

## src/app_sdk.h
```c
/*
 * Copyright (c) 2026 Espressif Systems (Shanghai) Co., Ltd.
 *
 * SPDX-License-Identifier: Apache-2.0
 */

#ifndef APP_PLATFORM_APP_SDK_H_
#define APP_PLATFORM_APP_SDK_H_

#include <zephyr/kernel.h>
#include <stdint.h>
#include <stddef.h>

/*
 * The unified platform SDK - the single surface an application uses. It pulls
 * together the patterns proven across this series into one coherent API:
 *
 *   - app runtime: an app is a group of threads sharing one isolated domain;
 *     app_thread_spawn adds a thread to the calling app.
 *   - service discovery: app_service_count / app_service_info let an app learn
 *     what the platform offers at runtime (the registry).
 *   - three capability tiers:
 *       open       - any app may use (sensors: read-only, shared)
 *       scoped     - granted per app by manifest (i2c: only a (bus,addr) slice)
 *       admin      - system only (wifi credentials): -EPERM otherwise
 *
 * An app codes against this header alone. The export set is the API and the
 * security boundary; capability tier decides who may call what.
 */

/* App thread entry point. */
typedef void (*app_entry_t)(void *arg);

/* ---- runtime ---- */
__syscall void     app_log(const char *msg);
__syscall void     app_sleep_ms(uint32_t ms);
__syscall uint32_t app_uptime_ms(void);
__syscall int      app_thread_spawn(app_entry_t entry, void *arg);
__syscall int      app_thread_join(int handle);

/* ---- service discovery (the registry, queryable) ---- */
__syscall int app_service_count(void);
/* tier: 0=open, 1=scoped, 2=admin */
__syscall int app_service_info(int idx, char *name, size_t name_sz, int *tier);

/* ---- open capability: sensors ---- */
__syscall int app_sensor_read(const char *name, int32_t *milli_value);

/* ---- scoped capability: i2c (manifest grants a (bus,addr) slice) ---- */
__syscall int app_i2c_read(uint8_t bus, uint16_t addr, uint8_t reg);

/* ---- admin capability: system configuration (denied to normal apps) ---- */
__syscall int app_admin_wifi_set(const char *ssid, const char *psk);

#include <zephyr/syscalls/app_sdk.h>

#endif /* APP_PLATFORM_APP_SDK_H_ */
```

## src/platform.c
```c
/*
 * Copyright (c) 2026 Espressif Systems (Shanghai) Co., Ltd.
 *
 * SPDX-License-Identifier: Apache-2.0
 */

/*
 * The platform: one service registry and the SDK syscalls behind it. Every
 * service the platform exposes is one registry row with a name and a capability
 * tier; the SDK functions enforce the tier and forward to the real driver or
 * subsystem. This is the single place the platform's surface and policy live.
 */

#include "app_sdk.h"

#include <zephyr/kernel.h>
#include <zephyr/sys/printk.h>
#include <zephyr/device.h>
#include <zephyr/drivers/sensor.h>
#include <zephyr/internal/syscall_handler.h>
#include <string.h>
#include <errno.h>

enum tier { TIER_OPEN = 0, TIER_SCOPED = 1, TIER_ADMIN = 2 };

/* The service registry: the platform's announced surface + its policy. */
struct service {
	const char *name;
	enum tier   tier;
};

static const struct service registry[] = {
	{ "log",          TIER_OPEN },
	{ "sleep",        TIER_OPEN },
	{ "thread-spawn", TIER_OPEN },
	{ "sensor",       TIER_OPEN },
	{ "i2c",          TIER_SCOPED },
	{ "wifi-config",  TIER_ADMIN },
};
#define SERVICE_COUNT ((int)ARRAY_SIZE(registry))

/* Per-app capability state, keyed by thread. */
struct app_caps {
	k_tid_t  tid;
	bool     is_admin;
	uint8_t  i2c_bus;       /* the scoped i2c grant: bus + addr */
	uint16_t i2c_addr;
	bool     i2c_granted;
};

#define MAX_APPS 4
static struct app_caps caps[MAX_APPS];

void platform_app_register(k_tid_t tid, bool admin)
{
	for (int i = 0; i < MAX_APPS; i++) {
		if (caps[i].tid == NULL) {
			caps[i].tid = tid;
			caps[i].is_admin = admin;
			return;
		}
	}
}

void platform_grant_i2c(k_tid_t tid, uint8_t bus, uint16_t addr)
{
	for (int i = 0; i < MAX_APPS; i++) {
		if (caps[i].tid == tid) {
			caps[i].i2c_bus = bus;
			caps[i].i2c_addr = addr;
			caps[i].i2c_granted = true;
			return;
		}
	}
}

static struct app_caps *caps_of_current(void)
{
	k_tid_t cur = k_current_get();

	for (int i = 0; i < MAX_APPS; i++) {
		if (caps[i].tid == cur) {
			return &caps[i];
		}
	}
	return NULL;
}

/* ---- runtime ---- */

void z_impl_app_log(const char *msg)
{
	printk("    [app] %s\n", msg);
}

void z_impl_app_sleep_ms(uint32_t ms)
{
	k_msleep((int32_t)ms);
}

uint32_t z_impl_app_uptime_ms(void)
{
	return (uint32_t)k_uptime_get();
}

/* thread spawn lives in app_rt.c; declared here for the registry view. */
extern int app_rt_spawn(app_entry_t entry, void *arg);
extern int app_rt_join(int idx);

int z_impl_app_thread_spawn(app_entry_t entry, void *arg)
{
	return app_rt_spawn(entry, arg);
}

int z_impl_app_thread_join(int handle)
{
	return app_rt_join(handle);
}

/* ---- discovery ---- */

int z_impl_app_service_count(void)
{
	return SERVICE_COUNT;
}

int z_impl_app_service_info(int idx, char *name, size_t name_sz, int *tier)
{
	if (idx < 0 || idx >= SERVICE_COUNT) {
		return -EINVAL;
	}
	strncpy(name, registry[idx].name, name_sz - 1);
	name[name_sz - 1] = '\0';
	*tier = (int)registry[idx].tier;
	return 0;
}

/* ---- open: sensor ---- */

static const struct device *const die_temp = DEVICE_DT_GET(DT_ALIAS(die_temp0));

int z_impl_app_sensor_read(const char *name, int32_t *milli_value)
{
	if (strcmp(name, "temperature") != 0 || !device_is_ready(die_temp)) {
		return -ENODEV;
	}
	if (sensor_sample_fetch(die_temp) != 0) {
		return -EIO;
	}
	struct sensor_value v;

	if (sensor_channel_get(die_temp, SENSOR_CHAN_DIE_TEMP, &v) != 0) {
		return -EIO;
	}
	*milli_value = v.val1 * 1000 + v.val2 / 1000;
	return 0;
}

/* ---- scoped: i2c ---- */

int z_impl_app_i2c_read(uint8_t bus, uint16_t addr, uint8_t reg)
{
	ARG_UNUSED(reg);
	struct app_caps *c = caps_of_current();

	if (!c || !c->i2c_granted || c->i2c_bus != bus || c->i2c_addr != addr) {
		printk("    [platform] DENIED i2c%u @ 0x%02x (not in app manifest)\n",
		       bus, addr);
		return -EPERM;
	}
	printk("    [platform] GRANTED i2c%u @ 0x%02x (scoped capability)\n",
	       bus, addr);
	/* real read would run here; no device wired, return ok-with-zero. */
	return 0;
}

/* ---- admin: wifi config ---- */

int z_impl_app_admin_wifi_set(const char *ssid, const char *psk)
{
	struct app_caps *c = caps_of_current();

	if (!c || !c->is_admin) {
		printk("    [platform] DENIED wifi-config (app is not admin)\n");
		return -EPERM;
	}
	printk("    [platform] wifi-config applied: ssid='%s' (psk %zu)\n",
	       ssid, strlen(psk));
	return 0;
}

#ifdef CONFIG_USERSPACE

static inline int z_vrfy_app_service_info(int idx, char *name, size_t name_sz,
					  int *tier)
{
	K_OOPS(K_SYSCALL_MEMORY_WRITE(name, name_sz));
	K_OOPS(K_SYSCALL_MEMORY_WRITE(tier, sizeof(*tier)));
	return z_impl_app_service_info(idx, name, name_sz, tier);
}
#include <zephyr/syscalls/app_service_info_mrsh.c>

static inline int z_vrfy_app_sensor_read(const char *name, int32_t *milli_value)
{
	K_OOPS(K_SYSCALL_MEMORY_WRITE(milli_value, sizeof(*milli_value)));
	return z_impl_app_sensor_read(name, milli_value);
}
#include <zephyr/syscalls/app_sensor_read_mrsh.c>

static inline int z_vrfy_app_i2c_read(uint8_t bus, uint16_t addr, uint8_t reg)
{
	return z_impl_app_i2c_read(bus, addr, reg);
}
#include <zephyr/syscalls/app_i2c_read_mrsh.c>

static inline int z_vrfy_app_admin_wifi_set(const char *ssid, const char *psk)
{
	return z_impl_app_admin_wifi_set(ssid, psk);
}
#include <zephyr/syscalls/app_admin_wifi_set_mrsh.c>

static inline void z_vrfy_app_log(const char *msg)
{
	z_impl_app_log(msg);
}
#include <zephyr/syscalls/app_log_mrsh.c>

static inline void z_vrfy_app_sleep_ms(uint32_t ms)
{
	z_impl_app_sleep_ms(ms);
}
#include <zephyr/syscalls/app_sleep_ms_mrsh.c>

static inline uint32_t z_vrfy_app_uptime_ms(void)
{
	return z_impl_app_uptime_ms();
}
#include <zephyr/syscalls/app_uptime_ms_mrsh.c>

static inline int z_vrfy_app_thread_spawn(app_entry_t entry, void *arg)
{
	return z_impl_app_thread_spawn(entry, arg);
}
#include <zephyr/syscalls/app_thread_spawn_mrsh.c>

static inline int z_vrfy_app_thread_join(int handle)
{
	return z_impl_app_thread_join(handle);
}
#include <zephyr/syscalls/app_thread_join_mrsh.c>

static inline int z_vrfy_app_service_count(void)
{
	return z_impl_app_service_count();
}
#include <zephyr/syscalls/app_service_count_mrsh.c>
#endif /* CONFIG_USERSPACE */
```
