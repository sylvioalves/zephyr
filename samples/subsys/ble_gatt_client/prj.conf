## CMakeLists.txt
```
# SPDX-License-Identifier: Apache-2.0

cmake_minimum_required(VERSION 3.20.0)
find_package(Zephyr REQUIRED HINTS $ENV{ZEPHYR_BASE})
project(ble_gatt_client)

zephyr_syscall_header(${CMAKE_CURRENT_SOURCE_DIR}/src/gatt_svc.h)

target_sources(app PRIVATE
  src/main.c
  src/gatt_broker.c
  src/gatt_svc.c
)
```

## prj.conf
```kconfig
CONFIG_USERSPACE=y
CONFIG_APPLICATION_DEFINED_SYSCALL=y

CONFIG_BT=y
CONFIG_BT_CENTRAL=y
CONFIG_BT_GATT_CLIENT=y
CONFIG_BT_GATT_AUTO_DISCOVER_CCC=y
CONFIG_BT_SMP=y

CONFIG_LOG=y
CONFIG_LOG_MODE_MINIMAL=y
CONFIG_THREAD_NAME=y

CONFIG_MAIN_STACK_SIZE=4096

# GATT discovery runs on the BT RX work queue; give it headroom.
CONFIG_BT_RX_STACK_SIZE=2048
CONFIG_BT_LONG_WQ_STACK_SIZE=2048
```

## src/main.c
```c
/*
 * Copyright (c) 2026 Espressif Systems (Shanghai) Co., Ltd.
 *
 * SPDX-License-Identifier: Apache-2.0
 */

/*
 * BLE GATT client service (Tier 2): an isolated user-mode app asks the broker
 * for "heart rate". The broker scans, connects to a Heart Rate peer, discovers
 * the characteristic, and subscribes; notifications are delivered to the app
 * through its event queue. The app never touches the controller, the
 * connection, or the GATT layer - it just consumes heart-rate values.
 *
 * Pair with any Heart Rate peer: a fitness strap, or a phone running a GATT
 * server app (e.g. nRF Connect) advertising the Heart Rate Service.
 */

#include "gatt_svc.h"
#include "gatt_broker.h"

#include <zephyr/kernel.h>
#include <zephyr/sys/printk.h>

#define STACK_SIZE 2048
#define APP_PRIO   5

K_THREAD_STACK_DEFINE(app_stack, STACK_SIZE);
static struct k_thread app_thread;

K_MSGQ_DEFINE(app_q, sizeof(struct gatt_notification), 8, 4);

static const char *state_name(uint8_t s)
{
	switch (s) {
	case GATT_SCANNING:     return "scanning";
	case GATT_CONNECTED:    return "connected";
	case GATT_SUBSCRIBED:   return "subscribed";
	case GATT_DISCONNECTED: return "disconnected";
	default:                return "?";
	}
}

static void hr_app(void *p1, void *p2, void *p3)
{
	ARG_UNUSED(p1); ARG_UNUSED(p2); ARG_UNUSED(p3);

	printk("  [hr-app] requesting heart-rate service\n");
	svc_ble_hrs_start();

	for (;;) {
		struct gatt_notification ev;
		int rc = svc_ble_next_event(&ev, 5000);

		if (rc != 0) {
			printk("  [hr-app] waiting...\n");
			continue;
		}

		if (ev.handle == 0xFFFF) {
			printk("  [hr-app] state: %s\n", state_name(ev.data[0]));
			continue;
		}

		/* Heart Rate Measurement: byte 0 = flags, byte 1 = bpm (8-bit). */
		uint8_t bpm = (ev.len >= 2) ? ev.data[1] : 0;

		printk("  [hr-app] heart rate notification: %u bpm (len %u)\n",
		       bpm, ev.len);
	}
}

int main(void)
{
	printk("\n*** BLE GATT client service: app subscribes to heart rate (C6) ***\n");

	if (gatt_broker_init() != 0) {
		printk("gatt_broker_init failed\n");
		return 0;
	}

	k_tid_t t = k_thread_create(&app_thread, app_stack, STACK_SIZE, hr_app,
				    NULL, NULL, NULL, APP_PRIO, K_USER,
				    K_FOREVER);

	k_thread_access_grant(t, &app_q);
	gatt_svc_register(t, &app_q);
	k_thread_start(t);
	return 0;
}
```

## src/gatt_broker.c
```c
/*
 * Copyright (c) 2026 Espressif Systems (Shanghai) Co., Ltd.
 *
 * SPDX-License-Identifier: Apache-2.0
 */

#include "gatt_broker.h"

#include <zephyr/kernel.h>
#include <zephyr/sys/printk.h>
#include <zephyr/sys/byteorder.h>
#include <zephyr/bluetooth/bluetooth.h>
#include <zephyr/bluetooth/conn.h>
#include <zephyr/bluetooth/gatt.h>
#include <zephyr/bluetooth/uuid.h>
#include <zephyr/bluetooth/addr.h>

/* The app's notification/state queue (set by gatt_broker_start). */
static struct k_msgq *app_q;

static struct bt_conn *default_conn;
static struct bt_uuid_16 discover_uuid = BT_UUID_INIT_16(0);
static struct bt_gatt_discover_params discover_params;
static struct bt_gatt_discover_params ccc_disc_params;   /* for auto-CCC */
static struct bt_gatt_subscribe_params subscribe_params;
static enum gatt_state state;

static void push_state(enum gatt_state s)
{
	state = s;
	/* A zero-length notification carries a state change to the app. */
	struct gatt_notification ev = { .handle = 0xFFFF, .len = 0 };

	ev.data[0] = (uint8_t)s;
	if (app_q) {
		(void)k_msgq_put(app_q, &ev, K_NO_WAIT);
	}
}

static void start_scan(void);

/* A heart-rate notification arrived: push the raw value to the app. */
static uint8_t notify_func(struct bt_conn *conn,
			   struct bt_gatt_subscribe_params *params,
			   const void *data, uint16_t length)
{
	if (!data) {
		params->value_handle = 0U;
		return BT_GATT_ITER_STOP;
	}

	struct gatt_notification ev = {
		.handle = params->value_handle,
		.len = MIN(length, GATT_NOTIFY_MAXLEN),
	};

	memcpy(ev.data, data, ev.len);
	if (app_q) {
		(void)k_msgq_put(app_q, &ev, K_NO_WAIT);
	}
	return BT_GATT_ITER_CONTINUE;
}

/* GATT discovery state machine: primary -> characteristic -> CCC -> subscribe. */
static uint8_t discover_func(struct bt_conn *conn,
			     const struct bt_gatt_attr *attr,
			     struct bt_gatt_discover_params *params)
{
	int err;

	if (!attr) {
		return BT_GATT_ITER_STOP;
	}

	if (!bt_uuid_cmp(discover_params.uuid, BT_UUID_HRS)) {
		memcpy(&discover_uuid, BT_UUID_HRS_MEASUREMENT,
		       sizeof(discover_uuid));
		discover_params.uuid = &discover_uuid.uuid;
		discover_params.start_handle = attr->handle + 1;
		discover_params.type = BT_GATT_DISCOVER_CHARACTERISTIC;
		discover_params.func = discover_func;   /* keep callback valid */
		err = bt_gatt_discover(conn, &discover_params);
		if (err) {
			printk("gatt-broker: char discover failed (%d)\n", err);
		}
	} else {
		/*
		 * Found the measurement characteristic. Let the subscribe call
		 * auto-discover the CCC descriptor (BT_GATT_AUTO_DISCOVER_CCC),
		 * avoiding a separate manual descriptor-discovery pass.
		 */
		subscribe_params.notify = notify_func;
		subscribe_params.value = BT_GATT_CCC_NOTIFY;
		subscribe_params.value_handle = bt_gatt_attr_value_handle(attr);
		subscribe_params.ccc_handle = BT_GATT_AUTO_DISCOVER_CCC_HANDLE;
		subscribe_params.disc_params = &ccc_disc_params;
		subscribe_params.end_handle = BT_ATT_LAST_ATTRIBUTE_HANDLE;

		err = bt_gatt_subscribe(conn, &subscribe_params);
		if (err && err != -EALREADY) {
			printk("gatt-broker: subscribe failed (%d)\n", err);
		} else {
			printk("gatt-broker: subscribed to heart rate\n");
			push_state(GATT_SUBSCRIBED);
		}
		return BT_GATT_ITER_STOP;
	}

	return BT_GATT_ITER_CONTINUE;
}

/* Advertised-data parser: connect if the peer offers the Heart Rate Service. */
static bool eir_found(struct bt_data *data, void *user_data)
{
	bt_addr_le_t *addr = user_data;

	if (data->type != BT_DATA_UUID16_SOME &&
	    data->type != BT_DATA_UUID16_ALL) {
		return true;
	}

	for (int i = 0; i + 1 < data->data_len; i += 2) {
		struct bt_uuid_16 u = BT_UUID_INIT_16(
			sys_get_le16(&data->data[i]));

		if (bt_uuid_cmp(&u.uuid, BT_UUID_HRS) != 0) {
			continue;
		}

		(void)bt_le_scan_stop();

		struct bt_conn_le_create_param *cp = BT_CONN_LE_CREATE_CONN;

		int err = bt_conn_le_create(addr, cp, BT_LE_CONN_PARAM_DEFAULT,
					    &default_conn);
		if (err) {
			printk("gatt-broker: create conn failed (%d)\n", err);
			start_scan();
		}
		return false;
	}
	return true;
}

static void device_found(const bt_addr_le_t *addr, int8_t rssi, uint8_t type,
			 struct net_buf_simple *ad)
{
	if (default_conn) {
		return;
	}
	if (type == BT_GAP_ADV_TYPE_ADV_IND ||
	    type == BT_GAP_ADV_TYPE_ADV_DIRECT_IND) {
		bt_data_parse(ad, eir_found, (void *)addr);
	}
}

static void start_scan(void)
{
	struct bt_le_scan_param sp = {
		.type    = BT_LE_SCAN_TYPE_ACTIVE,
		.options = BT_LE_SCAN_OPT_NONE,
		.interval = BT_GAP_SCAN_FAST_INTERVAL,
		.window  = BT_GAP_SCAN_FAST_WINDOW,
	};

	int err = bt_le_scan_start(&sp, device_found);

	if (err) {
		printk("gatt-broker: scan start failed (%d)\n", err);
		return;
	}
	push_state(GATT_SCANNING);
	printk("gatt-broker: scanning for a Heart Rate peer\n");
}

static void connected(struct bt_conn *conn, uint8_t err)
{
	if (err) {
		printk("gatt-broker: connect failed (%u)\n", err);
		bt_conn_unref(default_conn);
		default_conn = NULL;
		start_scan();
		return;
	}

	printk("gatt-broker: %s, discovering services\n", __func__);
	push_state(GATT_CONNECTED);

	memcpy(&discover_uuid, BT_UUID_HRS, sizeof(discover_uuid));
	discover_params.uuid = &discover_uuid.uuid;
	discover_params.func = discover_func;
	discover_params.start_handle = BT_ATT_FIRST_ATTRIBUTE_HANDLE;
	discover_params.end_handle = BT_ATT_LAST_ATTRIBUTE_HANDLE;
	discover_params.type = BT_GATT_DISCOVER_PRIMARY;

	if (bt_gatt_discover(conn, &discover_params) != 0) {
		printk("gatt-broker: discover failed\n");
	}
}

static void disconnected(struct bt_conn *conn, uint8_t reason)
{
	printk("gatt-broker: %s (0x%02x), rescanning\n", __func__, reason);
	bt_conn_unref(default_conn);
	default_conn = NULL;
	push_state(GATT_DISCONNECTED);
	start_scan();
}

BT_CONN_CB_DEFINE(conn_callbacks) = {
	.connected = connected,
	.disconnected = disconnected,
};

int gatt_broker_init(void)
{
	int err = bt_enable(NULL);

	if (err) {
		printk("gatt-broker: bt_enable failed (%d)\n", err);
		return err;
	}
	printk("gatt-broker: Bluetooth ready, broker owns the controller\n");
	return 0;
}

int gatt_broker_start(struct k_msgq *notify_q)
{
	app_q = notify_q;
	start_scan();
	return 0;
}

enum gatt_state gatt_broker_state(void)
{
	return state;
}
```

## src/gatt_broker.h
```c
/*
 * Copyright (c) 2026 Espressif Systems (Shanghai) Co., Ltd.
 *
 * SPDX-License-Identifier: Apache-2.0
 */

#ifndef BLE_GATT_CLIENT_GATT_BROKER_H_
#define BLE_GATT_CLIENT_GATT_BROKER_H_

#include <zephyr/kernel.h>

/*
 * BLE GATT client service (Tier 2). The broker owns the controller and runs the
 * whole stateful client machine in supervisor mode: scan for a peer exposing the
 * Heart Rate Service, connect, discover the measurement characteristic, and
 * subscribe to its notifications. Each notification is pushed to the requesting
 * app's event queue - the same async-event seam used for scan results, now
 * carrying connection-bound data.
 *
 * The app never touches the controller, the connection, or the GATT layer; it
 * asks for "heart rate" and receives values asynchronously.
 */

#define GATT_NOTIFY_MAXLEN 20

/* One notification delivered to an app. */
struct gatt_notification {
	uint16_t handle;
	uint8_t  len;
	uint8_t  data[GATT_NOTIFY_MAXLEN];
};

/* Connection-state events the app can observe. */
enum gatt_state {
	GATT_SCANNING = 0,
	GATT_CONNECTED,
	GATT_SUBSCRIBED,
	GATT_DISCONNECTED,
};

/* Initialize Bluetooth and the GATT-client broker. */
int gatt_broker_init(void);

/*
 * Start the client machine: scan, connect to a Heart Rate peer, discover, and
 * subscribe. Notifications and state changes are delivered to @p notify_q.
 */
int gatt_broker_start(struct k_msgq *notify_q);

/* Current state (for the app to report). */
enum gatt_state gatt_broker_state(void);

#endif /* BLE_GATT_CLIENT_GATT_BROKER_H_ */
```

## src/gatt_svc.c
```c
/*
 * Copyright (c) 2026 Espressif Systems (Shanghai) Co., Ltd.
 *
 * SPDX-License-Identifier: Apache-2.0
 */

#include "gatt_svc.h"
#include "gatt_broker.h"

#include <zephyr/kernel.h>
#include <zephyr/internal/syscall_handler.h>

static k_tid_t app_tid;
static struct k_msgq *app_q;

void gatt_svc_register(k_tid_t tid, struct k_msgq *q)
{
	app_tid = tid;
	app_q = q;
}

int z_impl_svc_ble_hrs_start(void)
{
	if (k_current_get() != app_tid) {
		return -EPERM;
	}
	return gatt_broker_start(app_q);
}

int z_impl_svc_ble_next_event(struct gatt_notification *out, int32_t timeout_ms)
{
	if (k_current_get() != app_tid || app_q == NULL) {
		return -EPERM;
	}
	if (k_msgq_get(app_q, out, K_MSEC(timeout_ms)) != 0) {
		return -EAGAIN;
	}
	return 0;
}

#ifdef CONFIG_USERSPACE

static inline int z_vrfy_svc_ble_hrs_start(void)
{
	return z_impl_svc_ble_hrs_start();
}
#include <zephyr/syscalls/svc_ble_hrs_start_mrsh.c>

static inline int z_vrfy_svc_ble_next_event(struct gatt_notification *out,
					    int32_t timeout_ms)
{
	K_OOPS(K_SYSCALL_MEMORY_WRITE(out, sizeof(*out)));
	return z_impl_svc_ble_next_event(out, timeout_ms);
}
#include <zephyr/syscalls/svc_ble_next_event_mrsh.c>

#endif /* CONFIG_USERSPACE */
```

## src/gatt_svc.h
```c
/*
 * Copyright (c) 2026 Espressif Systems (Shanghai) Co., Ltd.
 *
 * SPDX-License-Identifier: Apache-2.0
 */

#ifndef BLE_GATT_CLIENT_GATT_SVC_H_
#define BLE_GATT_CLIENT_GATT_SVC_H_

#include <zephyr/kernel.h>
#include "gatt_broker.h"

/*
 * Broker syscalls for the GATT-client service. The app asks the broker to find,
 * connect to, and subscribe to a Heart Rate peer, then receives notifications
 * and connection-state changes asynchronously - the same per-app event queue
 * mechanism as the scan service, now carrying connection-bound data.
 */

/* Supervisor-side: register the calling app's thread and event queue. */
void gatt_svc_register(k_tid_t tid, struct k_msgq *q);

/* Start the client machine (scan -> connect -> subscribe). */
__syscall int svc_ble_hrs_start(void);

/*
 * Wait up to @p timeout_ms for the next event (notification or state change).
 * Returns 0 on an event, -EAGAIN on timeout.
 */
__syscall int svc_ble_next_event(struct gatt_notification *out,
				 int32_t timeout_ms);

#include <zephyr/syscalls/gatt_svc.h>

#endif /* BLE_GATT_CLIENT_GATT_SVC_H_ */
```
