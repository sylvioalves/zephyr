## CMakeLists.txt
```
# Copyright (c) 2026 Espressif Systems (Shanghai) Co., Ltd.
# SPDX-License-Identifier: Apache-2.0

cmake_minimum_required(VERSION 3.20.0)
find_package(Zephyr REQUIRED HINTS $ENV{ZEPHYR_BASE})
project(app_edk)

target_sources(app PRIVATE src/main.c)

# The firmware runs the module bundle (hello.llext and hello.manifest) found in
# APP_EDK_BUNDLE_DIR, built outside the tree from the kit of this firmware. Without
# it, the build builds module/ with its own kit and the publisher key.
zephyr_get(APP_EDK_BUNDLE_DIR)
if(APP_EDK_BUNDLE_DIR)
  get_filename_component(bundle_dir ${APP_EDK_BUNDLE_DIR} ABSOLUTE)
else()
  set(publisher_key ${CMAKE_CURRENT_SOURCE_DIR}/keys/publisher.pem)
  app_platform_edk_project(hello_module
    SOURCE_DIR ${CMAKE_CURRENT_SOURCE_DIR}/module
    OUTPUTS hello.llext hello.manifest
    DEPENDS ${publisher_key}
    CMAKE_ARGS -DAPP_SIGNING_KEY=${publisher_key} -DAPP_SIGNING_KEY_ID=1
  )
  add_dependencies(app hello_module)
  set(bundle_dir ${CMAKE_CURRENT_BINARY_DIR}/hello_module/build)
endif()

set(gen_dir ${ZEPHYR_BINARY_DIR}/include/generated/app_edk)
generate_inc_file_for_target(app ${bundle_dir}/hello.llext ${gen_dir}/hello.llext.inc)
generate_inc_file_for_target(app ${bundle_dir}/hello.manifest ${gen_dir}/hello.manifest.inc)
```

## prj.conf
```kconfig
CONFIG_APP_PLATFORM=y
CONFIG_APP_PLATFORM_MAX_APPS=1
CONFIG_APP_PLATFORM_LOADER=y
CONFIG_APP_PLATFORM_SERVICES=y
# Modules are signed by the publisher keys of the list, never with the
# development key.
CONFIG_APP_PLATFORM_KEYS_FILE="keys.yaml"
CONFIG_APP_PLATFORM_DEV_KEY=n
# west build -t llext-edk packs the module development kit.
CONFIG_APP_PLATFORM_EDK=y

CONFIG_USERSPACE=y

CONFIG_TASK_WDT=y
CONFIG_TASK_WDT_HW_FALLBACK=n

CONFIG_LLEXT=y
CONFIG_LLEXT_HEAP_SIZE=32
CONFIG_LLEXT_TYPE_ELF_RELOCATABLE=y

CONFIG_PSA_CRYPTO=y
CONFIG_MBEDTLS_ENABLE_HEAP=y
CONFIG_MBEDTLS_HEAP_SIZE=4096
CONFIG_PSA_WANT_ALG_SHA_256=y
CONFIG_PSA_WANT_ALG_ECDSA=y
CONFIG_PSA_WANT_ECC_SECP_R1_256=y
CONFIG_PSA_WANT_KEY_TYPE_ECC_PUBLIC_KEY=y
CONFIG_MBEDTLS_PSA_P256M_DRIVER_ENABLED=y
CONFIG_ENTROPY_GENERATOR=y

CONFIG_LOG=y
CONFIG_LOG_MODE_MINIMAL=y

CONFIG_MAIN_STACK_SIZE=4096
CONFIG_HEAP_MEM_POOL_SIZE=16384
```

## src/main.c
```c
/*
 * Copyright (c) 2026 Espressif Systems (Shanghai) Co., Ltd.
 *
 * SPDX-License-Identifier: Apache-2.0
 */

#include <zephyr/kernel.h>
#include <zephyr/app_platform/app_loader.h>
#include <zephyr/app_platform/app_manifest.h>
#include <zephyr/app_platform/app_platform.h>
#include <zephyr/llext/llext.h>
#include <zephyr/sys/printk.h>
#include <string.h>

static const uint8_t mod_bytes[] = {
#include "app_edk/hello.llext.inc"
};
static const uint8_t bundle[] = {
#include "app_edk/hello.manifest.inc"
};

static uint8_t work[8192] __aligned(8);

int main(void)
{
	size_t mf_len = sizeof(bundle) - APP_MANIFEST_SIG_LEN;
	struct app_platform_status st;
	struct app_manifest mf;
	struct llext *ext = NULL;
	void *entry = NULL;
	int ret;
	int id;

	if (mf_len != sizeof(mf) || sizeof(mod_bytes) > sizeof(work)) {
		printk("app_edk: the bundle does not fit\n");
		return 0;
	}
	memcpy(&mf, bundle, mf_len);
	memcpy(work, mod_bytes, sizeof(mod_bytes));

	if (app_platform_init() != 0) {
		printk("app_edk: platform init failed\n");
		return 0;
	}

	ret = app_loader_verify_load_manifest(&mf, mf_len, bundle + mf_len, APP_MANIFEST_SIG_LEN,
					      work, sizeof(mod_bytes), "app_main", &ext, &entry);
	if (ret != 0) {
		printk("app_edk: module refused: %d\n", ret);
		return 0;
	}
	printk("app_edk: module '%s' v%u signed by key %u verified\n", mf.name, mf.version,
	       mf.key_id);

	id = app_platform_launch_llext(mf.name, ext, (app_entry_t)entry, NULL,
				       APP_CAP_LOG | APP_CAP_TIME);
	if (id < 0) {
		printk("app_edk: launch failed: %d\n", id);
		return 0;
	}

	do {
		k_msleep(100);
	} while (app_platform_status(id, &st) == 0 && st.active);
	printk("app_edk: module ended\n");
	return 0;
}
```
