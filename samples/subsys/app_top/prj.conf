## CMakeLists.txt
```
# SPDX-License-Identifier: Apache-2.0

cmake_minimum_required(VERSION 3.20.0)
find_package(Zephyr REQUIRED HINTS $ENV{ZEPHYR_BASE})
project(app_top)

target_sources(app PRIVATE src/main.c)

set(ext_src ${PROJECT_SOURCE_DIR}/module/src/loop_app.c)
set(bin ${PROJECT_BINARY_DIR}/llext/loop_app.llext)
set(inc ${ZEPHYR_BINARY_DIR}/include/generated/loop_app.inc)
set(sha ${ZEPHYR_BINARY_DIR}/include/generated/loop_app.sha256.inc)

app_platform_add_module(loop_ext OUTPUT ${bin} SOURCES ${ext_src})
llext_include_directories(loop_ext ${ZEPHYR_BINARY_DIR}/include/generated)
generate_inc_file_for_target(app ${bin} ${inc})

add_custom_command(
  OUTPUT  ${sha}
  COMMAND ${CMAKE_COMMAND}
    -DMODULE_BIN=${bin}
    -DOUT_INC=${sha}
    -P ${CMAKE_CURRENT_SOURCE_DIR}/cmake/gen_sha256_inc.cmake
  DEPENDS ${bin}
)
add_custom_target(loop_sha DEPENDS ${sha})
add_dependencies(app loop_sha)
```

## prj.conf
```kconfig
CONFIG_APPLICATION_DEFINED_SYSCALL=y

CONFIG_APP_PLATFORM=y
CONFIG_APP_PLATFORM_MAX_APPS=10
CONFIG_APP_PLATFORM_LOADER=y
CONFIG_APP_PLATFORM_SERVICES=y

CONFIG_TASK_WDT=y
CONFIG_TASK_WDT_CHANNELS=16
CONFIG_TASK_WDT_HW_FALLBACK=n

CONFIG_LLEXT=y
CONFIG_LLEXT_HEAP_SIZE=64
CONFIG_LLEXT_TYPE_ELF_RELOCATABLE=y

CONFIG_PSA_CRYPTO=y
CONFIG_MBEDTLS_ENABLE_HEAP=y
CONFIG_PSA_WANT_ALG_SHA_256=y

CONFIG_ENTROPY_GENERATOR=y

# Shell for live introspection (appstat status).
CONFIG_SHELL=y
CONFIG_SHELL_BACKEND_SERIAL=y

# Per-app stack high-water mark and CPU accounting for appstat.
CONFIG_INIT_STACKS=y
CONFIG_THREAD_STACK_INFO=y
CONFIG_THREAD_RUNTIME_STATS=y
CONFIG_SCHED_THREAD_USAGE=y

# System heap stats for appstat.
CONFIG_SYS_HEAP_RUNTIME_STATS=y

CONFIG_LOG=y
CONFIG_THREAD_NAME=y

# Route app logs through the shell so they render above the prompt instead of
# racing the console. SHELL_LOG_BACKEND is on by default once LOG is full
# (not minimal); deferred mode keeps logging off the app threads.
CONFIG_LOG_MODE_DEFERRED=y
CONFIG_SHELL_BACKEND_SERIAL_INTERRUPT_DRIVEN=y

CONFIG_MAIN_STACK_SIZE=4096
CONFIG_HEAP_MEM_POOL_SIZE=32768
```

## boards/esp32c6_devkitc_esp32c6_hpcore.overlay
```dts
/*
 * Copyright (c) 2026 Espressif Systems (Shanghai) Co., Ltd.
 *
 * SPDX-License-Identifier: Apache-2.0
 *
 * Enlarge the storage partition for the application store. Under simple boot
 * the second firmware slot is unused, so its region is reassigned to storage.
 * The code partition and the low-power-core slots are left untouched.
 */

/delete-node/ &slot1_partition;

&storage_partition {
	reg = <0x1e0000 DT_SIZE_K(1792)>;
};
```

## src/main.c
```c
/*
 * Copyright (c) 2026 Espressif Systems (Shanghai) Co., Ltd.
 *
 * SPDX-License-Identifier: Apache-2.0
 */

/*
 * Launch one built-in and one loadable application, then leave a shell up so
 * both can be inspected and controlled live. The built-in app is compiled into
 * the firmware; the loadable app is a verified module loaded at runtime. Both
 * run as isolated user-mode threads looping with a one-second period. Run
 * "app status" on the console to compare them (the built-in shows a zero module
 * footprint, the loadable shows its loaded size) and "app stop/start/restart/
 * remove <id>" to control them.
 */

#include <zephyr/app_platform/app_platform.h>
#include <zephyr/app_platform/app_loader.h>
#include <zephyr/app_platform/app_services.h>
#include <zephyr/app_platform/app_caps.h>
#include <zephyr/kernel.h>
#include <zephyr/sys/printk.h>

static const uint8_t app_bytes[] __aligned(8) = {
#include "loop_app.inc"
};
static const uint8_t app_hash[32] = {
#include "loop_app.sha256.inc"
};

#define APP_CAPS (APP_CAP_LOG | APP_CAP_TIME)

/* Built-in app: runs as a user-mode thread, reaching the system only through
 * service syscalls, the same as a loadable app.
 */
static void builtin_hello(void *arg)
{
	ARG_UNUSED(arg);

	for (;;) {
		app_svc_log("builtin: hello from a compiled-in app");
		k_msleep(1000);
	}
}

int main(void)
{
	printk("\n*** built-in + loadable app demo (run: app status) ***\n");

	if (app_platform_init() != 0) {
		printk("platform init failed\n");
		return 0;
	}

	/* 1. A built-in application, compiled into the firmware. */
	const struct app_def builtin = {
		.name = "builtin0",
		.source = APP_BUILTIN,
		.entry = builtin_hello,
		.caps = APP_CAPS,
		.monitored = false,
	};

	if (app_platform_launch(&builtin) < 0) {
		printk("built-in launch failed\n");
	}

	/* 2. A loadable application, verified and loaded at runtime. */
	struct llext *ext = NULL;
	void *entry = NULL;
	int rc = app_loader_verify_load("loadable0", app_bytes,
					ARRAY_SIZE(app_bytes), app_hash,
					"app_main", &ext, &entry);

	if (rc == 0) {
		app_platform_launch_llext("loadable0", ext, (app_entry_t)entry, NULL,
					  APP_CAPS);
	} else {
		printk("loadable load failed: %d\n", rc);
	}

	printk("*** ready: built-in (id 0) + loadable (id 1); try app status ***\n");
	return 0;
}
```
