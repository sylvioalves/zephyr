## CMakeLists.txt
```
# SPDX-License-Identifier: Apache-2.0

cmake_minimum_required(VERSION 3.20.0)
find_package(Zephyr REQUIRED HINTS $ENV{ZEPHYR_BASE})
project(app_trio)

target_sources(app PRIVATE src/main.c)

# Build each of the three modules as an llext and embed its bytes + hash.
function(add_module name)
  set(src ${PROJECT_SOURCE_DIR}/module/src/${name}.c)
  set(bin ${PROJECT_BINARY_DIR}/llext/${name}.llext)
  set(inc ${ZEPHYR_BINARY_DIR}/include/generated/${name}.inc)
  set(sha ${ZEPHYR_BINARY_DIR}/include/generated/${name}.sha256.inc)

  app_platform_add_module(${name}_ext OUTPUT ${bin} SOURCES ${src})
  llext_include_directories(${name}_ext ${ZEPHYR_BINARY_DIR}/include/generated)
  generate_inc_file_for_target(app ${bin} ${inc})

  add_custom_command(
    OUTPUT  ${sha}
    COMMAND ${CMAKE_COMMAND}
      -DMODULE_BIN=${bin}
      -DOUT_INC=${sha}
      -P ${CMAKE_CURRENT_SOURCE_DIR}/cmake/gen_sha256_inc.cmake
    DEPENDS ${bin}
  )
  add_custom_target(${name}_sha DEPENDS ${sha})
  add_dependencies(app ${name}_sha)
endfunction()

add_module(pub_app)
add_module(bridge_app)
add_module(print_app)
```

## prj.conf
```kconfig
CONFIG_APPLICATION_DEFINED_SYSCALL=y

CONFIG_APP_PLATFORM=y
CONFIG_APP_PLATFORM_MAX_APPS=4
CONFIG_APP_PLATFORM_LOADER=y
CONFIG_APP_PLATFORM_SERVICES=y
CONFIG_APP_PLATFORM_NET=y

# Wi-Fi for the network service (set to your 2.4GHz network).
CONFIG_APP_PLATFORM_NET_WIFI_SSID="CHANGE_ME_SSID"
CONFIG_APP_PLATFORM_NET_WIFI_PSK="CHANGE_ME_PSK"

CONFIG_TASK_WDT=y
CONFIG_TASK_WDT_CHANNELS=8

CONFIG_LLEXT=y
CONFIG_LLEXT_HEAP_SIZE=64
CONFIG_LLEXT_TYPE_ELF_RELOCATABLE=y
CONFIG_PSA_CRYPTO=y
CONFIG_MBEDTLS_ENABLE_HEAP=y
CONFIG_PSA_WANT_ALG_SHA_256=y

CONFIG_SENSOR=y

CONFIG_WIFI=y
CONFIG_WIFI_USAGE_MODE_STA=y
CONFIG_WIFI_STA_AUTO_DHCPV4=y

CONFIG_NETWORKING=y
CONFIG_NET_IPV4=y
CONFIG_NET_IPV6=n
CONFIG_NET_DHCPV4=y
CONFIG_NET_DHCPV4_OPTION_DNS_ADDRESS=y
CONFIG_NET_UDP=y
CONFIG_NET_TCP=y
CONFIG_NET_SOCKETS=y
CONFIG_DNS_RESOLVER=y
CONFIG_DNS_SERVER_IP_ADDRESSES=y
CONFIG_DNS_SERVER1="8.8.8.8"
CONFIG_NET_MAX_CONTEXTS=10

CONFIG_NET_MGMT=y
CONFIG_NET_MGMT_EVENT=y
CONFIG_NET_MGMT_EVENT_INFO=y
CONFIG_NET_MGMT_EVENT_STACK_SIZE=4096

CONFIG_MQTT_LIB=y

CONFIG_LOG=y
CONFIG_LOG_MODE_MINIMAL=y
CONFIG_NET_LOG=y
CONFIG_THREAD_NAME=y

CONFIG_MAIN_STACK_SIZE=6144
CONFIG_HEAP_MEM_POOL_SIZE=153600
```

## boards/esp32c5_devkitc_esp32c5_hpcore.conf
```kconfig
# The ESP32-C5 has 378 KB of internal SRAM: shrink the system heap and the
# loadable-extension heap (three modules of about 5 KB each) so the image links.
CONFIG_HEAP_MEM_POOL_SIZE=40960
CONFIG_LLEXT_HEAP_SIZE=32
```

## boards/esp32c6_devkitc_esp32c6_hpcore.overlay
```dts
/*
 * Copyright (c) 2026 Espressif Systems (Shanghai) Co., Ltd.
 * SPDX-License-Identifier: Apache-2.0
 */

/* Enable the SoC die-temperature sensor (die_temp0 alias). */
&coretemp {
	status = "okay";
};
```

## src/main.c
```c
/*
 * Copyright (c) 2026 Espressif Systems (Shanghai) Co., Ltd.
 *
 * SPDX-License-Identifier: Apache-2.0
 */

/*
 * Three isolated applications cooperating across the network and the in-device
 * message bus:
 *   app 1 (pub)    - publishes the SoC die temperature to the broker every 5s
 *   app 2 (bridge) - subscribes to that topic, receives each value over MQTT,
 *                    and forwards it to app 3 over inter-application IPC
 *   app 3 (printer)- receives the forwarded values over IPC and prints them
 * Each runs in its own memory domain and reaches the system only through
 * capability-gated service syscalls.
 */

#include <zephyr/app_platform/app_platform.h>
#include <zephyr/app_platform/app_loader.h>
#include <zephyr/app_platform/app_caps.h>
#include <zephyr/kernel.h>
#include <zephyr/sys/printk.h>

static const uint8_t pub_app[] __aligned(8) = {
#include "pub_app.inc"
};
static const uint8_t pub_hash[32] = {
#include "pub_app.sha256.inc"
};
static const uint8_t bridge_app[] __aligned(8) = {
#include "bridge_app.inc"
};
static const uint8_t bridge_hash[32] = {
#include "bridge_app.sha256.inc"
};
static const uint8_t print_app[] __aligned(8) = {
#include "print_app.inc"
};
static const uint8_t print_hash[32] = {
#include "print_app.sha256.inc"
};

static int launch(const char *name, const uint8_t *bytes, size_t len,
		   const uint8_t *hash, app_caps_t caps)
{
	struct llext *ext = NULL;
	void *entry = NULL;
	int rc = app_loader_verify_load(name, bytes, len, hash, "app_main",
					&ext, &entry);

	if (rc != 0) {
		printk("%s: load failed %d\n", name, rc);
		return rc;
	}
	rc = app_platform_launch_llext(name, ext, (app_entry_t)entry, NULL, caps);
	if (rc < 0) {
		printk("%s: %s failed %d\n", name, __func__, rc);
	}
	return rc;
}

int main(void)
{
	printk("\n*** three cooperating apps: MQTT -> IPC chain ***\n");

	if (app_platform_init() != 0) {
		printk("platform init failed\n");
		return 0;
	}

	/* TRIO_APPS is a bitmask selecting which apps to launch, so each can be
	 * brought up alone or together: bit0 pub, bit1 bridge, bit2 printer.
	 * Default: all three.
	 */
#ifndef TRIO_APPS
#define TRIO_APPS 0x7
#endif
	printk("trio: launching set 0x%x\n", TRIO_APPS);

	/* Printer first so its IPC name is registered before the bridge sends. */
	if (TRIO_APPS & 0x4) {
		launch("printer", print_app, ARRAY_SIZE(print_app), print_hash,
		       APP_CAP_LOG | APP_CAP_IPC);
		k_msleep(200);
	}
	if (TRIO_APPS & 0x2) {
		launch("bridge", bridge_app, ARRAY_SIZE(bridge_app), bridge_hash,
		       APP_CAP_LOG | APP_CAP_NET | APP_CAP_IPC);
	}
	if (TRIO_APPS & 0x1) {
		launch("pub", pub_app, ARRAY_SIZE(pub_app), pub_hash,
		       APP_CAP_LOG | APP_CAP_NET | APP_CAP_TIME | APP_CAP_SENSOR);
	}

	printk("*** launched set 0x%x; watch the flow ***\n", TRIO_APPS);
	return 0;
}
```
