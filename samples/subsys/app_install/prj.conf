## CMakeLists.txt
```
# SPDX-License-Identifier: Apache-2.0

cmake_minimum_required(VERSION 3.20.0)
find_package(Zephyr REQUIRED HINTS $ENV{ZEPHYR_BASE})
project(app_install)

# Identity bound into the manifest of the bundled reference app. Uploaded apps
# are signed on the host with the same key and verified against the trusted key
# table compiled into this build.
set(APP_NAME    "uploaded")
set(APP_VERSION 1)
set(APP_REQUESTED_CAPS LOG,RANDOM)
set(APP_REQUIRED_CAPS  LOG)

target_sources(app PRIVATE src/main.c)

set(ext_src ${PROJECT_SOURCE_DIR}/module/src/install_app.c)
set(bin ${PROJECT_BINARY_DIR}/llext/install_app.llext)
set(inc ${ZEPHYR_BINARY_DIR}/include/generated/install_app.inc)
set(mf  ${ZEPHYR_BINARY_DIR}/include/generated/install_app.manifest.inc)
set(sig ${ZEPHYR_BINARY_DIR}/include/generated/install_app.sig.inc)
set(bundle_dir ${PROJECT_BINARY_DIR}/bundle)
set(bundle_ext ${bundle_dir}/${APP_NAME}.llext)
set(bundle_mf  ${bundle_dir}/${APP_NAME}.manifest)

app_platform_add_module(install_ext OUTPUT ${bin} SOURCES ${ext_src})
llext_include_directories(install_ext ${ZEPHYR_BINARY_DIR}/include/generated)
generate_inc_file_for_target(app ${bin} ${inc})

# Sign a manifest binding the name, version and module hash; embed the
# manifest and signature. The same key signs apps uploaded
# from the host. The module and its signed manifest are also written to the
# bundle directory, which "west app install" uploads. The private key is
# generated once and never compiled in.
add_custom_command(
  OUTPUT  ${mf} ${sig} ${bundle_ext} ${bundle_mf}
  COMMAND ${CMAKE_COMMAND} -E make_directory ${bundle_dir}
  COMMAND ${CMAKE_COMMAND} -E copy ${bin} ${bundle_ext}
  COMMAND ${CMAKE_COMMAND}
    -DMODULE_BIN=${bin}
    -DKEY_DIR=${CMAKE_CURRENT_SOURCE_DIR}/keys
    -DAPP_NAME=${APP_NAME}
    -DAPP_VERSION=${APP_VERSION}
    -DAPP_REQUESTED_CAPS=${APP_REQUESTED_CAPS}
    -DAPP_REQUIRED_CAPS=${APP_REQUIRED_CAPS}
    -DABI_FILE=${APP_PLATFORM_ABI_FILE}
    -DOUT_MF_INC=${mf}
    -DOUT_SIG_INC=${sig}
    -DOUT_MANIFEST=${bundle_mf}
    -DPYTHON_EXECUTABLE=${PYTHON_EXECUTABLE}
    -P ${ZEPHYR_BASE}/subsys/app_platform/cmake/sign_module.cmake
  DEPENDS ${bin} ${APP_PLATFORM_ABI_FILE}
)
add_custom_target(install_sign DEPENDS ${mf} ${sig} ${bundle_ext} ${bundle_mf})
add_dependencies(install_sign app_platform_abi)
add_dependencies(app install_sign)
```

## prj.conf
```kconfig
CONFIG_APPLICATION_DEFINED_SYSCALL=y

CONFIG_APP_PLATFORM=y
CONFIG_APP_PLATFORM_MAX_APPS=4
CONFIG_APP_PLATFORM_LOADER=y
# Modules are signed with the development key, generated under keys/.
CONFIG_APP_PLATFORM_DEV_KEY=y
CONFIG_APP_PLATFORM_SERVICES=y
CONFIG_APP_PLATFORM_REGISTRY=y

CONFIG_TASK_WDT=y
CONFIG_TASK_WDT_CHANNELS=6
CONFIG_TASK_WDT_HW_FALLBACK=n

CONFIG_LLEXT=y
CONFIG_LLEXT_HEAP_SIZE=64
CONFIG_LLEXT_TYPE_ELF_RELOCATABLE=y

# Persistent storage for uploaded apps + registry.
CONFIG_FLASH=y
CONFIG_FLASH_MAP=y
CONFIG_FILE_SYSTEM=y
CONFIG_FILE_SYSTEM_LITTLEFS=y

# Shell on uart0, with mcumgr file transfer and shell command execution
# carried over the same shell so a host can upload and install a signed app
# over one serial cable.
CONFIG_SHELL=y
CONFIG_SHELL_BACKEND_SERIAL=y
CONFIG_BASE64=y
CONFIG_CRC=y
CONFIG_NET_BUF=y
CONFIG_MCUMGR=y
CONFIG_MCUMGR_TRANSPORT_SHELL=y
CONFIG_MCUMGR_GRP_FS=y
CONFIG_SHELL_BACKEND_DUMMY=y
CONFIG_MCUMGR_GRP_SHELL=y
CONFIG_SHELL_PROMPT_DUMMY=""
CONFIG_SHELL_DUMMY_INIT_LOG_LEVEL_NONE=y
CONFIG_MCUMGR_TRANSPORT_WORKQUEUE_STACK_SIZE=4096
CONFIG_ZCBOR=y
CONFIG_SYSTEM_WORKQUEUE_STACK_SIZE=2304

# Authenticate the uploaded module: ECDSA P-256 signature verification.
CONFIG_PSA_CRYPTO=y
CONFIG_MBEDTLS_ENABLE_HEAP=y
CONFIG_PSA_WANT_ALG_SHA_256=y
CONFIG_PSA_WANT_ALG_ECDSA=y
CONFIG_PSA_WANT_ECC_SECP_R1_256=y
CONFIG_PSA_WANT_KEY_TYPE_ECC_PUBLIC_KEY=y
CONFIG_MBEDTLS_PSA_P256M_DRIVER_ENABLED=y

CONFIG_ENTROPY_GENERATOR=y

CONFIG_LOG=y
CONFIG_THREAD_NAME=y

CONFIG_MAIN_STACK_SIZE=4096
CONFIG_HEAP_MEM_POOL_SIZE=32768
```

## boards/esp32c6_devkitc_esp32c6_hpcore.overlay
```dts
/*
 * Copyright (c) 2026 Espressif Systems (Shanghai) Co., Ltd.
 *
 * SPDX-License-Identifier: Apache-2.0
 *
 * Enlarge the storage partition for the application store. Under simple boot
 * the second firmware slot is unused, so its region is reassigned to storage,
 * growing the littlefs area from 192 KB to 1.75 MB for many or larger apps. The
 * code partition and the low-power-core slots are left untouched.
 */

/delete-node/ &slot1_partition;

&storage_partition {
	reg = <0x1e0000 DT_SIZE_K(1792)>;
};
```

## src/main.c
```c
/*
 * Copyright (c) 2026 Espressif Systems (Shanghai) Co., Ltd.
 *
 * SPDX-License-Identifier: Apache-2.0
 */

/*
 * Over-the-wire app install over a single serial cable.
 *
 * A host signs an application on a build machine, then uploads two files over
 * the shell's mcumgr transport into the device's storage:
 *   mcumgr ... fs upload app.llext     /lfs/<name>.llext.new
 *   mcumgr ... fs upload app.manifest  /lfs/<name>.manifest.new
 * The shell command "store install <name>" then verifies the signed manifest
 * against the public key compiled into the firmware, binds the module to it,
 * moves both over the installed copies unless that would be a downgrade,
 * records it in the registry, and launches it as an isolated user-mode app -
 * streamed from flash, never held whole in RAM. "store list" shows what is
 * installed. The same cable carries both the upload and the shell, so no extra
 * wiring or second port is needed.
 */

#include <zephyr/app_platform/app_platform.h>
#include <zephyr/app_platform/app_loader.h>
#include <zephyr/app_platform/app_registry.h>
#include <zephyr/app_platform/app_manifest.h>
#include <zephyr/app_platform/app_caps.h>
#include <zephyr/kernel.h>
#include <zephyr/shell/shell.h>
#include <zephyr/fs/fs.h>
#include <string.h>

/* The most a loaded application may hold; its manifest requests its own. */
#define APP_CAPS_CEILING (APP_CAP_LOG | APP_CAP_TIME | APP_CAP_RANDOM)

static int cmd_install(const struct shell *sh, size_t argc, char **argv)
{
	const char *name = argv[1];
	union app_manifest_buf mb;
	const struct app_manifest *mf = &mb.mf;
	size_t mf_len = 0;
	uint8_t sig[APP_MANIFEST_SIG_LEN];

	if (app_registry_load_staged_manifest(name, &mb, &mf_len, sig, sizeof(sig)) != 0) {
		shell_error(sh, "no uploaded manifest for '%s' "
			    "(upload /lfs/%s.manifest.new first)", name, name);
		return -ENOENT;
	}
	if (strncmp(mf->name, name, APP_MANIFEST_NAME_MAX) != 0) {
		shell_error(sh, "manifest names '%s', not '%s' - refused",
			    mf->name, name);
		app_registry_discard(name);
		return -EPERM;
	}

	char path[64];

	if (app_registry_staged_blob_path(name, path, sizeof(path)) != 0) {
		shell_error(sh, "bad path");
		return -EINVAL;
	}

	struct llext *ext = NULL;
	void *entry = NULL;
	int rc = app_loader_verify_load_manifest_file(mf, mf_len, sig, APP_MANIFEST_SIG_LEN, path,
						      "app_main", &ext, &entry);

	if (rc != 0) {
		shell_error(sh, "verify/load failed (%d) - install rejected", rc);
		app_registry_discard(name);
		return rc;
	}

	rc = app_registry_commit(name, true, mf);
	if (rc != 0) {
		shell_error(sh, "install refused (%d)", rc);
		app_loader_forget(ext);
		llext_unload(&ext);
		return rc;
	}

	rc = app_platform_launch_llext(mf->name, ext, (app_entry_t)entry, NULL,
				       APP_CAPS_CEILING);
	if (rc < 0) {
		shell_error(sh, "launch refused (%d)", rc);
		return rc;
	}
	shell_print(sh, "installed and launched '%s' v%u (isolated app %d)",
		    mf->name, mf->version, rc);
	return 0;
}

static int cmd_list(const struct shell *sh, size_t argc, char **argv)
{
	int n = app_registry_count();

	if (n == 0) {
		shell_print(sh, "no apps installed");
		return 0;
	}
	for (int i = 0; i < n; i++) {
		struct app_record r;

		if (app_registry_get(i, &r) == 0) {
			shell_print(sh, "  %s  v%u%s", r.name, r.version,
				    r.autostart ? "  (autostart)" : "");
		}
	}
	return 0;
}

SHELL_STATIC_SUBCMD_SET_CREATE(store_cmds,
	SHELL_CMD_ARG(install, NULL, "install <name>: verify+launch an uploaded app",
		      cmd_install, 2, 0),
	SHELL_CMD(list, NULL, "list installed apps", cmd_list),
	SHELL_SUBCMD_SET_END);
SHELL_CMD_REGISTER(store, &store_cmds, "App store: install uploaded apps", NULL);

int main(void)
{
	printk("\n*** over-the-wire app install (C5) ***\n");

	if (app_platform_init() != 0) {
		printk("platform init failed\n");
		return 0;
	}
	if (app_registry_load() != 0) {
		printk("registry load failed\n");
		return 0;
	}
	printk("ready. upload a signed app, then: store install <name>\n");
	return 0;
}
```
