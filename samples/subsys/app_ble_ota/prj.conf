## CMakeLists.txt
```
# SPDX-License-Identifier: Apache-2.0

cmake_minimum_required(VERSION 3.20.0)
find_package(Zephyr REQUIRED HINTS $ENV{ZEPHYR_BASE})
project(app_ble_ota)

target_sources(app PRIVATE src/main.c)

# The fetcher runs on this device: embedded with its hash, like any built-in.
set(f_src ${PROJECT_SOURCE_DIR}/module/src/fetcher_app.c)
set(f_bin ${PROJECT_BINARY_DIR}/llext/fetcher_app.llext)
set(f_inc ${ZEPHYR_BINARY_DIR}/include/generated/fetcher_app.inc)
set(f_sha ${ZEPHYR_BINARY_DIR}/include/generated/fetcher_app.sha256.inc)

app_platform_add_module(fetcher_ext OUTPUT ${f_bin} SOURCES ${f_src})
llext_include_directories(fetcher_ext ${ZEPHYR_BINARY_DIR}/include/generated)
generate_inc_file_for_target(app ${f_bin} ${f_inc})

add_custom_command(
  OUTPUT  ${f_sha}
  COMMAND ${CMAKE_COMMAND}
    -DMODULE_BIN=${f_bin}
    -DOUT_INC=${f_sha}
    -P ${CMAKE_CURRENT_SOURCE_DIR}/cmake/gen_sha256_inc.cmake
  DEPENDS ${f_bin}
)
add_custom_target(fetcher_sha DEPENDS ${f_sha})
add_dependencies(app fetcher_sha)

# The application the peer serves is built HERE, not on the peer, because a
# module that calls platform services is only valid for the syscall table of
# the build that produced it. The result is left in the build tree for the peer
# to pick up and sign:
#
#   west build -b <peer board> samples/subsys/app_ble_ota/peer -- \
#           -DOTA_MODULE=${CMAKE_BINARY_DIR}/llext/ota_app.llext
#
# It is deliberately not embedded in this image: the point of the sample is
# that the application arrives over the air.
set(o_src ${PROJECT_SOURCE_DIR}/module/src/ota_app.c)
set(o_bin ${PROJECT_BINARY_DIR}/llext/ota_app.llext)

app_platform_add_module(ota_ext OUTPUT ${o_bin} SOURCES ${o_src})
llext_include_directories(ota_ext ${ZEPHYR_BINARY_DIR}/include/generated)
add_dependencies(app ota_ext)
```

## prj.conf
```kconfig
CONFIG_APPLICATION_DEFINED_SYSCALL=y

CONFIG_APP_PLATFORM=y
CONFIG_APP_PLATFORM_MAX_APPS=4
CONFIG_APP_PLATFORM_LOADER=y
# Modules are signed with the development key, generated under keys/.
CONFIG_APP_PLATFORM_DEV_KEY=y
CONFIG_APP_PLATFORM_SERVICES=y
CONFIG_APP_PLATFORM_REGISTRY=y

CONFIG_TASK_WDT=y
CONFIG_TASK_WDT_CHANNELS=6
CONFIG_TASK_WDT_HW_FALLBACK=n

CONFIG_LLEXT=y
CONFIG_LLEXT_HEAP_SIZE=48
CONFIG_LLEXT_TYPE_ELF_RELOCATABLE=y

# Storage for the fetched app + registry.
CONFIG_FLASH=y
CONFIG_FLASH_MAP=y
CONFIG_FILE_SYSTEM=y
CONFIG_FILE_SYSTEM_LITTLEFS=y

# Authenticate the fetched app: ECDSA P-256 signature verification.
CONFIG_PSA_CRYPTO=y
CONFIG_MBEDTLS_ENABLE_HEAP=y
CONFIG_PSA_WANT_ALG_SHA_256=y
CONFIG_PSA_WANT_ALG_ECDSA=y
CONFIG_PSA_WANT_ECC_SECP_R1_256=y
CONFIG_PSA_WANT_KEY_TYPE_ECC_PUBLIC_KEY=y
CONFIG_MBEDTLS_PSA_P256M_DRIVER_ENABLED=y

CONFIG_ENTROPY_GENERATOR=y

CONFIG_LOG=y
CONFIG_THREAD_NAME=y

CONFIG_MAIN_STACK_SIZE=6144
CONFIG_HEAP_MEM_POOL_SIZE=16384

# BLE central: the device pulls the image from the peer.
CONFIG_BT=y
CONFIG_BT_CENTRAL=y
CONFIG_BT_OBSERVER=y
CONFIG_BT_GATT_CLIENT=y
CONFIG_BT_DEVICE_NAME="c5-ota-device"
CONFIG_APP_PLATFORM_BLE=y
CONFIG_APP_PLATFORM_BLE_OTA=y

# A 23-byte MTU would move the image 20 bytes at a time.
CONFIG_BT_BUF_ACL_RX_SIZE=251
CONFIG_BT_L2CAP_TX_MTU=247
CONFIG_BT_ATT_PREPARE_COUNT=2
```

## src/main.c
```c
/*
 * Copyright (c) 2026 Espressif Systems (Shanghai) Co., Ltd.
 *
 * SPDX-License-Identifier: Apache-2.0
 */

/*
 * Updating an application over BLE, for a device with no network connection.
 *
 * A peer board hosts one signed application (see the peer/ directory). This
 * device runs a fetcher application that holds APP_CAP_BLE and asks the
 * platform to pull the image; the platform writes the manifest, signature and
 * module straight to flash without the fetcher ever seeing them.
 *
 * The supervisor then verifies the signature against the public key compiled
 * in here, installs the application in the registry and launches it. The
 * transport is untrusted throughout: a peer that serves tampered bytes, an
 * unsigned image or a manifest naming a different application is rejected by
 * the same check an HTTP download goes through.
 */

#include <zephyr/app_platform/app_platform.h>
#include <zephyr/app_platform/app_loader.h>
#include <zephyr/app_platform/app_registry.h>
#include <zephyr/app_platform/app_manifest.h>
#include <zephyr/app_platform/app_caps.h>
#include <zephyr/kernel.h>
#include <zephyr/sys/printk.h>
#include <zephyr/fs/fs.h>
#include <string.h>

static const uint8_t fetcher_app[] __aligned(8) = {
#include "fetcher_app.inc"
};
static const uint8_t fetcher_hash[32] = {
#include "fetcher_app.sha256.inc"
};

/*
 * The fetcher needs BLE and nothing else. FETCHED_CAPS is the most the
 * application that arrives may hold, whatever its manifest requests, and
 * notably not BLE: what was updated over the air cannot itself reach the peer.
 */
#define FETCHER_CAPS (APP_CAP_LOG | APP_CAP_TIME | APP_CAP_BLE)
#define FETCHED_CAPS (APP_CAP_LOG | APP_CAP_TIME | APP_CAP_RANDOM)

#define APP_NAME "weather"

/* Verify what the transport staged, then install and launch it. */
static int install_fetched(const char *name)
{
	union app_manifest_buf mb;
	const struct app_manifest *mf = &mb.mf;
	size_t mf_len = 0;
	uint8_t sig[APP_MANIFEST_SIG_LEN];
	char path[64];

	if (app_registry_load_staged_manifest(name, &mb, &mf_len, sig, sizeof(sig)) != 0) {
		printk("no manifest staged for '%s'\n", name);
		app_registry_discard(name);
		return -ENOENT;
	}
	if (app_registry_staged_blob_path(name, path, sizeof(path)) != 0) {
		return -ENAMETOOLONG;
	}

	struct llext *ext = NULL;
	void *entry = NULL;
	int64_t t0 = k_uptime_get();
	int rc = app_loader_verify_load_manifest_file(mf, mf_len, sig, APP_MANIFEST_SIG_LEN, path,
						      "app_main", &ext, &entry);

	if (rc != 0) {
		printk("verify/load failed (%d) - update rejected\n", rc);
		app_registry_discard(name);
		return rc;
	}
	printk("verified '%s' v%u in %lld ms\n", mf->name, mf->version,
	       k_uptime_get() - t0);

	rc = app_registry_commit(name, true, mf);
	if (rc != 0) {
		printk("install refused (%d)\n", rc);
		app_loader_forget(ext);
		llext_unload(&ext);
		return rc;
	}

	rc = app_platform_launch_llext(mf->name, ext, (app_entry_t)entry, NULL,
				       FETCHED_CAPS);
	if (rc < 0) {
		printk("launch refused (%d)\n", rc);
		return rc;
	}
	printk("updated over BLE: '%s' v%u running as app %d\n", mf->name,
	       mf->version, rc);
	return 0;
}

int main(void)
{
	printk("\n*** application update over BLE ***\n");

	if (app_platform_init() != 0 || app_registry_load() != 0) {
		printk("platform init failed\n");
		return 0;
	}

	struct llext *ext = NULL;
	void *entry = NULL;
	int rc = app_loader_verify_load("fetcher", fetcher_app,
					ARRAY_SIZE(fetcher_app), fetcher_hash,
					"app_main", &ext, &entry);

	if (rc == 0) {
		rc = app_platform_launch_llext("fetcher", ext,
					       (app_entry_t)entry, NULL, FETCHER_CAPS);
	}
	if (rc < 0) {
		printk("fetcher app failed to start (%d)\n", rc);
		return 0;
	}
	int fetcher_id = rc;

	printk("fetcher running as app %d; pulling '%s' from the peer...\n",
	       rc, APP_NAME);

	/* Wait for this run's transfer to finish: any staged leftover is
	 * dropped first, so the staged file reappearing means the fetch ran.
	 */
	char path[64];

	if (app_registry_staged_blob_path(APP_NAME, path, sizeof(path)) != 0) {
		return 0;
	}
	app_registry_discard(APP_NAME);

	for (int i = 0; i < 60; i++) {
		struct fs_dirent st;

		k_msleep(1000);
		if (fs_stat(path, &st) != 0 || st.size == 0) {
			continue;
		}
		/* Present and no longer growing: the transfer is done. */
		off_t len = st.size;

		k_msleep(1000);
		if (fs_stat(path, &st) == 0 && st.size == len) {
			/* The fetcher has done its job. Reclaim it before the
			 * new application is loaded so the update does not
			 * need room for both at once.
			 */
			(void)app_platform_remove(fetcher_id);
			k_msleep(200);
			(void)install_fetched(APP_NAME);
			return 0;
		}
	}
	printk("no image arrived from the peer\n");
	return 0;
}
```
