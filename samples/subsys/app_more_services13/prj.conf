## CMakeLists.txt
```
# SPDX-License-Identifier: Apache-2.0

cmake_minimum_required(VERSION 3.20.0)
find_package(Zephyr REQUIRED HINTS $ENV{ZEPHYR_BASE})
project(app_more_services13)

zephyr_syscall_header(${CMAKE_CURRENT_SOURCE_DIR}/src/svc.h)

target_sources(app PRIVATE src/main.c src/svc.c)
```

## prj.conf
```kconfig
CONFIG_USERSPACE=y
CONFIG_APPLICATION_DEFINED_SYSCALL=y

CONFIG_DMA=y

CONFIG_LOG=y
CONFIG_LOG_MODE_MINIMAL=y
CONFIG_THREAD_NAME=y

CONFIG_MAIN_STACK_SIZE=4096
```

## boards/esp32c5_devkitc_esp32c5_hpcore.overlay
```dts
/*
 * Copyright (c) 2026 Espressif Systems (Shanghai) Co., Ltd.
 *
 * SPDX-License-Identifier: Apache-2.0
 */

&dma {
	status = "okay";
};
```

## boards/esp32c6_devkitc_esp32c6_hpcore.overlay
```dts
/*
 * Copyright (c) 2026 Espressif Systems (Shanghai) Co., Ltd.
 *
 * SPDX-License-Identifier: Apache-2.0
 */

/* Enable the GDMA controller for the memory-copy service. */
&dma {
	status = "okay";
};
```

## src/main.c
```c
/*
 * Copyright (c) 2026 Espressif Systems (Shanghai) Co., Ltd.
 *
 * SPDX-License-Identifier: Apache-2.0
 */

/*
 * An app using a hardware DMA memory copy through services from user mode. The
 * platform owns the GDMA channel and the DMA-capable buffers; the app hands over
 * a pattern to copy and checks the result came back intact, never touching the
 * DMA engine directly.
 */

#include "svc.h"

#include <zephyr/kernel.h>
#include <zephyr/sys/printk.h>
#include <string.h>

#define STACK_SIZE 2048
#define APP_PRIO   5

K_THREAD_STACK_DEFINE(app_stack, STACK_SIZE);
static struct k_thread app_thread;

static void app_entry(void *p1, void *p2, void *p3)
{
	ARG_UNUSED(p1); ARG_UNUSED(p2); ARG_UNUSED(p3);

	for (int round = 0; round < 3; round++) {
		uint8_t in[32];
		uint8_t out[32] = { 0 };

		for (int i = 0; i < (int)sizeof(in); i++) {
			in[i] = (uint8_t)(round * 16 + i);
		}

		int rc = svc_dma_copy(in, out, sizeof(in));
		bool match = (rc == (int)sizeof(in)) &&
			     (memcmp(in, out, sizeof(in)) == 0);

		printk("  [app] round %d: dma copy rc=%d, first=%02x last=%02x, match=%d\n",
		       round, rc, out[0], out[sizeof(out) - 1], match);

		k_msleep(200);
	}

	printk("  [app] done - copied buffers via hardware DMA\n");
}

int main(void)
{
	printk("\n*** more services 13: hardware DMA copy (C6) ***\n");

	int rc = svc_dma_install();

	printk("  [platform] dma channel install rc=%d\n", rc);

	k_tid_t t = k_thread_create(&app_thread, app_stack, STACK_SIZE, app_entry,
				    NULL, NULL, NULL, APP_PRIO, K_USER, K_FOREVER);

	k_thread_start(t);
	k_thread_join(t, K_FOREVER);

	printk("\n*** done ***\n");
	return 0;
}
```

## src/svc.c
```c
/*
 * Copyright (c) 2026 Espressif Systems (Shanghai) Co., Ltd.
 *
 * SPDX-License-Identifier: Apache-2.0
 */

#include "svc.h"

#include <zephyr/kernel.h>
#include <zephyr/device.h>
#include <zephyr/drivers/dma.h>
#include <zephyr/internal/syscall_handler.h>
#include <zephyr/cache.h>
#include <string.h>
#include <errno.h>

#define DMA_MAX  256
#define DMA_CHAN 0U

/* The platform owns the GDMA controller and the DMA-capable staging buffers. */
static const struct device *const dma = DEVICE_DT_GET(DT_NODELABEL(dma));
static const uint32_t dma_chan = DMA_CHAN;

/* Cache-line aligned so the DMA and CPU views stay coherent on flush/invalidate. */
static uint8_t src_buf[DMA_MAX] __aligned(64);
static uint8_t dst_buf[DMA_MAX] __aligned(64);

static struct k_sem done_sem;

static void dma_done(const struct device *d, void *arg, uint32_t chan, int status)
{
	ARG_UNUSED(d); ARG_UNUSED(arg); ARG_UNUSED(chan); ARG_UNUSED(status);
	k_sem_give(&done_sem);
}

int svc_dma_install(void)
{
	if (!device_is_ready(dma)) {
		return -ENODEV;
	}
	k_sem_init(&done_sem, 0, 1);
	return 0;
}

int z_impl_svc_dma_copy(const uint8_t *src, uint8_t *dst, size_t len)
{
	if (!device_is_ready(dma) || len == 0U || len > DMA_MAX) {
		return -EINVAL;
	}

	memcpy(src_buf, src, len);
	sys_cache_data_flush_range(src_buf, len);

	struct dma_block_config blk = {
		.source_address = (uint32_t)src_buf,
		.dest_address = (uint32_t)dst_buf,
		.block_size = len,
	};
	struct dma_config cfg = {
		.channel_direction = MEMORY_TO_MEMORY,
		.source_data_size = 1U,
		.dest_data_size = 1U,
		.source_burst_length = 1U,
		.dest_burst_length = 1U,
		.block_count = 1U,
		.head_block = &blk,
		.dma_callback = dma_done,
		.complete_callback_en = 0U,
	};

	int rc = dma_config(dma, dma_chan, &cfg);

	if (rc != 0) {
		return rc;
	}

	k_sem_reset(&done_sem);
	rc = dma_start(dma, dma_chan);
	if (rc != 0) {
		return rc;
	}

	if (k_sem_take(&done_sem, K_MSEC(100)) != 0) {
		return -ETIMEDOUT;
	}

	sys_cache_data_invd_range(dst_buf, len);
	memcpy(dst, dst_buf, len);
	return (int)len;
}

#ifdef CONFIG_USERSPACE
static inline int z_vrfy_svc_dma_copy(const uint8_t *src, uint8_t *dst, size_t len)
{
	if (len == 0U || len > DMA_MAX) {
		return -EINVAL;
	}
	K_OOPS(K_SYSCALL_MEMORY_READ(src, len));
	K_OOPS(K_SYSCALL_MEMORY_WRITE(dst, len));
	return z_impl_svc_dma_copy(src, dst, len);
}
#include <zephyr/syscalls/svc_dma_copy_mrsh.c>
#endif
```

## src/svc.h
```c
/*
 * Copyright (c) 2026 Espressif Systems (Shanghai) Co., Ltd.
 *
 * SPDX-License-Identifier: Apache-2.0
 */

#ifndef APP_MORE_SERVICES13_SVC_H_
#define APP_MORE_SERVICES13_SVC_H_

#include <zephyr/kernel.h>

/*
 * A thirteenth batch: a hardware DMA memory-copy service. The platform owns a
 * GDMA channel and the DMA-capable source and destination buffers. The app hands
 * over bytes to copy; the supervisor stages them, runs a memory-to-memory DMA
 * transfer, and returns the result. The app never touches the DMA engine or its
 * buffers directly.
 *
 *   svc_dma_copy - DMA-copy @len bytes from @src into @dst via hardware.
 */

/* Scoped: hardware DMA copy of @len bytes from @src to @dst. */
__syscall int svc_dma_copy(const uint8_t *src, uint8_t *dst, size_t len);

/* Supervisor-only: bind the DMA channel before launching the app. */
int svc_dma_install(void);

#include <zephyr/syscalls/svc.h>

#endif /* APP_MORE_SERVICES13_SVC_H_ */
```
