## CMakeLists.txt
```
# SPDX-License-Identifier: Apache-2.0

cmake_minimum_required(VERSION 3.20.0)
find_package(Zephyr REQUIRED HINTS $ENV{ZEPHYR_BASE})
project(app_ble_llext)

target_sources(app PRIVATE
  src/main.c
)

# Build the peripheral as a loadable llext, embedded and SHA-256 verified.
set(ext_src ${PROJECT_SOURCE_DIR}/module/src/ble_llext_app.c)
set(bin ${PROJECT_BINARY_DIR}/llext/ble_llext_app.llext)
set(inc ${ZEPHYR_BINARY_DIR}/include/generated/ble_llext_app.inc)
set(sha ${ZEPHYR_BINARY_DIR}/include/generated/ble_llext_app.sha256.inc)

app_platform_add_module(ble_llext_app_ext OUTPUT ${bin} SOURCES ${ext_src})
llext_include_directories(ble_llext_app_ext
  ${ZEPHYR_BINARY_DIR}/include/generated
)
generate_inc_file_for_target(app ${bin} ${inc})

add_custom_command(
  OUTPUT ${sha}
  COMMAND ${CMAKE_COMMAND}
    -DMODULE_BIN=${bin}
    -DOUT_INC=${sha}
    -P ${CMAKE_CURRENT_SOURCE_DIR}/cmake/gen_sha256_inc.cmake
  DEPENDS ${bin}
)
add_custom_target(ble_llext_app_sha DEPENDS ${sha})
add_dependencies(app ble_llext_app_sha)
```

## prj.conf
```kconfig
CONFIG_APPLICATION_DEFINED_SYSCALL=y

CONFIG_APP_PLATFORM=y
CONFIG_APP_PLATFORM_MAX_APPS=2
CONFIG_APP_PLATFORM_SERVICES=y
CONFIG_APP_PLATFORM_IO=y
CONFIG_APP_PLATFORM_BLE=y
CONFIG_APP_PLATFORM_BLE_GATT=y
CONFIG_APP_PLATFORM_BLE_SERVE=y
CONFIG_APP_PLATFORM_EVENTS=y
CONFIG_APP_PLATFORM_LOADER=y

CONFIG_ENTROPY_GENERATOR=y

CONFIG_TASK_WDT=y
CONFIG_TASK_WDT_CHANNELS=6

CONFIG_LOG=y
CONFIG_THREAD_NAME=y

CONFIG_MAIN_STACK_SIZE=4096
# Registering the service and advertising run on these stacks.
CONFIG_APP_PLATFORM_SUPERVISOR_STACK_SIZE=4096
CONFIG_APP_PLATFORM_APP_STACK_SIZE=4096

CONFIG_BT=y
CONFIG_BT_PERIPHERAL=y
CONFIG_BT_GATT_SERVICE_CHANGED=y
CONFIG_BT_GATT_DYNAMIC_DB=y
CONFIG_BT_CENTRAL=y
CONFIG_BT_OBSERVER=y
CONFIG_BT_GATT_CLIENT=y
CONFIG_BT_DEVICE_NAME="c5-app"
CONFIG_BT_L2CAP_TX_MTU=247
CONFIG_BT_BUF_ACL_RX_SIZE=251
# One slot is taken by the client role the platform also builds in.
CONFIG_BT_MAX_CONN=2

CONFIG_LLEXT=y
CONFIG_LLEXT_HEAP_SIZE=24
CONFIG_LLEXT_TYPE_ELF_RELOCATABLE=y

CONFIG_PSA_CRYPTO=y
CONFIG_MBEDTLS_ENABLE_HEAP=y
CONFIG_PSA_WANT_ALG_SHA_256=y
```

## src/main.c
```c
/*
 * Copyright (c) 2026 Espressif Systems (Shanghai) Co., Ltd.
 *
 * SPDX-License-Identifier: Apache-2.0
 */

#include <zephyr/app_platform/app_platform.h>
#include <zephyr/app_platform/app_services.h>
#include <zephyr/app_platform/app_caps.h>
#include <zephyr/app_platform/app_loader.h>
#include <zephyr/kernel.h>
#include <zephyr/sys/printk.h>

static const uint8_t ble_llext_app[] __aligned(8) = {
#include "ble_llext_app.inc"
};
static const uint8_t ble_llext_app_hash[] = {
#include "ble_llext_app.sha256.inc"
};

/* The service the application is allowed to serve. It must match the UUID the
 * module passes to app_svc_ble_serve_start().
 */
static const uint8_t svc_uuid[16] = {
	0xab, 0x89, 0x67, 0x45, 0x23, 0x01, 0x7d, 0x8c,
	0x5b, 0x4a, 0x44, 0x44, 0xa0, 0xc3, 0xb2, 0xa1,
};

int main(void)
{
	const struct app_launch_opts opts = { .stopped = true };
	struct llext *ext = NULL;
	void *entry = NULL;
	int rc;

	if (app_platform_init() != 0) {
		printk("platform init failed\n");
		return 0;
	}

	rc = app_loader_verify_load("ble_llext", ble_llext_app, ARRAY_SIZE(ble_llext_app),
				    ble_llext_app_hash, "app_main", &ext, &entry);
	if (rc != 0) {
		printk("module load failed (%d)\n", rc);
		return 0;
	}

	rc = app_platform_launch_llext_opts("ble_llext", ext, (app_entry_t)entry, NULL,
					    APP_CAP_LOG | APP_CAP_BLE | APP_CAP_INPUT, &opts);
	if (rc < 0) {
		printk("launch failed (%d)\n", rc);
		return 0;
	}

	app_platform_grant_ble_gatt(rc, svc_uuid, sizeof(svc_uuid));
	(void)app_platform_start(rc);
	printk("launched loadable peripheral app %d\n", rc);
	return 0;
}
```
