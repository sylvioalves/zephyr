## CMakeLists.txt
```
# SPDX-License-Identifier: Apache-2.0

cmake_minimum_required(VERSION 3.20.0)
find_package(Zephyr REQUIRED HINTS $ENV{ZEPHYR_BASE})
project(app_i2c_scoped)

zephyr_syscall_header(${CMAKE_CURRENT_SOURCE_DIR}/src/i2c_svc.h)

target_sources(app PRIVATE src/main.c src/i2c_svc.c)
```

## prj.conf
```kconfig
CONFIG_USERSPACE=y
CONFIG_APPLICATION_DEFINED_SYSCALL=y

CONFIG_I2C=y

CONFIG_LOG=y
CONFIG_LOG_MODE_MINIMAL=y
CONFIG_THREAD_NAME=y

CONFIG_MAIN_STACK_SIZE=4096
```

## boards/esp32c6_devkitc_esp32c6_hpcore.overlay
```dts
/*
 * Copyright (c) 2026 Espressif Systems (Shanghai) Co., Ltd.
 *
 * SPDX-License-Identifier: Apache-2.0
 */

/* The platform owns i2c0; apps reach devices on it only via the broker. */
&i2c0 {
	status = "okay";
};
```

## boards/qemu_riscv32.overlay
```dts
/*
 * Copyright (c) 2026 Espressif Systems (Shanghai) Co., Ltd.
 *
 * SPDX-License-Identifier: Apache-2.0
 */

#include <zephyr/dt-bindings/i2c/i2c.h>

/* QEMU has no I2C controller: stand in an emulated bus with nothing attached,
 * so the granted read reaches the bus and fails there.
 */
/ {
	i2c0: i2c@100 {
		compatible = "zephyr,i2c-emul-controller";
		reg = <0x100 4>;
		#address-cells = <1>;
		#size-cells = <0>;
		clock-frequency = <I2C_BITRATE_STANDARD>;
		status = "okay";
	};
};
```

## src/main.c
```c
/*
 * Copyright (c) 2026 Espressif Systems (Shanghai) Co., Ltd.
 *
 * SPDX-License-Identifier: Apache-2.0
 */

/*
 * Scoped I2C capability demo. An app is granted I2C bus 0 at address 0x48 only.
 * Reading 0x48 is allowed (the broker proceeds to the bus); reading any other
 * address is denied at the broker before any bus transaction. The bus is shared
 * platform infrastructure; the app holds a narrow, manifest-defined slice.
 */

#include "i2c_svc.h"

#include <zephyr/kernel.h>
#include <zephyr/sys/printk.h>

#define STACK_SIZE 2048
#define APP_PRIO   5

#define GRANTED_ADDR   0x48
#define FORBIDDEN_ADDR 0x50

K_THREAD_STACK_DEFINE(app_stack, STACK_SIZE);
static struct k_thread app_thread;

static void app_entry(void *p1, void *p2, void *p3)
{
	ARG_UNUSED(p1); ARG_UNUSED(p2); ARG_UNUSED(p3);

	printk("  [app] reading my granted sensor at i2c0 0x%02x...\n",
	       GRANTED_ADDR);
	int rc = app_i2c_read(0, GRANTED_ADDR, 0x00);

	printk("  [app] granted-address read returned %d\n", rc);

	printk("  [app] now trying a DIFFERENT address 0x%02x (a system chip)...\n",
	       FORBIDDEN_ADDR);
	rc = app_i2c_read(0, FORBIDDEN_ADDR, 0x00);
	printk("  [app] forbidden-address read returned %d (%s)\n", rc,
	       rc == -EPERM ? "DENIED, as expected" : "unexpected");
}

int main(void)
{
	printk("\n*** scoped I2C capability: app gets bus0 0x48 only (C6) ***\n");

	k_tid_t t = k_thread_create(&app_thread, app_stack, STACK_SIZE, app_entry,
				    NULL, NULL, NULL, APP_PRIO, K_USER, K_FOREVER);

	/* The app's manifest grants exactly one (bus, addr): i2c0 @ 0x48. */
	i2c_grant(t, 0, GRANTED_ADDR);

	k_thread_start(t);
	k_thread_join(t, K_FOREVER);

	printk("\n*** done: app could use only its granted address; others denied ***\n");
	return 0;
}
```

## src/i2c_svc.c
```c
/*
 * Copyright (c) 2026 Espressif Systems (Shanghai) Co., Ltd.
 *
 * SPDX-License-Identifier: Apache-2.0
 */

#include "i2c_svc.h"

#include <zephyr/kernel.h>
#include <zephyr/device.h>
#include <zephyr/drivers/i2c.h>
#include <zephyr/internal/syscall_handler.h>

/* The platform owns the bus controller (from devicetree). */
static const struct device *const bus0 = DEVICE_DT_GET(DT_NODELABEL(i2c0));

/* Per-app manifest grants: which (bus, addr) each app thread may touch. */
struct i2c_grant_entry {
	k_tid_t  tid;
	uint8_t  bus;
	uint16_t addr;
};

#define MAX_GRANTS 8
static struct i2c_grant_entry grants[MAX_GRANTS];

void i2c_grant(k_tid_t tid, uint8_t bus, uint16_t addr)
{
	for (int i = 0; i < MAX_GRANTS; i++) {
		if (grants[i].tid == NULL) {
			grants[i].tid = tid;
			grants[i].bus = bus;
			grants[i].addr = addr;
			return;
		}
	}
}

static bool granted(k_tid_t tid, uint8_t bus, uint16_t addr)
{
	for (int i = 0; i < MAX_GRANTS; i++) {
		if (grants[i].tid == tid && grants[i].bus == bus &&
		    grants[i].addr == addr) {
			return true;
		}
	}
	return false;
}

int z_impl_app_i2c_read(uint8_t bus, uint16_t addr, uint8_t reg)
{
	/* Enforce the manifest scope BEFORE any bus access. */
	if (!granted(k_current_get(), bus, addr)) {
		printk("    [i2c-broker] DENIED app i2c%u @ 0x%02x (not in manifest)\n",
		       bus, addr);
		return -EPERM;
	}

	if (bus != 0 || !device_is_ready(bus0)) {
		return -ENODEV;
	}

	uint8_t val = 0;
	int rc = i2c_reg_read_byte(bus0, addr, reg, &val);

	printk("    [i2c-broker] GRANTED app i2c%u @ 0x%02x reg 0x%02x -> rc=%d\n",
	       bus, addr, reg, rc);
	return (rc == 0) ? val : rc;
}

#ifdef CONFIG_USERSPACE
static inline int z_vrfy_app_i2c_read(uint8_t bus, uint16_t addr, uint8_t reg)
{
	return z_impl_app_i2c_read(bus, addr, reg);
}
#include <zephyr/syscalls/app_i2c_read_mrsh.c>
#endif
```

## src/i2c_svc.h
```c
/*
 * Copyright (c) 2026 Espressif Systems (Shanghai) Co., Ltd.
 *
 * SPDX-License-Identifier: Apache-2.0
 */

#ifndef APP_I2C_SCOPED_I2C_SVC_H_
#define APP_I2C_SCOPED_I2C_SVC_H_

#include <zephyr/kernel.h>

/*
 * Scoped I2C capability - the Tier-2 service pattern. A bus is powerful: raw
 * access lets an app talk to ANY device on it, including the system's own
 * chips. So apps never get raw I2C. Instead each app's manifest grants specific
 * (bus, address) pairs, and the broker enforces the scope BEFORE any bus
 * transaction. A call to a granted address proceeds; any other address is
 * denied without ever touching the bus. CAN, SPI, UART, and flash follow the
 * same scoped-capability shape.
 */

/* Supervisor: grant an app thread access to one (bus, addr). */
void i2c_grant(k_tid_t tid, uint8_t bus, uint16_t addr);

/* App: read one register. Returns the byte (>=0), -EPERM if not granted. */
__syscall int app_i2c_read(uint8_t bus, uint16_t addr, uint8_t reg);

#include <zephyr/syscalls/i2c_svc.h>

#endif /* APP_I2C_SCOPED_I2C_SVC_H_ */
```
