## CMakeLists.txt
```
# SPDX-License-Identifier: Apache-2.0

cmake_minimum_required(VERSION 3.20.0)
find_package(Zephyr REQUIRED HINTS $ENV{ZEPHYR_BASE})
project(psram_two_apps_llext)

target_sources(app PRIVATE
  src/main.c
)

set(ext_src ${PROJECT_SOURCE_DIR}/module/src/psram_stress.c)
set(bin ${PROJECT_BINARY_DIR}/llext/psram.llext)
set(inc ${ZEPHYR_BINARY_DIR}/include/generated/psram.inc)
set(sha ${ZEPHYR_BINARY_DIR}/include/generated/psram.sha256.inc)

app_platform_add_module(psram_ext OUTPUT ${bin} SOURCES ${ext_src})
llext_include_directories(psram_ext ${ZEPHYR_BINARY_DIR}/include/generated)
generate_inc_file_for_target(app ${bin} ${inc})

add_custom_command(
  OUTPUT  ${sha}
  COMMAND ${CMAKE_COMMAND}
    -DMODULE_BIN=${bin}
    -DOUT_INC=${sha}
    -P ${CMAKE_CURRENT_SOURCE_DIR}/cmake/gen_sha256_inc.cmake
  DEPENDS ${bin}
)
add_custom_target(psram_sha DEPENDS ${sha})
add_dependencies(app psram_sha)
```

## prj.conf
```kconfig
CONFIG_APPLICATION_DEFINED_SYSCALL=y

CONFIG_APP_PLATFORM=y
CONFIG_APP_PLATFORM_MAX_APPS=4
CONFIG_APP_PLATFORM_LOADER=y
CONFIG_APP_PLATFORM_SERVICES=y
CONFIG_APP_PLATFORM_PSRAM=y

CONFIG_TASK_WDT=y
CONFIG_TASK_WDT_CHANNELS=6

CONFIG_LLEXT=y
CONFIG_LLEXT_HEAP_SIZE=64
CONFIG_LLEXT_TYPE_ELF_RELOCATABLE=y

CONFIG_PSA_CRYPTO=y
CONFIG_MBEDTLS_ENABLE_HEAP=y
CONFIG_PSA_WANT_ALG_SHA_256=y

# External RAM (PSRAM) on the C5.
CONFIG_ESP_SPIRAM=y
CONFIG_ESP_SPIRAM_SIZE=8388608
CONFIG_SHARED_MULTI_HEAP=y

CONFIG_LOG=y
CONFIG_LOG_MODE_MINIMAL=y
CONFIG_THREAD_NAME=y

CONFIG_MAIN_STACK_SIZE=4096
CONFIG_HEAP_MEM_POOL_SIZE=32768

# These apps are not monitored, so nothing feeds the task watchdog during
# the sustained stress loop; disable its hardware fallback so it cannot reset
# the device while the apps are busy.
CONFIG_TASK_WDT_HW_FALLBACK=n
```

## src/main.c
```c
/*
 * Copyright (c) 2026 Espressif Systems (Shanghai) Co., Ltd.
 *
 * SPDX-License-Identifier: Apache-2.0
 */

/*
 * Two loadable applications, each an independent instance of the same verified
 * llext module, launched as isolated user-mode apps. Each maps its own private
 * region of external RAM (PSRAM) and runs a ten-second concurrent
 * read/write/verify stress over it. The regions are private partitions of each
 * app's own memory domain and are allocated non-overlapping, so the two apps
 * hammer external RAM at the same time without interfering; any corruption
 * surfaces as a verify mismatch.
 */

#include <zephyr/app_platform/app_platform.h>
#include <zephyr/app_platform/app_loader.h>
#include <zephyr/app_platform/app_caps.h>
#include <zephyr/kernel.h>
#include <zephyr/sys/printk.h>

static const uint8_t psram_app[] __aligned(8) = {
#include "psram.inc"
};
static const uint8_t psram_hash[32] = {
#include "psram.sha256.inc"
};

#define APP_CAPS (APP_CAP_LOG | APP_CAP_TIME | APP_CAP_PSRAM)
#define STRESS_MS 10000

static int load_and_launch(const char *name)
{
	struct llext *ext = NULL;
	void *entry = NULL;
	int rc = app_loader_verify_load(name, psram_app, ARRAY_SIZE(psram_app),
					psram_hash, "app_main", &ext, &entry);

	if (rc != 0) {
		printk("install '%s' failed: %d\n", name, rc);
		return rc;
	}

	return app_platform_launch_llext(name, ext, (app_entry_t)entry, NULL, APP_CAPS);
}

int main(void)
{
	printk("\n*** two-app loadable external RAM stress (C5) ***\n");

	if (app_platform_init() != 0) {
		printk("platform init failed\n");
		return 0;
	}

	if (load_and_launch("psram-a") < 0 || load_and_launch("psram-b") < 0) {
		return 0;
	}

	/* Let both apps run the full 10 s stress plus reporting time. */
	k_msleep(STRESS_MS + 3000);

	printk("\n*** done: two loadable apps each stressed a private region ***\n");
	return 0;
}
```
