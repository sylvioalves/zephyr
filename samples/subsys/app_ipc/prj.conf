## CMakeLists.txt
```
# SPDX-License-Identifier: Apache-2.0

cmake_minimum_required(VERSION 3.20.0)
find_package(Zephyr REQUIRED HINTS $ENV{ZEPHYR_BASE})
project(app_ipc)

zephyr_syscall_header(${CMAKE_CURRENT_SOURCE_DIR}/src/svc.h)

target_sources(app PRIVATE
  src/main.c
  src/svc.c
  src/apps.c
)
```

## prj.conf
```kconfig
CONFIG_USERSPACE=y
CONFIG_APPLICATION_DEFINED_SYSCALL=y

# The application platform subsystem (manager only - no loader or registry).
CONFIG_APP_PLATFORM=y
CONFIG_APP_PLATFORM_MAX_APPS=4

CONFIG_TASK_WDT=y
CONFIG_TASK_WDT_CHANNELS=6

CONFIG_LOG=y
CONFIG_LOG_MODE_MINIMAL=y
CONFIG_THREAD_NAME=y

CONFIG_MAX_DOMAIN_PARTITIONS=8
CONFIG_MAIN_STACK_SIZE=4096
CONFIG_HEAP_MEM_POOL_SIZE=8192
```

## src/main.c
```c
/*
 * Copyright (c) 2026 Espressif Systems (Shanghai) Co., Ltd.
 *
 * SPDX-License-Identifier: Apache-2.0
 */

/*
 * Inter-application messaging on the application platform. Two isolated apps -
 * a producer and a consumer - cannot touch each other's memory, so they
 * cooperate through a capability-gated broker: the producer sends values to the
 * consumer, the consumer acknowledges them back. Only copied bytes cross the
 * isolation boundary, and only because both apps hold the IPC capability.
 */

#include "app_caps.h"

#include <zephyr/app_platform/app_platform.h>
#include <zephyr/kernel.h>
#include <zephyr/sys/printk.h>

extern void svc_ipc_init(void);
extern void app_producer(void *arg);
extern void app_consumer(void *arg);

int main(void)
{
	printk("\n*** app platform: inter-app messaging (C6) ***\n");

	if (app_platform_init() != 0) {
		printk("platform init failed\n");
		return 0;
	}
	svc_ipc_init();

	/* Launch order fixes the group ids the apps message by. */
	const struct app_def producer = {
		.name = "producer", .source = APP_BUILTIN,
		.entry = app_producer, .caps = CAP_IPC,
	};
	const struct app_def consumer = {
		.name = "consumer", .source = APP_BUILTIN,
		.entry = app_consumer, .caps = CAP_IPC,
	};

	app_platform_launch(&producer);   /* group APP_PRODUCER (0) */
	app_platform_launch(&consumer);   /* group APP_CONSUMER (1) */

	k_msleep(4000);

	printk("\n*** done: two isolated apps cooperated by message passing ***\n");
	return 0;
}
```

## src/app_caps.h
```c
/*
 * Copyright (c) 2026 Espressif Systems (Shanghai) Co., Ltd.
 *
 * SPDX-License-Identifier: Apache-2.0
 */

#ifndef APP_IPC_APP_CAPS_H_
#define APP_IPC_APP_CAPS_H_

#include <zephyr/sys/util.h>

/* Application-defined capability: permission to use inter-app messaging. */
#define CAP_IPC  BIT(0)

/* The well-known group ids in this demo's launch order. */
#define APP_PRODUCER 0
#define APP_CONSUMER 1

#endif /* APP_IPC_APP_CAPS_H_ */
```

## src/apps.c
```c
/*
 * Copyright (c) 2026 Espressif Systems (Shanghai) Co., Ltd.
 *
 * SPDX-License-Identifier: Apache-2.0
 */

/*
 * Two isolated apps that cooperate by message passing. The producer sends a
 * counter to the consumer through the broker; the consumer receives it and
 * sends an acknowledgment back. Neither can see the other's memory - only
 * copied bytes cross, routed by the platform.
 */

#include "svc.h"
#include "app_caps.h"

#include <zephyr/kernel.h>

/* producer: send a counter to the consumer, wait for its ack. */
void app_producer(void *arg)
{
	ARG_UNUSED(arg);

	for (uint8_t n = 1; n <= 5; n++) {
		uint8_t out = n;

		svc_ipc_send(APP_CONSUMER, &out, 1);
		svc_log("producer: sent a value to the consumer");

		int from = -1;
		uint8_t ack[8] = { 0 };
		int got = svc_ipc_recv(&from, ack, sizeof(ack), 1000);

		if (got > 0 && ack[0] == 'o') {
			svc_log("producer: got 'ok' ack back from the consumer");
		}
		k_msleep(500);
	}
	svc_log("producer: done");
}

/* consumer: receive values, log them, acknowledge each back to the sender. */
void app_consumer(void *arg)
{
	ARG_UNUSED(arg);

	for (;;) {
		int from = -1;
		uint8_t in[8] = { 0 };
		int got = svc_ipc_recv(&from, in, sizeof(in), 2000);

		if (got > 0) {
			svc_log("consumer: received a value, acking back");

			uint8_t ack[2] = { 'o', 'k' };

			svc_ipc_send(from, ack, sizeof(ack));
		} else {
			svc_log("consumer: idle (no message)");
		}
	}
}
```

## src/svc.c
```c
/*
 * Copyright (c) 2026 Espressif Systems (Shanghai) Co., Ltd.
 *
 * SPDX-License-Identifier: Apache-2.0
 */

#include "svc.h"
#include "app_caps.h"

#include <zephyr/kernel.h>
#include <zephyr/sys/printk.h>
#include <zephyr/internal/syscall_handler.h>
#include <zephyr/app_platform/app_platform.h>
#include <string.h>
#include <errno.h>

#define IPC_MSG_MAX  32
#define MAILBOX_DEPTH 8

/* A message in transit: the sender id plus the copied payload. */
struct ipc_msg {
	int      from;
	uint16_t len;
	uint8_t  data[IPC_MSG_MAX];
};

/*
 * One mailbox per application group. The broker owns these in supervisor mode;
 * apps never see another app's mailbox, only the bytes routed into their own.
 */
static struct k_msgq mailboxes[CONFIG_APP_PLATFORM_MAX_APPS];
static char mailbox_bufs[CONFIG_APP_PLATFORM_MAX_APPS]
			[MAILBOX_DEPTH * sizeof(struct ipc_msg)];

void svc_ipc_init(void)
{
	for (int i = 0; i < CONFIG_APP_PLATFORM_MAX_APPS; i++) {
		k_msgq_init(&mailboxes[i], mailbox_bufs[i], sizeof(struct ipc_msg),
			    MAILBOX_DEPTH);
	}
}

void z_impl_svc_log(const char *msg)
{
	printk("    [app %d] %s\n", app_platform_id_current(), msg);
}

int z_impl_svc_ipc_send(int to, const uint8_t *buf, size_t len)
{
	if ((app_platform_caps_current() & CAP_IPC) == 0U) {
		return -EPERM;
	}
	if (to < 0 || to >= CONFIG_APP_PLATFORM_MAX_APPS || len == 0U ||
	    len > IPC_MSG_MAX) {
		return -EINVAL;
	}

	struct ipc_msg m = { .from = app_platform_id_current(), .len = (uint16_t)len };

	memcpy(m.data, buf, len);
	if (k_msgq_put(&mailboxes[to], &m, K_NO_WAIT) != 0) {
		return -ENOBUFS;
	}
	return (int)len;
}

int z_impl_svc_ipc_recv(int *from, uint8_t *buf, size_t cap, int32_t timeout_ms)
{
	if ((app_platform_caps_current() & CAP_IPC) == 0U) {
		return -EPERM;
	}

	int me = app_platform_id_current();

	if (me < 0) {
		return -ESRCH;
	}

	struct ipc_msg m;
	k_timeout_t t = (timeout_ms < 0) ? K_FOREVER : K_MSEC(timeout_ms);

	if (k_msgq_get(&mailboxes[me], &m, t) != 0) {
		return -EAGAIN;
	}

	size_t n = MIN((size_t)m.len, cap);

	*from = m.from;
	memcpy(buf, m.data, n);
	return (int)n;
}

#ifdef CONFIG_USERSPACE
static inline void z_vrfy_svc_log(const char *msg)
{
	char kbuf[48];

	if (k_usermode_string_copy(kbuf, (char *)msg, sizeof(kbuf)) == 0) {
		z_impl_svc_log(kbuf);
	}
}
#include <zephyr/syscalls/svc_log_mrsh.c>

static inline int z_vrfy_svc_ipc_send(int to, const uint8_t *buf, size_t len)
{
	if (len > IPC_MSG_MAX) {
		return -EINVAL;
	}
	K_OOPS(K_SYSCALL_MEMORY_READ(buf, len));
	return z_impl_svc_ipc_send(to, buf, len);
}
#include <zephyr/syscalls/svc_ipc_send_mrsh.c>

static inline int z_vrfy_svc_ipc_recv(int *from, uint8_t *buf, size_t cap,
				      int32_t timeout_ms)
{
	if (cap > IPC_MSG_MAX) {
		cap = IPC_MSG_MAX;
	}
	K_OOPS(K_SYSCALL_MEMORY_WRITE(from, sizeof(*from)));
	K_OOPS(K_SYSCALL_MEMORY_WRITE(buf, cap));
	return z_impl_svc_ipc_recv(from, buf, cap, timeout_ms);
}
#include <zephyr/syscalls/svc_ipc_recv_mrsh.c>
#endif
```

## src/svc.h
```c
/*
 * Copyright (c) 2026 Espressif Systems (Shanghai) Co., Ltd.
 *
 * SPDX-License-Identifier: Apache-2.0
 */

#ifndef APP_IPC_SVC_H_
#define APP_IPC_SVC_H_

#include <zephyr/kernel.h>

/*
 * Inter-application messaging, brokered and capability-gated. Isolated apps
 * cannot touch each other's memory, so they cooperate by passing messages
 * through the platform: a sender hands bytes to a named peer, the broker checks
 * the sender's IPC grant and routes the message into the peer's mailbox, and the
 * peer polls for it. Apps never share an address space; only copied bytes cross.
 *
 *   svc_log       - log a line (always available).
 *   svc_ipc_send  - send @len bytes to peer app id @to. Needs CAP_IPC.
 *   svc_ipc_recv  - poll this app's mailbox; -EAGAIN if empty. Needs CAP_IPC.
 */

/* Always available. */
__syscall void svc_log(const char *msg);

/* Scoped (CAP_IPC): deliver @buf[0..len) to peer app @to. Returns bytes sent. */
__syscall int svc_ipc_send(int to, const uint8_t *buf, size_t len);

/*
 * Scoped (CAP_IPC): poll the next message for this app. On success returns the
 * length and writes the sender id to *@from and up to @cap bytes into @buf.
 */
__syscall int svc_ipc_recv(int *from, uint8_t *buf, size_t cap, int32_t timeout_ms);

#include <zephyr/syscalls/svc.h>

#endif /* APP_IPC_SVC_H_ */
```
