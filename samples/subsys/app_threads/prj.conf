## CMakeLists.txt
```
# SPDX-License-Identifier: Apache-2.0

cmake_minimum_required(VERSION 3.20.0)
find_package(Zephyr REQUIRED HINTS $ENV{ZEPHYR_BASE})
project(app_threads)

zephyr_syscall_header(${CMAKE_CURRENT_SOURCE_DIR}/src/app_rt.h)

target_sources(app PRIVATE src/main.c src/app_rt.c)
```

## prj.conf
```kconfig
CONFIG_USERSPACE=y
CONFIG_APPLICATION_DEFINED_SYSCALL=y

CONFIG_LOG=y
CONFIG_LOG_MODE_MINIMAL=y
CONFIG_THREAD_NAME=y

CONFIG_MAX_DOMAIN_PARTITIONS=8
CONFIG_MAIN_STACK_SIZE=4096
```

## src/main.c
```c
/*
 * Copyright (c) 2026 Espressif Systems (Shanghai) Co., Ltd.
 *
 * SPDX-License-Identifier: Apache-2.0
 */

/*
 * A multi-threaded app. The app is one group (domain + threads). Its root
 * thread spawns two more threads in the same group; all three share the app's
 * memory and isolation, and are reaped together when the app is aborted - the
 * process-with-threads model on a microcontroller.
 */

#include "app_rt.h"

#include <zephyr/kernel.h>
#include <zephyr/sys/printk.h>
#include <zephyr/app_memory/app_memdomain.h>

/* Shared app state, in the app's own partition - all the app's threads see it,
 * no other app does.
 */
K_APPMEM_PARTITION_DEFINE(app_part);
static volatile int K_APP_DMEM(app_part) shared_counter;

/* A user-mode delay (a real SDK exposes app_sleep_ms; busy-wait keeps this
 * sample free of any syscall the demo app is not granted).
 */
static void spin_delay(void)
{
	for (volatile int i = 0; i < 4000000; i++) {
	}
}

/* A worker thread: bumps the shared counter (proving shared app memory). */
static void worker(void *name_p)
{
	const char *name = name_p;

	for (int i = 0; i < 6; i++) {
		shared_counter++;
		printk("    [%s] tick %d, shared_counter=%d (shared app memory)\n",
		       name, i, shared_counter);
		spin_delay();
	}
}

/* The app's root thread: spawns two more threads in its own group. */
static void app_root(void *arg)
{
	ARG_UNUSED(arg);

	printk("  [root] app started; spawning two worker threads in my group\n");
	app_thread_spawn(worker, "worker-A");
	app_thread_spawn(worker, "worker-B");

	/* Root also does work. */
	worker("root");
}

int main(void)
{
	printk("\n*** multi-threaded app: one app, many threads, shared domain (C6) ***\n");

	struct k_mem_partition *part = &app_part;

	app_create("multi", part, app_root, NULL);

	/* Let the app run, then tear the whole thing down. */
	k_msleep(4000);
	app_abort_all();

	printk("\n*** done: app ran 3 threads sharing its memory; aborted together ***\n");
	return 0;
}
```

## src/app_rt.c
```c
/*
 * Copyright (c) 2026 Espressif Systems (Shanghai) Co., Ltd.
 *
 * SPDX-License-Identifier: Apache-2.0
 */

#include "app_rt.h"

#include <zephyr/kernel.h>
#include <zephyr/sys/printk.h>
#include <zephyr/internal/syscall_handler.h>

#define APP_STACK_SIZE 2048
#define APP_PRIO       5

/* One app group: a domain plus a pool of thread slots that share it. */
static struct k_mem_domain domain;
static struct k_thread threads[APP_MAX_THREADS];
static K_THREAD_STACK_ARRAY_DEFINE(stacks, APP_MAX_THREADS, APP_STACK_SIZE);
static int thread_count;
static k_tid_t root_tid;

/*
 * Trampoline: runs in USER mode, so it must not read any kernel global. The
 * entry fn and arg are passed as thread parameters by value; the entry pointer
 * is app text the user thread may call, the arg is opaque.
 */
static void trampoline(void *entry, void *arg, void *u2)
{
	ARG_UNUSED(u2);
	app_entry_t fn = (app_entry_t)entry;

	fn(arg);
}

/* Spawn a thread into THIS app group (supervisor context). */
static int spawn_in_group(app_entry_t entry, void *arg, bool is_root)
{
	if (thread_count >= APP_MAX_THREADS) {
		return -ENOSPC;
	}
	int idx = thread_count++;

	uint32_t opts = K_USER | (is_root ? 0 : K_INHERIT_PERMS);

	k_tid_t t = k_thread_create(&threads[idx], stacks[idx], APP_STACK_SIZE,
				    trampoline, (void *)entry, arg, NULL,
				    APP_PRIO, opts, K_FOREVER);

	/* All threads of the app share its domain: same isolation, same memory,
	 * so they see each other's data but no other app's. Capability grants
	 * are applied per the app's manifest by the broker (omitted here; this
	 * sample focuses on the multi-thread, shared-domain model).
	 */
	k_mem_domain_add_thread(&domain, t);
	if (is_root) {
		root_tid = t;
	}
	k_thread_start(t);
	return idx;
}

int app_create(const char *name, struct k_mem_partition *part,
	       app_entry_t root, void *arg)
{
	printk("app-rt: creating app '%s' (group = domain + threads)\n", name);
	k_mem_domain_init(&domain, 0, NULL);
	if (part != NULL) {
		k_mem_domain_add_partition(&domain, part);
	}
	thread_count = 0;
	return spawn_in_group(root, arg, true);
}

void app_abort_all(void)
{
	for (int i = 0; i < thread_count; i++) {
		k_thread_abort(&threads[i]);
	}
	printk("app-rt: app aborted - all %d threads reaped together\n",
	       thread_count);
	thread_count = 0;
}

int z_impl_app_thread_spawn(app_entry_t entry, void *arg)
{
	/* A running app thread asks for another thread in its own group. The
	 * broker does the create in supervisor context, in the app's domain.
	 */
	return spawn_in_group(entry, arg, false);
}

#ifdef CONFIG_USERSPACE
static inline int z_vrfy_app_thread_spawn(app_entry_t entry, void *arg)
{
	/* entry is app text; arg is opaque to the kernel. The thread runs in the
	 * caller's domain with the caller's permissions, so no escalation.
	 */
	return z_impl_app_thread_spawn(entry, arg);
}
#include <zephyr/syscalls/app_thread_spawn_mrsh.c>
#endif
```

## src/app_rt.h
```c
/*
 * Copyright (c) 2026 Espressif Systems (Shanghai) Co., Ltd.
 *
 * SPDX-License-Identifier: Apache-2.0
 */

#ifndef APP_THREADS_APP_RT_H_
#define APP_THREADS_APP_RT_H_

#include <zephyr/kernel.h>

/*
 * App runtime: an application is a GROUP - one memory domain plus one or more
 * threads that share it. The threads see each other's memory (they are one
 * app), are isolated from other apps, and all inherit the app's capability
 * grants. This mirrors a process with multiple threads in a general OS.
 *
 * A loadable app cannot manage stacks itself, so the broker owns a pool of
 * thread slots per app and spawns into the app's domain on request.
 */

#define APP_MAX_THREADS 3   /* per app group */

typedef void (*app_entry_t)(void *arg);

/* Supervisor: create an app group (with the app's private partition), spawn
 * its first (root) thread.
 */
int app_create(const char *name, struct k_mem_partition *part,
	       app_entry_t root, void *arg);

/* Abort the whole app: every thread in the group is reaped together. */
void app_abort_all(void);

/* The SDK call: a running app thread spawns another thread in its own group. */
__syscall int app_thread_spawn(app_entry_t entry, void *arg);

#include <zephyr/syscalls/app_rt.h>

#endif /* APP_THREADS_APP_RT_H_ */
```
