## CMakeLists.txt
```
# SPDX-License-Identifier: Apache-2.0

cmake_minimum_required(VERSION 3.20.0)
find_package(Zephyr REQUIRED HINTS $ENV{ZEPHYR_BASE})
project(app_update)

target_sources(app PRIVATE
  src/main.c
)

# Build the same module twice as two releases (v1 and v2) of one app.
set(ext_src ${PROJECT_SOURCE_DIR}/module/src/versioned_app.c)

function(build_release ver)
  set(name app_v${ver})
  set(bin ${PROJECT_BINARY_DIR}/llext/${name}.llext)
  set(inc ${ZEPHYR_BINARY_DIR}/include/generated/${name}.inc)
  set(sha ${ZEPHYR_BINARY_DIR}/include/generated/${name}.sha256.inc)

  app_platform_add_module(${name}_ext OUTPUT ${bin} SOURCES ${ext_src})
  llext_compile_definitions(${name}_ext APP_VERSION=${ver})
  llext_include_directories(${name}_ext ${ZEPHYR_BINARY_DIR}/include/generated)
  generate_inc_file_for_target(app ${bin} ${inc})

  add_custom_command(
    OUTPUT  ${sha}
    COMMAND ${CMAKE_COMMAND}
      -DMODULE_BIN=${bin}
      -DOUT_INC=${sha}
      -P ${CMAKE_CURRENT_SOURCE_DIR}/cmake/gen_sha256_inc.cmake
    DEPENDS ${bin}
  )
  add_custom_target(${name}_sha DEPENDS ${sha})
  add_dependencies(app ${name}_sha)
endfunction()

build_release(1)
build_release(2)
```

## prj.conf
```kconfig
CONFIG_APPLICATION_DEFINED_SYSCALL=y

# The application platform subsystem with the verified loader.
CONFIG_APP_PLATFORM=y
CONFIG_APP_PLATFORM_MAX_APPS=4
CONFIG_APP_PLATFORM_LOADER=y
CONFIG_APP_PLATFORM_SERVICES=y

CONFIG_TASK_WDT=y
CONFIG_TASK_WDT_CHANNELS=6

# Runtime-loaded app verification (SHA-256 via PSA crypto).
CONFIG_LLEXT=y
CONFIG_LLEXT_HEAP_SIZE=64
CONFIG_LLEXT_TYPE_ELF_RELOCATABLE=y
CONFIG_PSA_CRYPTO=y
CONFIG_MBEDTLS_ENABLE_HEAP=y
CONFIG_PSA_WANT_ALG_SHA_256=y

CONFIG_LOG=y
CONFIG_LOG_MODE_MINIMAL=y
CONFIG_THREAD_NAME=y

CONFIG_MAIN_STACK_SIZE=4096
CONFIG_HEAP_MEM_POOL_SIZE=16384
```

## src/main.c
```c
/*
 * Copyright (c) 2026 Espressif Systems (Shanghai) Co., Ltd.
 *
 * SPDX-License-Identifier: Apache-2.0
 */

/*
 * Hot-updating a running app. Version 1 of an app is verified, loaded, and
 * launched as an isolated user-mode group. While it runs, a new release
 * (version 2) "arrives": the platform verifies it, stops the running v1, and
 * launches v2 in its place. The app is replaced live, without rebooting and
 * without disturbing the rest of the system. Both versions are embedded here to
 * stand in for two downloaded releases.
 */

#include <zephyr/app_platform/app_platform.h>
#include <zephyr/app_platform/app_loader.h>
#include <zephyr/app_platform/app_caps.h>
#include <zephyr/kernel.h>
#include <zephyr/sys/printk.h>

static const uint8_t app_v1[] __aligned(8) = {
#include "app_v1.inc"
};
static const uint8_t app_v1_hash[32] = {
#include "app_v1.sha256.inc"
};

static const uint8_t app_v2[] __aligned(8) = {
#include "app_v2.inc"
};
static const uint8_t app_v2_hash[32] = {
#include "app_v2.sha256.inc"
};

/* Verify, load and launch a release; returns the running group id. */
static int install_version(const char *name, const uint8_t *buf, size_t len,
			   const uint8_t hash[32])
{
	struct llext *ext = NULL;
	void *entry = NULL;
	int rc = app_loader_verify_load(name, buf, len, hash, "app_main", &ext, &entry);

	if (rc != 0) {
		printk("update: install of %s failed: %d\n", name, rc);
		return rc;
	}
	return app_platform_launch_llext(name, ext, (app_entry_t)entry, NULL, APP_CAP_LOG);
}

int main(void)
{
	printk("\n*** app platform: live app hot-update (C6) ***\n");

	if (app_platform_init() != 0) {
		printk("platform init failed\n");
		return 0;
	}

	printk("\ninstalling app v1...\n");
	int id = install_version("app-v1", app_v1, ARRAY_SIZE(app_v1), app_v1_hash);

	if (id < 0) {
		return 0;
	}

	/* Let v1 run for a bit. */
	k_msleep(2500);

	printk("\na new release arrived - hot-updating to v2...\n");
	printk("stopping running v1 (group %d)\n", id);
	app_platform_stop(id);

	int id2 = install_version("app-v2", app_v2, ARRAY_SIZE(app_v2), app_v2_hash);

	printk("v2 launched as group %d - the app was updated live\n", id2);

	k_msleep(3000);

	printk("\n*** done: app updated at runtime, no reboot ***\n");
	return 0;
}
```

## src/svc.h
```c
/*
 * Copyright (c) 2026 Espressif Systems (Shanghai) Co., Ltd.
 *
 * SPDX-License-Identifier: Apache-2.0
 */

#ifndef APP_UPDATE_SVC_H_
#define APP_UPDATE_SVC_H_

#include <zephyr/kernel.h>

/* Minimal services the versioned app uses while running. */
__syscall void svc_log(const char *msg);
__syscall void svc_heartbeat(void);

#include <zephyr/syscalls/svc.h>

#endif /* APP_UPDATE_SVC_H_ */
```
