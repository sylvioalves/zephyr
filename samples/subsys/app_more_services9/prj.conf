## CMakeLists.txt
```
# SPDX-License-Identifier: Apache-2.0

cmake_minimum_required(VERSION 3.20.0)
find_package(Zephyr REQUIRED HINTS $ENV{ZEPHYR_BASE})
project(app_more_services9)

zephyr_syscall_header(${CMAKE_CURRENT_SOURCE_DIR}/src/svc.h)

target_sources(app PRIVATE src/main.c src/svc.c)
```

## prj.conf
```kconfig
CONFIG_USERSPACE=y
CONFIG_APPLICATION_DEFINED_SYSCALL=y

CONFIG_PWM=y

CONFIG_LOG=y
CONFIG_LOG_MODE_MINIMAL=y
CONFIG_THREAD_NAME=y

CONFIG_MAIN_STACK_SIZE=4096
```

## boards/esp32c5_devkitc_esp32c5_hpcore.overlay
```dts
/*
 * Copyright (c) 2026 Espressif Systems (Shanghai) Co., Ltd.
 *
 * SPDX-License-Identifier: Apache-2.0
 */

#include <zephyr/dt-bindings/pinctrl/esp32c5-pinctrl.h>

/* MCPWM operator-0 outputs: PWM0A on GPIO4 (channel 0), PWM0B on GPIO5 (channel 1). */
&pinctrl {
	mcpwm0_default: mcpwm0_default {
		group1 {
			pinmux = <MCPWM0_OUT0A_GPIO4>,
				 <MCPWM0_OUT0B_GPIO5>;
			output-enable;
		};
	};
};

&mcpwm0 {
	pinctrl-0 = <&mcpwm0_default>;
	pinctrl-names = "default";
	prescale = <255>;
	prescale-timer0 = <103>;
	status = "okay";
};
```

## boards/esp32c6_devkitc_esp32c6_hpcore.overlay
```dts
/*
 * Copyright (c) 2026 Espressif Systems (Shanghai) Co., Ltd.
 *
 * SPDX-License-Identifier: Apache-2.0
 */

#include <zephyr/dt-bindings/pinctrl/esp32c6-pinctrl.h>

/* MCPWM operator-0 outputs: PWM0A on GPIO4 (channel 0), PWM0B on GPIO5 (channel 1). */
&pinctrl {
	mcpwm0_default: mcpwm0_default {
		group1 {
			pinmux = <MCPWM0_OUT0A_GPIO4>,
				 <MCPWM0_OUT0B_GPIO5>;
			output-enable;
		};
	};
};

&mcpwm0 {
	pinctrl-0 = <&mcpwm0_default>;
	pinctrl-names = "default";
	prescale = <255>;
	prescale-timer0 = <103>;
	status = "okay";
};
```

## src/main.c
```c
/*
 * Copyright (c) 2026 Espressif Systems (Shanghai) Co., Ltd.
 *
 * SPDX-License-Identifier: Apache-2.0
 */

/*
 * An app driving the motor-control PWM (MCPWM) through services from user mode.
 * The platform owns the MCPWM controller; the app ramps the duty cycle on two
 * output channels the way a motor driver would, never touching the controller
 * directly.
 */

#include "svc.h"

#include <zephyr/kernel.h>
#include <zephyr/sys/printk.h>

#define STACK_SIZE 2048
#define APP_PRIO   5

K_THREAD_STACK_DEFINE(app_stack, STACK_SIZE);
static struct k_thread app_thread;

static void app_entry(void *p1, void *p2, void *p3)
{
	ARG_UNUSED(p1); ARG_UNUSED(p2); ARG_UNUSED(p3);

	static const uint32_t duties[] = { 0, 25, 50, 75, 100, 50, 0 };

	for (int i = 0; i < (int)ARRAY_SIZE(duties); i++) {
		int rc0 = svc_motor_set(0, duties[i]);
		int rc1 = svc_motor_set(1, 100 - duties[i]);

		printk("  [app] ch0=%u%% (rc=%d), ch1=%u%% (rc=%d)\n",
		       duties[i], rc0, 100 - duties[i], rc1);

		k_msleep(300);
	}

	svc_motor_set(0, 0);
	svc_motor_set(1, 0);
	printk("  [app] done - ramped MCPWM on two channels\n");
}

int main(void)
{
	printk("\n*** more services 9: motor pwm / MCPWM (C6) ***\n");

	k_tid_t t = k_thread_create(&app_thread, app_stack, STACK_SIZE, app_entry,
				    NULL, NULL, NULL, APP_PRIO, K_USER, K_FOREVER);

	k_thread_start(t);
	k_thread_join(t, K_FOREVER);

	printk("\n*** done ***\n");
	return 0;
}
```

## src/svc.c
```c
/*
 * Copyright (c) 2026 Espressif Systems (Shanghai) Co., Ltd.
 *
 * SPDX-License-Identifier: Apache-2.0
 */

#include "svc.h"

#include <zephyr/kernel.h>
#include <zephyr/device.h>
#include <zephyr/drivers/pwm.h>
#include <zephyr/internal/syscall_handler.h>
#include <errno.h>

#define MOTOR_CHANNELS 2U
#define PERIOD_NS      PWM_HZ(1000)

/* The platform owns the MCPWM controller; the app drives granted channels. */
static const struct device *const mcpwm = DEVICE_DT_GET(DT_NODELABEL(mcpwm0));

/* The two output channels exposed to the app (operator 0: PWM0A and PWM0B). */
static const uint32_t channel_map[MOTOR_CHANNELS] = { 0U, 1U };

int z_impl_svc_motor_set(uint32_t channel, uint32_t duty_pct)
{
	if (!device_is_ready(mcpwm) || channel >= MOTOR_CHANNELS || duty_pct > 100U) {
		return -EINVAL;
	}

	uint32_t pulse = (uint32_t)(((uint64_t)PERIOD_NS * duty_pct) / 100U);

	return pwm_set(mcpwm, channel_map[channel], PERIOD_NS, pulse, 0);
}

#ifdef CONFIG_USERSPACE
static inline int z_vrfy_svc_motor_set(uint32_t channel, uint32_t duty_pct)
{
	if (channel >= MOTOR_CHANNELS || duty_pct > 100U) {
		return -EINVAL;
	}
	return z_impl_svc_motor_set(channel, duty_pct);
}
#include <zephyr/syscalls/svc_motor_set_mrsh.c>
#endif
```

## src/svc.h
```c
/*
 * Copyright (c) 2026 Espressif Systems (Shanghai) Co., Ltd.
 *
 * SPDX-License-Identifier: Apache-2.0
 */

#ifndef APP_MORE_SERVICES9_SVC_H_
#define APP_MORE_SERVICES9_SVC_H_

#include <zephyr/kernel.h>

/*
 * A ninth batch: the motor-control PWM (MCPWM), distinct from the LEDC PWM. The
 * platform owns the MCPWM timer and its output channels; the app sets a duty
 * cycle per channel from user mode, the way a motor driver would ramp an
 * H-bridge. The channel index is validated against the granted set.
 *
 *   svc_motor_set - drive MCPWM @channel at @duty_pct (0..100) percent.
 */

/* Scoped: set output @channel duty to @duty_pct percent (0..100). */
__syscall int svc_motor_set(uint32_t channel, uint32_t duty_pct);

#include <zephyr/syscalls/svc.h>

#endif /* APP_MORE_SERVICES9_SVC_H_ */
```
