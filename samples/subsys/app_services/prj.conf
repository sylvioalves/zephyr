## CMakeLists.txt
```
# SPDX-License-Identifier: Apache-2.0

cmake_minimum_required(VERSION 3.20.0)
find_package(Zephyr REQUIRED HINTS $ENV{ZEPHYR_BASE})
project(app_services)

zephyr_syscall_header(${CMAKE_CURRENT_SOURCE_DIR}/src/svc_broker.h)

target_sources(app PRIVATE
  src/main.c
  src/app_group.c
  src/svc_registry.c
  src/svc_broker.c
  src/net_link.c
)
```

## Kconfig
```
# SPDX-License-Identifier: Apache-2.0

source "Kconfig.zephyr"

config APP_GROUP_MAX
	int "Maximum number of concurrent app groups"
	default 4
	help
	  Size of the static pool of app groups (isolated user-mode apps).

config APP_WIFI_SSID
	string "Wi-Fi SSID for the M2 network service"
	default "Internet"

config APP_WIFI_PSK
	string "Wi-Fi PSK for the M2 network service"
	default "netsemfio123456"
```

## prj.conf
```kconfig
CONFIG_USERSPACE=y
CONFIG_APPLICATION_DEFINED_SYSCALL=y

CONFIG_TASK_WDT=y
CONFIG_TASK_WDT_CHANNELS=6

CONFIG_LOG=y
CONFIG_LOG_MODE_MINIMAL=y
CONFIG_THREAD_NAME=y

CONFIG_MAX_DOMAIN_PARTITIONS=8
CONFIG_APP_GROUP_MAX=4

# Wi-Fi + IP stack (shared, owned by the supervisor)
CONFIG_WIFI=y
CONFIG_WIFI_USAGE_MODE_STA=y

# Let the Wi-Fi driver start DHCP on connect; this installs the default route
# (gateway) so DNS/internet is reachable.
CONFIG_WIFI_STA_AUTO_DHCPV4=y

CONFIG_NETWORKING=y
CONFIG_NET_IPV4=y
CONFIG_NET_IPV6=n
CONFIG_NET_DHCPV4=y
CONFIG_NET_UDP=y
CONFIG_NET_TCP=y

# Sockets + DNS (DNS resolve is brokered in supervisor mode)
CONFIG_NET_SOCKETS=y
CONFIG_DNS_RESOLVER=y
CONFIG_NET_MAX_CONTEXTS=16
CONFIG_NET_MAX_CONN=16

# Let DHCP provide the DNS server, with a public fallback so resolves work.
CONFIG_NET_DHCPV4_OPTION_DNS_ADDRESS=y
CONFIG_DNS_SERVER_IP_ADDRESSES=y
CONFIG_DNS_SERVER1="8.8.8.8"

CONFIG_NET_MGMT=y
CONFIG_NET_MGMT_EVENT=y
CONFIG_NET_MGMT_EVENT_INFO=y
CONFIG_NET_MGMT_EVENT_STACK_SIZE=4096

CONFIG_HEAP_MEM_POOL_SIZE=131072
CONFIG_MAIN_STACK_SIZE=5200
```

## boards/esp32c5_devkitc_esp32c5_hpcore.conf
```kconfig
# The ESP32-C5 has 378 KB of internal SRAM: a 96 KB system heap is what fits.
CONFIG_HEAP_MEM_POOL_SIZE=98304
```

## src/main.c
```c
/*
 * Copyright (c) 2026 Espressif Systems (Shanghai) Co., Ltd.
 *
 * SPDX-License-Identifier: Apache-2.0
 */

/*
 * M2 demo: two memory-isolated apps each use the internet INDEPENDENTLY through
 * one shared Wi-Fi radio + IP stack on C6.
 *
 * The supervisor (trusted base) owns the radio: it connects to Wi-Fi and runs
 * DHCP, then releases the apps. Each app then opens its OWN socket and does its
 * OWN DNS lookup in user mode - the net stack isolates their sockets by kobject
 * permission, so the apps are independent. Killing one networked app leaves the
 * other online and resolving.
 */

#include "app_group.h"
#include "svc_broker.h"
#include "svc_registry.h"
#include "net_link.h"

#include <zephyr/kernel.h>
#include <zephyr/sys/printk.h>
#include <zephyr/net/socket.h>

/*
 * These networked apps need no private data partition: their isolation that
 * matters is per-socket (the net stack grants each app a kobject permission on
 * its own socket, so apps cannot touch each other's connections). They run in
 * the default domain with stack isolation; pass NULL for the partition.
 */

/* Each app resolves a different host, on its own, to show independence. */
static void net_app(struct app_group *g, void *arg)
{
	ARG_UNUSED(g);
	const char *host = (const char *)arg;

	/* Wait for the link, heartbeating so the watchdog does not reclaim us
	 * while the supervisor is still bringing Wi-Fi/DHCP up.
	 */
	bool ready = false;

	for (int w = 0; w < 120; w++) {
		if (net_link_wait_ready(K_MSEC(250)) == 0) {
			ready = true;
			break;
		}
		svc_heartbeat();
	}
	if (!ready) {
		printk("  [%s-app] network never came up\n", host);
		return;
	}

	for (int i = 0; ; i++) {
		int rc = svc_net_probe(80);

		printk("  [%s-app] #%d net probe -> %s (rc=%d)\n",
		       host, i, rc == 0 ? "connected" : "no-connect", rc);

		svc_heartbeat();
		k_msleep(2000);
	}
}

/* A bad networked app: resolves once, then hangs - must not affect the other. */
static void bad_net_app(struct app_group *g, void *arg)
{
	ARG_UNUSED(g);
	const char *host = (const char *)arg;

	bool ready = false;

	for (int w = 0; w < 120; w++) {
		if (net_link_wait_ready(K_MSEC(250)) == 0) {
			ready = true;
			break;
		}
		svc_heartbeat();
	}
	if (!ready) {
		return;
	}

	int rc = svc_net_probe(80);

	printk("  [%s-BAD] probed once (rc=%d), now HANGING\n", host, rc);
	for (;;) {
		/* stop heartbeating -> supervisor reclaims this app only */
	}
}

/* Grant a group the net-ready semaphore so its app can wait on it. */
extern struct k_sem net_ready_sem;

int main(void)
{
	printk("\n*** M2: two apps, independent internet over shared Wi-Fi (C6) ***\n");

	if (app_group_init() != 0) {
		printk("app_group_init failed\n");
		return 0;
	}

	if (net_link_up() != 0) {
		printk("net_link_up failed\n");
		return 0;
	}

	/* App A: independently resolves example.com forever. */
	struct app_group *a = app_group_create("A", NULL, net_app,
					       (void *)"example.com");
	app_group_grant_service(a, SVC_DEMO);
	k_object_access_grant(&net_ready_sem, &a->thread);
	app_group_start(a);

	/* App B: a bad app that resolves once then hangs. */
	struct app_group *b = app_group_create("B", NULL, bad_net_app,
					       (void *)"zephyrproject.org");
	app_group_grant_service(b, SVC_DEMO);
	k_object_access_grant(&net_ready_sem, &b->thread);
	app_group_start(b);

	printk("M2: apps running; App B will hang and be reclaimed, App A stays online\n");
	return 0;
}
```

## src/app_group.c
```c
/*
 * Copyright (c) 2026 Espressif Systems (Shanghai) Co., Ltd.
 *
 * SPDX-License-Identifier: Apache-2.0
 */

#include "app_group.h"

#include <zephyr/kernel.h>
#include <zephyr/sys/printk.h>
#include <zephyr/fatal.h>
#include <zephyr/task_wdt/task_wdt.h>
#include "svc_registry.h"

#define SUPERVISOR_STACK_SIZE 2048
#define SUPERVISOR_PRIO       2
#define APP_PRIO              5

static struct app_group groups[APP_GROUP_MAX];
static K_THREAD_STACK_ARRAY_DEFINE(group_stacks, APP_GROUP_MAX, APP_GROUP_STACK_SIZE);

/*
 * Per-app resource pool: the kernel allocates from here on behalf of the app's
 * syscalls (sockets, DNS). Bounding it per app means one app cannot exhaust
 * kernel memory and starve another. This is the brokered-allocation model
 * (apps do not run a user-mode allocator; see V2 finding).
 */
#define APP_POOL_BYTES 4096
K_HEAP_DEFINE(app_pool_0, APP_POOL_BYTES);
K_HEAP_DEFINE(app_pool_1, APP_POOL_BYTES);
K_HEAP_DEFINE(app_pool_2, APP_POOL_BYTES);
K_HEAP_DEFINE(app_pool_3, APP_POOL_BYTES);
static struct k_heap *const app_pools[] = {
	&app_pool_0, &app_pool_1, &app_pool_2, &app_pool_3,
};
BUILD_ASSERT(ARRAY_SIZE(app_pools) >= APP_GROUP_MAX,
	     "need one resource pool per app group");

/* Reclaim requests from the wdt ISR / fatal handler to the supervisor thread. */
static struct k_msgq reclaim_q;
static uint8_t reclaim_q_buf[APP_GROUP_MAX * sizeof(uint8_t)];

/* The supervisor performs all aborts in thread context. */
static struct k_thread supervisor_thread;
static K_THREAD_STACK_DEFINE(supervisor_stack, SUPERVISOR_STACK_SIZE);

/* Map a thread back to its group (the manager owns every app thread). */
static struct app_group *group_of_thread(k_tid_t tid)
{
	for (int i = 0; i < APP_GROUP_MAX; i++) {
		if (groups[i].state != APP_GROUP_FREE &&
		    &groups[i].thread == tid) {
			return &groups[i];
		}
	}
	return NULL;
}

struct app_group *app_group_current(void)
{
	return group_of_thread(k_current_get());
}

/*
 * Fault containment. Runs in kernel context when an app faults. Returning
 * makes the kernel abort only the faulting thread; we also queue the group for
 * full reclaim by the supervisor. Kernel panics are not recoverable.
 */
void k_sys_fatal_error_handler(unsigned int reason, const struct arch_esf *esf)
{
	ARG_UNUSED(esf);

	if (reason == K_ERR_KERNEL_PANIC) {
		printk("supervisor: kernel panic, halting\n");
		k_fatal_halt(reason);
	}

	struct app_group *g = group_of_thread(k_current_get());

	if (g != NULL) {
		printk("supervisor: app '%s' (group %u) faulted (reason %u); reclaiming\n",
		       g->name, g->id, reason);
		(void)k_msgq_put(&reclaim_q, &g->id, K_NO_WAIT);
	} else {
		printk("supervisor: fault in non-app thread %p, halting\n",
		       k_current_get());
		k_fatal_halt(reason);
	}
}

/* Per-group watchdog timeout: queue the group for reclaim (ISR context). */
static void wdt_callback(int channel_id, void *user_data)
{
	ARG_UNUSED(channel_id);
	struct app_group *g = user_data;

	(void)k_msgq_put(&reclaim_q, &g->id, K_NO_WAIT);
}

void app_group_abort(struct app_group *g)
{
	if (g->state == APP_GROUP_FREE) {
		return;
	}

	/* 1. stop watching this group's liveness. */
	if (g->wdt_chan >= 0) {
		(void)task_wdt_delete(g->wdt_chan);
		g->wdt_chan = -1;
	}

	/* 2. kill the app thread (synchronous on this arch for these threads). */
	k_thread_abort(&g->thread);

	/* 3. revoke every service grant - no dangling capabilities. */
	svc_registry_revoke_all(g);
	g->granted_services = 0;

	/*
	 * 4. reclaim the domain by REMOVING the app's partition (RISC-V has no
	 * k_mem_domain_deinit). The domain object is kept and re-provisioned on
	 * the next create that reuses this slot.
	 */
	if (g->part != NULL) {
		(void)k_mem_domain_remove_partition(&g->domain, g->part);
		g->part = NULL;
	}

	g->state = APP_GROUP_FREE;
	printk("supervisor: group %u ('%s') reclaimed; slot free\n", g->id, g->name);
}

static void supervisor_fn(void *a, void *b, void *c)
{
	ARG_UNUSED(a); ARG_UNUSED(b); ARG_UNUSED(c);

	for (;;) {
		uint8_t id;

		if (k_msgq_get(&reclaim_q, &id, K_FOREVER) == 0 &&
		    id < APP_GROUP_MAX) {
			app_group_abort(&groups[id]);
		}
	}
}

int app_group_init(void)
{
	for (int i = 0; i < APP_GROUP_MAX; i++) {
		groups[i].id = i;
		groups[i].state = APP_GROUP_FREE;
		groups[i].stack = group_stacks[i];
		groups[i].wdt_chan = -1;
	}

	k_msgq_init(&reclaim_q, reclaim_q_buf, sizeof(uint8_t), APP_GROUP_MAX);

	if (task_wdt_init(NULL) != 0) {
		printk("supervisor: task_wdt_init failed\n");
		return -EIO;
	}

	k_thread_create(&supervisor_thread, supervisor_stack, SUPERVISOR_STACK_SIZE,
			supervisor_fn, NULL, NULL, NULL,
			SUPERVISOR_PRIO, 0, K_NO_WAIT);
	k_thread_name_set(&supervisor_thread, "supervisor");
	return 0;
}

struct app_group *app_group_create(const char *name,
				   struct k_mem_partition *part,
				   app_entry_t entry, void *arg)
{
	for (int i = 0; i < APP_GROUP_MAX; i++) {
		struct app_group *g = &groups[i];

		if (g->state != APP_GROUP_FREE) {
			continue;
		}

		g->name = name;
		g->part = part;
		g->entry = entry;
		g->arg = arg;
		g->granted_services = 0;
		g->wdt_chan = -1;
		k_sem_init(&g->heartbeat, 0, 1);

		/* (Re)provision the reused domain with this app's partition. */
		k_mem_domain_init(&g->domain, 0, NULL);
		if (part != NULL) {
			k_mem_domain_add_partition(&g->domain, part);
		}

		g->state = APP_GROUP_READY;
		return g;
	}

	return NULL;
}

int app_group_grant_service(struct app_group *g, uint32_t service_id)
{
	if (g->state != APP_GROUP_READY) {
		return -EINVAL;
	}
	return svc_registry_grant(g, service_id);
}

/*
 * Trampoline: runs in USER MODE, so it must not dereference the kernel-side
 * group struct. The entry fn, the group ptr, and arg are passed as thread
 * parameters by value; the entry fn treats the group ptr as an opaque token
 * (it only ever passes it back through broker syscalls, never dereferences it).
 */
static void app_trampoline(void *entry, void *gp, void *arg)
{
	app_entry_t fn = (app_entry_t)entry;

	fn((struct app_group *)gp, arg);
}

int app_group_start(struct app_group *g)
{
	if (g->state != APP_GROUP_READY) {
		return -EINVAL;
	}

	k_tid_t t = k_thread_create(&g->thread, g->stack, APP_GROUP_STACK_SIZE,
				    app_trampoline, (void *)g->entry, g, g->arg,
				    APP_PRIO, K_USER | K_INHERIT_PERMS, K_FOREVER);
	k_thread_name_set(t, g->name);

	/* Bound the app's kernel-side allocations to its own resource pool. */
	k_thread_heap_assign(t, app_pools[g->id]);

	/* The app must reach its liveness sem; grant it. */
	k_thread_access_grant(t, &g->heartbeat);

	/* Apply the service-token grants recorded by app_group_grant_service(). */
	for (uint32_t id = 0; id < SVC_COUNT; id++) {
		if ((g->granted_services & BIT(id)) == 0) {
			continue;
		}
		const struct svc_desc *svc = svc_registry_get(id);

		if (svc != NULL && svc->token != NULL) {
			k_object_access_grant(svc->token, t);
		}
	}

	if (g->part != NULL) {
		k_mem_domain_add_thread(&g->domain, t);
	}

	/* Arm this group's liveness watchdog. */
	g->wdt_chan = task_wdt_add(APP_GROUP_HEARTBEAT_MS, wdt_callback, g);

	g->state = APP_GROUP_RUNNING;
	k_thread_start(t);
	return 0;
}

void app_group_heartbeat(struct app_group *g)
{
	if (g->wdt_chan >= 0) {
		(void)task_wdt_feed(g->wdt_chan);
	}
}
```

## src/app_group.h
```c
/*
 * Copyright (c) 2026 Espressif Systems (Shanghai) Co., Ltd.
 *
 * SPDX-License-Identifier: Apache-2.0
 */

#ifndef APP_SERVICES_APP_GROUP_H_
#define APP_SERVICES_APP_GROUP_H_

#include <zephyr/kernel.h>

/*
 * App group: the unit of isolation and lifecycle. An app group is one
 * user-mode application running in its own memory domain, supervised so that
 * if it faults, hangs, or is killed, only that group is torn down - the
 * supervisor and other groups keep running. Groups are drawn from a static
 * pool and their memory domains are REUSED across runs (RISC-V has no
 * k_mem_domain_deinit), so reclaim re-provisions a domain rather than freeing
 * it.
 *
 * Communication rule (enforced by hardware): a user-mode app may not touch
 * kernel globals. It reaches services only through broker syscalls, and the
 * supervisor learns of its state only via granted kobjects (the liveness sem)
 * or the fatal handler.
 */

#define APP_GROUP_MAX        CONFIG_APP_GROUP_MAX
#define APP_GROUP_STACK_SIZE 4096
#define APP_GROUP_HEARTBEAT_MS 8000

enum app_group_state {
	APP_GROUP_FREE = 0,
	APP_GROUP_READY,
	APP_GROUP_RUNNING,
	APP_GROUP_DEAD,
};

struct app_group;

/* Entry point for an app; runs in user mode inside the group's domain. */
typedef void (*app_entry_t)(struct app_group *g, void *arg);

struct app_group {
	uint8_t              id;
	enum app_group_state state;
	const char          *name;

	struct k_mem_domain  domain;       /* reused; never deinit'd on RISC-V */
	struct k_mem_partition *part;      /* this app's private partition     */

	struct k_thread      thread;
	k_thread_stack_t    *stack;

	/* Liveness: the app feeds this; the supervisor watches it. */
	struct k_sem         heartbeat;
	int                  wdt_chan;

	uint32_t             granted_services;  /* bitmask into the registry */

	app_entry_t          entry;
	void                *arg;
};

/**
 * @brief Initialize the app-group subsystem (supervisor side).
 *
 * Sets up the task watchdog and the supervisor thread. Call once at boot.
 */
int app_group_init(void);

/**
 * @brief Create (allocate from the pool) an app group.
 *
 * @param name   Display name.
 * @param part   The app's private memory partition.
 * @param entry  User-mode entry point.
 * @param arg    Opaque argument passed to entry (must be a value or a granted
 *               kobject - never a kernel global the user app would dereference).
 * @return The group, or NULL if the pool is exhausted.
 */
struct app_group *app_group_create(const char *name,
				   struct k_mem_partition *part,
				   app_entry_t entry, void *arg);

/**
 * @brief Grant an app group access to a service (by registry id).
 */
int app_group_grant_service(struct app_group *g, uint32_t service_id);

/**
 * @brief Start the app group's user-mode thread.
 */
int app_group_start(struct app_group *g);

/**
 * @brief Atomically tear down a group: abort its thread, revoke its grants,
 * reclaim its domain partition, and return the slot to the pool. Safe to call
 * from the supervisor thread (not from an ISR).
 */
void app_group_abort(struct app_group *g);

/**
 * @brief Called by a running app to prove liveness (resets its watchdog).
 * This is a thin wrapper over the broker; apps call it via syscall.
 */
void app_group_heartbeat(struct app_group *g);

/**
 * @brief Resolve the app group owning the currently running thread.
 *
 * The manager owns every app thread, so this maps the caller (inside a broker
 * syscall, in supervisor context) back to its group without the user app
 * having to pass an unforgeable kernel pointer. Returns NULL if the current
 * thread is not a managed app.
 */
struct app_group *app_group_current(void);

#endif /* APP_SERVICES_APP_GROUP_H_ */
```

## src/net_link.c
```c
/*
 * Copyright (c) 2026 Espressif Systems (Shanghai) Co., Ltd.
 *
 * SPDX-License-Identifier: Apache-2.0
 */

#include "net_link.h"

#include <zephyr/kernel.h>
#include <zephyr/sys/printk.h>
#include <zephyr/net/net_if.h>
#include <zephyr/net/wifi.h>
#include <zephyr/net/wifi_mgmt.h>
#include <zephyr/net/net_mgmt.h>
#include <zephyr/net/dhcpv4.h>

/* Counting sem: one permit per waiting app, topped up when the link is ready. */
K_SEM_DEFINE(net_ready_sem, 0, 8);

uint8_t net_link_gateway[4];

static atomic_t link_ready;

static struct net_mgmt_event_callback wifi_cb;
static struct net_mgmt_event_callback ipv4_cb;

#define WIFI_MGMT_EVENTS (NET_EVENT_WIFI_CONNECT_RESULT | \
			  NET_EVENT_WIFI_DISCONNECT_RESULT)

static void wifi_evt(struct net_mgmt_event_callback *cb,
		     uint64_t mgmt_event, struct net_if *iface)
{
	ARG_UNUSED(cb);

	switch (mgmt_event) {
	case NET_EVENT_WIFI_CONNECT_RESULT:
		/* The driver auto-starts DHCP (WIFI_STA_AUTO_DHCPV4), which also
		 * installs the default route. We just wait for the IPv4 event.
		 */
		printk("net_link: Wi-Fi connected, waiting for DHCP/IP\n");
		break;
	case NET_EVENT_WIFI_DISCONNECT_RESULT:
		printk("net_link: Wi-Fi disconnected\n");
		break;
	default:
		break;
	}
}

static void ipv4_evt(struct net_mgmt_event_callback *cb,
		     uint64_t mgmt_event, struct net_if *iface)
{
	ARG_UNUSED(cb);

	if (mgmt_event == NET_EVENT_IPV4_ADDR_ADD) {
		/* Diagnostic: show the assigned IP and gateway. */
		if (iface != NULL && iface->config.ip.ipv4 != NULL) {
			char ip[NET_IPV4_ADDR_LEN], gw[NET_IPV4_ADDR_LEN];

			net_addr_ntop(AF_INET,
				&iface->config.ip.ipv4->unicast[0].ipv4.address.in_addr,
				ip, sizeof(ip));
			net_addr_ntop(AF_INET, &iface->config.ip.ipv4->gw,
				      gw, sizeof(gw));
			memcpy(net_link_gateway, &iface->config.ip.ipv4->gw, 4);
			printk("net_link: IP=%s GW=%s\n", ip, gw);
		}
		printk("net_link: got IPv4 address - network READY\n");
		atomic_set(&link_ready, 1);
		/* Release every app that is (or will be) waiting. */
		for (int i = 0; i < 8; i++) {
			k_sem_give(&net_ready_sem);
		}
	}
}

int net_link_up(void)
{
	struct net_if *iface = net_if_get_first_wifi();

	if (iface == NULL) {
		printk("net_link: no Wi-Fi iface\n");
		return -ENODEV;
	}

	net_mgmt_init_event_callback(&wifi_cb, wifi_evt, WIFI_MGMT_EVENTS);
	net_mgmt_add_event_callback(&wifi_cb);

	net_mgmt_init_event_callback(&ipv4_cb, ipv4_evt, NET_EVENT_IPV4_ADDR_ADD);
	net_mgmt_add_event_callback(&ipv4_cb);

	static struct wifi_connect_req_params params;

	params.ssid = (const uint8_t *)CONFIG_APP_WIFI_SSID;
	params.ssid_length = strlen(CONFIG_APP_WIFI_SSID);
	params.psk = (const uint8_t *)CONFIG_APP_WIFI_PSK;
	params.psk_length = strlen(CONFIG_APP_WIFI_PSK);
	params.security = WIFI_SECURITY_TYPE_PSK;
	params.band = WIFI_FREQ_BAND_2_4_GHZ;
	params.channel = WIFI_CHANNEL_ANY;
	params.mfp = WIFI_MFP_OPTIONAL;

	printk("net_link: connecting to '%s'...\n", CONFIG_APP_WIFI_SSID);
	int rc = net_mgmt(NET_REQUEST_WIFI_CONNECT, iface, &params,
			  sizeof(params));
	if (rc != 0) {
		printk("net_link: connect request failed: %d\n", rc);
		return rc;
	}
	return 0;
}

int net_link_wait_ready(k_timeout_t timeout)
{
	return k_sem_take(&net_ready_sem, timeout);
}
```

## src/net_link.h
```c
/*
 * Copyright (c) 2026 Espressif Systems (Shanghai) Co., Ltd.
 *
 * SPDX-License-Identifier: Apache-2.0
 */

#ifndef APP_SERVICES_NET_LINK_H_
#define APP_SERVICES_NET_LINK_H_

#include <zephyr/kernel.h>

/*
 * Network connectivity broker. The shared Wi-Fi radio and IP stack live in the
 * trusted base: the supervisor connects to Wi-Fi and runs DHCP. Once an IP is
 * obtained, apps are released to use their OWN sockets independently (sockets
 * are user-mode syscalls, isolated per-app by kobject permission). This mirrors
 * how a phone OS owns the modem while apps each open their own connections.
 */

/**
 * @brief Bring up Wi-Fi + DHCP (supervisor context). Returns 0 on link up.
 */
int net_link_up(void);

/**
 * @brief Block until the network is ready (IP obtained), or timeout.
 * Apps wait on this (via a granted semaphore) before opening sockets.
 */
int net_link_wait_ready(k_timeout_t timeout);

/* The "network ready" semaphore apps are granted and wait on. */
extern struct k_sem net_ready_sem;

/* The assigned gateway address (4 bytes), valid once the link is ready. An
 * on-subnet, always-routable target the apps can independently connect to.
 */
extern uint8_t net_link_gateway[4];

#endif /* APP_SERVICES_NET_LINK_H_ */
```

## src/svc_broker.c
```c
/*
 * Copyright (c) 2026 Espressif Systems (Shanghai) Co., Ltd.
 *
 * SPDX-License-Identifier: Apache-2.0
 */

#include "svc_broker.h"
#include "svc_registry.h"
#include "app_group.h"

#include <zephyr/kernel.h>
#include <zephyr/internal/syscall_handler.h>
#include <zephyr/net/socket.h>
#include <string.h>
#include "net_link.h"

int z_impl_svc_request(uint32_t service_id)
{
	const struct svc_desc *svc = svc_registry_get(service_id);
	struct app_group *g = app_group_current();

	if (svc == NULL || svc->handler == NULL) {
		return -EINVAL;
	}
	return svc->handler(g);
}

void z_impl_svc_heartbeat(void)
{
	struct app_group *g = app_group_current();

	if (g != NULL) {
		app_group_heartbeat(g);
	}
}

int z_impl_svc_net_probe(uint16_t port)
{
	struct net_sockaddr_in addr = {
		.sin_family = AF_INET,
		.sin_port = htons(port),
	};

	memcpy(&addr.sin_addr, net_link_gateway, 4);

	/*
	 * Runs in supervisor mode: open a socket and connect to the target, to
	 * prove this app independently exercises the shared IP stack. Each app
	 * gets its own net_context (isolated by kobject permission); the per-app
	 * resource pool bounds the allocation.
	 */
	int sock = zsock_socket(AF_INET, SOCK_STREAM, 0);

	if (sock < 0) {
		return -errno;
	}

	int rc = zsock_connect(sock, (struct net_sockaddr *)&addr, sizeof(addr));

	zsock_close(sock);
	return (rc == 0) ? 0 : -errno;
}

#ifdef CONFIG_USERSPACE

static inline int z_vrfy_svc_request(uint32_t service_id)
{
	const struct svc_desc *svc = svc_registry_get(service_id);

	/*
	 * Per-app service gate: the caller must hold permission on the
	 * service's token kobject. An ungranted app fails here (K_OOPS kills
	 * only that app).
	 */
	if (svc == NULL || svc->token == NULL) {
		return -EINVAL;
	}
	K_OOPS(K_SYSCALL_OBJ(svc->token, K_OBJ_SEM));
	return z_impl_svc_request(service_id);
}
#include <zephyr/syscalls/svc_request_mrsh.c>

static inline void z_vrfy_svc_heartbeat(void)
{
	z_impl_svc_heartbeat();
}
#include <zephyr/syscalls/svc_heartbeat_mrsh.c>

static inline int z_vrfy_svc_net_probe(uint16_t port)
{
	return z_impl_svc_net_probe(port);
}
#include <zephyr/syscalls/svc_net_probe_mrsh.c>

#endif /* CONFIG_USERSPACE */
```

## src/svc_broker.h
```c
/*
 * Copyright (c) 2026 Espressif Systems (Shanghai) Co., Ltd.
 *
 * SPDX-License-Identifier: Apache-2.0
 */

#ifndef APP_SERVICES_SVC_BROKER_H_
#define APP_SERVICES_SVC_BROKER_H_

#include <zephyr/kernel.h>

/*
 * The broker syscalls: the only surface a user-mode app uses to reach services
 * and to prove liveness. The caller's group is resolved from the running
 * thread (the manager owns it), so no kernel pointer is passed from user mode.
 */

/**
 * @brief Request a service by id. Gated on the caller holding the service's
 * token kobject permission; an ungranted app faults at the syscall boundary
 * (only that app is killed). Returns the service handler's result, or -EPERM.
 */
__syscall int svc_request(uint32_t service_id);

/**
 * @brief Prove liveness: feeds the calling group's watchdog.
 */
__syscall void svc_heartbeat(void);

/**
 * @brief Brokered network probe: open a socket and connect to the network
 * gateway on the given port. Runs in supervisor mode; each app calls it
 * independently and gets its own socket (isolated by kobject permission,
 * bounded by the caller's resource pool). The gateway is an on-subnet,
 * always-routable target, so this proves independent per-app network I/O
 * through the shared stack.
 *
 * @param port   TCP port to connect to on the gateway.
 * @return 0 if the connection succeeded, negative errno otherwise.
 */
__syscall int svc_net_probe(uint16_t port);

#include <zephyr/syscalls/svc_broker.h>

#endif /* APP_SERVICES_SVC_BROKER_H_ */
```

## src/svc_registry.c
```c
/*
 * Copyright (c) 2026 Espressif Systems (Shanghai) Co., Ltd.
 *
 * SPDX-License-Identifier: Apache-2.0
 */

#include "svc_registry.h"
#include "app_group.h"

#include <zephyr/kernel.h>

/* Demo service: a trivial counter, proving the brokered-service path. */
K_SEM_DEFINE(demo_token, 0, 1);
static uint32_t demo_calls;

static int demo_handler(struct app_group *caller)
{
	ARG_UNUSED(caller);
	demo_calls++;
	return (int)demo_calls;
}

static const struct svc_desc services[SVC_COUNT] = {
	[SVC_DEMO] = {
		.id = SVC_DEMO,
		.name = "demo-counter",
		.token = &demo_token,
		.handler = demo_handler,
	},
};

const struct svc_desc *svc_registry_get(uint32_t id)
{
	if (id >= SVC_COUNT) {
		return NULL;
	}
	return &services[id];
}

int svc_registry_grant(struct app_group *g, uint32_t id)
{
	const struct svc_desc *svc = svc_registry_get(id);

	if (svc == NULL) {
		return -EINVAL;
	}

	/* The grant happens on the group's thread once it is created; the
	 * bitmask records intent and is applied at start time.
	 */
	g->granted_services |= BIT(id);
	return 0;
}

void svc_registry_revoke_all(struct app_group *g)
{
	for (uint32_t id = 0; id < SVC_COUNT; id++) {
		if ((g->granted_services & BIT(id)) == 0) {
			continue;
		}
		const struct svc_desc *svc = svc_registry_get(id);

		if (svc != NULL && svc->token != NULL) {
			k_object_access_revoke(svc->token, &g->thread);
		}
	}
}

bool svc_registry_granted(struct app_group *g, uint32_t id)
{
	return (g->granted_services & BIT(id)) != 0;
}
```

## src/svc_registry.h
```c
/*
 * Copyright (c) 2026 Espressif Systems (Shanghai) Co., Ltd.
 *
 * SPDX-License-Identifier: Apache-2.0
 */

#ifndef APP_SERVICES_SVC_REGISTRY_H_
#define APP_SERVICES_SVC_REGISTRY_H_

#include <zephyr/kernel.h>

struct app_group;

/* Service identifiers (bit positions in the per-app grant bitmask). */
enum svc_id {
	SVC_DEMO = 0,     /* a trivial counter service, for M1 */
	SVC_COUNT,
};

/*
 * A service descriptor. The token is the kobject whose permission represents
 * access to this service; granting it to an app's thread is what lets the
 * broker syscall through. The handler runs in supervisor mode.
 */
struct svc_desc {
	enum svc_id   id;
	const char   *name;
	struct k_sem *token;
	int (*handler)(struct app_group *caller);
};

/* Look up a service by id, or NULL. */
const struct svc_desc *svc_registry_get(uint32_t id);

/* Grant / revoke a service to an app group (token kobject + bitmask). */
int  svc_registry_grant(struct app_group *g, uint32_t id);
void svc_registry_revoke_all(struct app_group *g);

/* True if the group currently holds the grant for id. */
bool svc_registry_granted(struct app_group *g, uint32_t id);

#endif /* APP_SERVICES_SVC_REGISTRY_H_ */
```
