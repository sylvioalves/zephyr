## CMakeLists.txt
```
# SPDX-License-Identifier: Apache-2.0

cmake_minimum_required(VERSION 3.20.0)
find_package(Zephyr REQUIRED HINTS $ENV{ZEPHYR_BASE})
project(app_inspect)

target_sources(app PRIVATE
  src/main.c
  src/apps.c
)
```

## prj.conf
```kconfig
CONFIG_APPLICATION_DEFINED_SYSCALL=y

CONFIG_APP_PLATFORM=y
CONFIG_APP_PLATFORM_MAX_APPS=4
CONFIG_APP_PLATFORM_SERVICES=y

CONFIG_ENTROPY_GENERATOR=y

CONFIG_TASK_WDT=y
CONFIG_TASK_WDT_CHANNELS=6

CONFIG_THREAD_STACK_INFO=y
CONFIG_INIT_STACKS=y
CONFIG_THREAD_RUNTIME_STATS=y
CONFIG_THREAD_NAME=y

CONFIG_LOG=y
CONFIG_LOG_MODE_MINIMAL=y

CONFIG_MAIN_STACK_SIZE=4096
CONFIG_HEAP_MEM_POOL_SIZE=8192

CONFIG_PRINTK=y
CONFIG_CBPRINTF_FP_SUPPORT=n
```

## src/main.c
```c
/*
 * Copyright (c) 2026 Espressif Systems (Shanghai) Co., Ltd.
 *
 * SPDX-License-Identifier: Apache-2.0
 */

/*
 * Per-app resource inspection. Three workers with different stack and CPU
 * profiles run alongside an inspector app that holds the inspect capability. The
 * inspector prints a top-style table of every group's stack high-water mark and
 * CPU share, reading the others only through a capability-gated broker call - so
 * an app cannot observe its neighbours unless the platform granted it the right.
 */

#include <zephyr/app_platform/app_platform.h>
#include <zephyr/app_platform/app_caps.h>
#include <zephyr/kernel.h>
#include <zephyr/sys/printk.h>

extern void app_spinner(void *arg);
extern void app_sleeper(void *arg);
extern void app_deep(void *arg);
extern void app_inspector(void *arg);

int main(void)
{
	printk("\n*** app platform: per-app resource inspection (C6) ***\n");

	if (app_platform_init() != 0) {
		printk("platform init failed\n");
		return 0;
	}

	const struct app_def apps[] = {
		{"spinner", APP_BUILTIN, app_spinner, APP_CAP_LOG, false},
		{"sleeper", APP_BUILTIN, app_sleeper, APP_CAP_LOG, false},
		{"deep", APP_BUILTIN, app_deep, APP_CAP_LOG, false},
		{"inspector", APP_BUILTIN, app_inspector, APP_CAP_LOG | APP_CAP_INSPECT, false},
	};

	for (size_t i = 0; i < ARRAY_SIZE(apps); i++) {
		app_platform_launch(&apps[i]);
	}

	k_msleep(6000);

	printk("\n*** done: inspector reported per-app stack and cpu use ***\n");
	return 0;
}
```

## src/app_caps.h
```c
/*
 * Copyright (c) 2026 Espressif Systems (Shanghai) Co., Ltd.
 *
 * SPDX-License-Identifier: Apache-2.0
 */

#ifndef APP_INSPECT_CAPS_H_
#define APP_INSPECT_CAPS_H_

/* The right to observe other application groups' status. */
#define CAP_INSPECT BIT(0)

#endif /* APP_INSPECT_CAPS_H_ */
```

## src/apps.c
```c
/*
 * Copyright (c) 2026 Espressif Systems (Shanghai) Co., Ltd.
 *
 * SPDX-License-Identifier: Apache-2.0
 */

/*
 * Worker apps with different resource profiles, plus an inspector app that holds
 * the inspect capability and prints a top-style table of every group's stack and
 * CPU use. The inspector reads the others only through the brokered app_svc_app_info
 * call; an app without APP_CAP_INSPECT is refused.
 */

#include <zephyr/app_platform/app_services.h>
#include <zephyr/kernel.h>
#include <stdio.h>

/* spinner: burns CPU continuously - should show a high cycle share. */
void app_spinner(void *arg)
{
	ARG_UNUSED(arg);

	app_svc_log("spinner: started");
	for (;;) {
		volatile uint32_t x = 0;

		for (uint32_t i = 0; i < 1000000; i++) {
			x += i;
		}
	}
}

/* sleeper: mostly idle - should show a low cycle share. */
void app_sleeper(void *arg)
{
	ARG_UNUSED(arg);

	app_svc_log("sleeper: started");
	for (;;) {
		k_msleep(1000);
	}
}

/* deep: recurses to grow its stack high-water mark. */
static void recurse(int depth)
{
	volatile char pad[64];

	pad[0] = (char)depth;
	if (depth > 0) {
		recurse(depth - 1);
	}
	(void)pad[0];
}

void app_deep(void *arg)
{
	ARG_UNUSED(arg);

	app_svc_log("deep: started");
	recurse(6);
	for (;;) {
		k_msleep(1000);
	}
}

/* inspector: prints a status table for all groups, every second. */
void app_inspector(void *arg)
{
	ARG_UNUSED(arg);

	int n = app_svc_app_count();

	for (int round = 0; round < 4; round++) {
		k_msleep(1000);
		app_svc_log("---- app status ----");
		for (int id = 0; id < n; id++) {
			struct app_svc_app_info info;

			if (app_svc_app_info(id, &info) != 0) {
				continue;
			}

			uint32_t share = 0;

			if (info.cpu_total != 0) {
				share = (uint32_t)((info.cpu_cycles * 1000U) / info.cpu_total);
			}

			char line[80];

			snprintf(line, sizeof(line),
				 "%-9s stack %u/%u B  cpu %u.%u%%%s",
				 info.name, info.stack_used, info.stack_size,
				 share / 10U, share % 10U,
				 info.monitored ? "  [mon]" : "");
			app_svc_log(line);
		}
	}
	app_svc_log("inspector: done");
}
```

## src/svc.c
```c
/*
 * Copyright (c) 2026 Espressif Systems (Shanghai) Co., Ltd.
 *
 * SPDX-License-Identifier: Apache-2.0
 */

#include "svc.h"
#include "app_caps.h"

#include <zephyr/kernel.h>
#include <zephyr/sys/printk.h>
#include <zephyr/internal/syscall_handler.h>
#include <zephyr/app_platform/app_platform.h>
#include <string.h>
#include <errno.h>

void z_impl_svc_log(const char *msg)
{
	printk("    [app %d] %s\n", app_platform_id_current(), msg);
}

int z_impl_svc_app_count(void)
{
	return app_platform_count();
}

int z_impl_svc_app_info(int id, struct svc_app_info *out)
{
	if ((app_platform_caps_current() & CAP_INSPECT) == 0U) {
		return -EPERM;
	}

	struct app_platform_status st;
	int ret = app_platform_status(id, &st);

	if (ret != 0) {
		return ret;
	}

	*out = (struct svc_app_info){
		.active = st.active,
		.monitored = st.monitored,
		.faulted = st.faulted,
		.stack_size = st.stack_size,
		.stack_used = st.stack_used,
		.cpu_cycles = st.cpu_cycles,
		.cpu_total = st.cpu_total,
	};
	strncpy(out->name, st.name ? st.name : "", sizeof(out->name) - 1);

	return 0;
}

#ifdef CONFIG_USERSPACE
static inline void z_vrfy_svc_log(const char *msg)
{
	char buf[96];

	if (k_usermode_string_copy(buf, (char *)msg, sizeof(buf)) == 0) {
		z_impl_svc_log(buf);
	}
}
#include <zephyr/syscalls/svc_log_mrsh.c>

static inline int z_vrfy_svc_app_count(void)
{
	return z_impl_svc_app_count();
}
#include <zephyr/syscalls/svc_app_count_mrsh.c>

static inline int z_vrfy_svc_app_info(int id, struct svc_app_info *out)
{
	K_OOPS(K_SYSCALL_MEMORY_WRITE(out, sizeof(*out)));
	return z_impl_svc_app_info(id, out);
}
#include <zephyr/syscalls/svc_app_info_mrsh.c>
#endif
```

## src/svc.h
```c
/*
 * Copyright (c) 2026 Espressif Systems (Shanghai) Co., Ltd.
 *
 * SPDX-License-Identifier: Apache-2.0
 */

#ifndef APP_INSPECT_SVC_H_
#define APP_INSPECT_SVC_H_

#include <zephyr/kernel.h>

/* User-mode-safe snapshot of one app group (name is a copy, not a pointer). */
struct svc_app_info {
	char     name[16];
	bool     active;
	bool     monitored;
	bool     faulted;
	uint32_t stack_size;
	uint32_t stack_used;
	uint64_t cpu_cycles;
	uint64_t cpu_total;
};

/* Services for the inspect demo. */
__syscall void svc_log(const char *msg);

/* Number of app slots. */
__syscall int svc_app_count(void);

/*
 * Read group @id into @out. Requires the inspect capability; an app without it
 * gets -EPERM, so one app cannot observe the others unless granted.
 */
__syscall int svc_app_info(int id, struct svc_app_info *out);

#include <zephyr/syscalls/svc.h>

#endif /* APP_INSPECT_SVC_H_ */
```
