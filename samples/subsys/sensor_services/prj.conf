## CMakeLists.txt
```
# SPDX-License-Identifier: Apache-2.0

cmake_minimum_required(VERSION 3.20.0)
find_package(Zephyr REQUIRED HINTS $ENV{ZEPHYR_BASE})
project(sensor_services)

zephyr_syscall_header(${CMAKE_CURRENT_SOURCE_DIR}/src/sensor_broker.h)

target_sources(app PRIVATE
  src/main.c
  src/sensor_broker.c
  src/sensor_catalog.c
)
```

## prj.conf
```kconfig
CONFIG_USERSPACE=y
CONFIG_APPLICATION_DEFINED_SYSCALL=y

CONFIG_SENSOR=y

CONFIG_LOG=y
CONFIG_LOG_MODE_MINIMAL=y
CONFIG_THREAD_NAME=y
```

## boards/esp32c6_devkitc_esp32c6_hpcore.overlay
```dts
/*
 * Copyright (c) 2026 Espressif Systems (Shanghai) Co., Ltd.
 *
 * SPDX-License-Identifier: Apache-2.0
 */

/* Enable the on-chip temperature sensor so the temperature service is present. */
&coretemp {
	status = "okay";
};
```

## src/main.c
```c
/*
 * Copyright (c) 2026 Espressif Systems (Shanghai) Co., Ltd.
 *
 * SPDX-License-Identifier: Apache-2.0
 */

/*
 * Sensor services: the platform announces a catalog of typed sensor services.
 * Apps discover what is available and read values by type, never touching the
 * peripheral, bus, or driver. Read-only sensors are shared: any number of apps
 * read them in parallel, like the network service. Here two isolated user-mode
 * apps both read the temperature concurrently.
 */

#include "sensor_broker.h"

#include <zephyr/kernel.h>
#include <zephyr/sys/printk.h>

extern void sensor_catalog_init(void);

#define STACK_SIZE 2048
#define APP_PRIO   5
#define TEMP_IDX   0   /* the temperature service is catalog entry 0 */

K_THREAD_STACK_DEFINE(stack_a, STACK_SIZE);
K_THREAD_STACK_DEFINE(stack_b, STACK_SIZE);
static struct k_thread th_a, th_b;

/* A reader app: continuously reads the temperature service in user mode. */
static void reader_app(void *name_p, void *p2, void *p3)
{
	ARG_UNUSED(p2); ARG_UNUSED(p3);
	const char *name = name_p;

	for (int i = 0; ; i++) {
		int32_t milli;
		int rc = svc_sensor_read(TEMP_IDX, &milli);

		if (rc == 0) {
			printk("  [%s] #%d temperature = %d.%03d C\n",
			       name, i, milli / 1000, (milli < 0 ? -milli : milli) % 1000);
		} else {
			printk("  [%s] #%d read rc=%d\n", name, i, rc);
		}
		k_msleep(700);
	}
}

static void announce_catalog(void)
{
	int n = svc_sensor_count();

	printk("\nplatform announces %d sensor services:\n", n);
	for (int i = 0; i < n; i++) {
		char name[24], unit[12];
		bool present;

		if (svc_sensor_info(i, name, sizeof(name), unit, sizeof(unit),
				    &present) == 0) {
			printk("  [%2d] %-16s (%-8s) %s\n", i, name, unit,
			       present ? "PRESENT" : "announced");
		}
	}
}

int main(void)
{
	printk("\n*** sensor services: announced catalog, parallel reads (C6) ***\n");

	sensor_catalog_init();
	announce_catalog();

	printk("\ntwo isolated apps reading the temperature service in parallel:\n");

	k_tid_t ta = k_thread_create(&th_a, stack_a, STACK_SIZE, reader_app,
				     "app-A", NULL, NULL, APP_PRIO, K_USER,
				     K_FOREVER);
	k_tid_t tb = k_thread_create(&th_b, stack_b, STACK_SIZE, reader_app,
				     "app-B", NULL, NULL, APP_PRIO, K_USER,
				     K_FOREVER);

	k_thread_start(ta);
	k_thread_start(tb);
	return 0;
}
```

## src/sensor_broker.c
```c
/*
 * Copyright (c) 2026 Espressif Systems (Shanghai) Co., Ltd.
 *
 * SPDX-License-Identifier: Apache-2.0
 */

#include "sensor_broker.h"
#include "sensor_catalog.h"

#include <zephyr/kernel.h>
#include <zephyr/internal/syscall_handler.h>
#include <string.h>

int z_impl_svc_sensor_count(void)
{
	return sensor_catalog_count();
}

int z_impl_svc_sensor_info(int idx, char *name, size_t name_sz,
			   char *unit, size_t unit_sz, bool *present)
{
	struct sensor_svc s;
	int rc = sensor_catalog_get(idx, &s);

	if (rc != 0) {
		return rc;
	}

	strncpy(name, s.name, name_sz - 1);
	name[name_sz - 1] = '\0';
	strncpy(unit, s.unit, unit_sz - 1);
	unit[unit_sz - 1] = '\0';
	*present = s.present;
	return 0;
}

int z_impl_svc_sensor_read(int idx, int32_t *milli_value)
{
	return sensor_catalog_read(idx, milli_value);
}

#ifdef CONFIG_USERSPACE

static inline int z_vrfy_svc_sensor_count(void)
{
	return z_impl_svc_sensor_count();
}
#include <zephyr/syscalls/svc_sensor_count_mrsh.c>

static inline int z_vrfy_svc_sensor_info(int idx, char *name, size_t name_sz,
					 char *unit, size_t unit_sz,
					 bool *present)
{
	K_OOPS(K_SYSCALL_MEMORY_WRITE(name, name_sz));
	K_OOPS(K_SYSCALL_MEMORY_WRITE(unit, unit_sz));
	K_OOPS(K_SYSCALL_MEMORY_WRITE(present, sizeof(*present)));
	return z_impl_svc_sensor_info(idx, name, name_sz, unit, unit_sz, present);
}
#include <zephyr/syscalls/svc_sensor_info_mrsh.c>

static inline int z_vrfy_svc_sensor_read(int idx, int32_t *milli_value)
{
	K_OOPS(K_SYSCALL_MEMORY_WRITE(milli_value, sizeof(*milli_value)));
	return z_impl_svc_sensor_read(idx, milli_value);
}
#include <zephyr/syscalls/svc_sensor_read_mrsh.c>

#endif /* CONFIG_USERSPACE */
```

## src/sensor_broker.h
```c
/*
 * Copyright (c) 2026 Espressif Systems (Shanghai) Co., Ltd.
 *
 * SPDX-License-Identifier: Apache-2.0
 */

#ifndef SENSOR_SERVICES_SENSOR_BROKER_H_
#define SENSOR_SERVICES_SENSOR_BROKER_H_

#include <zephyr/kernel.h>

/*
 * Broker syscalls the apps use to discover and read announced sensor services.
 * The catalog and the underlying devices live in the trusted base; apps only
 * pass indices and small buffers. Reads are read-only and shareable, so any
 * number of apps may read in parallel.
 */

/* How many sensor services the platform announces. */
__syscall int svc_sensor_count(void);

/*
 * Discover service @p idx: copies the name (up to name_sz) and the unit (up to
 * unit_sz) into the caller's buffers, and writes whether it is present here.
 * Returns 0 on success.
 */
__syscall int svc_sensor_info(int idx, char *name, size_t name_sz,
			      char *unit, size_t unit_sz, bool *present);

/*
 * Read service @p idx; writes the value in milli-units. Returns 0 on success,
 * -ENODEV if announced but not present on this board.
 */
__syscall int svc_sensor_read(int idx, int32_t *milli_value);

#include <zephyr/syscalls/sensor_broker.h>

#endif /* SENSOR_SERVICES_SENSOR_BROKER_H_ */
```

## src/sensor_catalog.c
```c
/*
 * Copyright (c) 2026 Espressif Systems (Shanghai) Co., Ltd.
 *
 * SPDX-License-Identifier: Apache-2.0
 */

#include "sensor_catalog.h"

#include <zephyr/kernel.h>
#include <zephyr/device.h>
#include <zephyr/drivers/sensor.h>

/*
 * The board's real die-temperature sensor, bound from devicetree. This is the
 * one entry actually backed by hardware on this board; every read of the
 * AMBIENT/DIE temperature service goes through it.
 */
#define HAVE_DIE_TEMP DT_NODE_EXISTS(DT_ALIAS(die_temp0))
#if HAVE_DIE_TEMP
static const struct device *const die_temp = DEVICE_DT_GET(DT_ALIAS(die_temp0));
#endif

/* One mutex serializes the actual bus transaction; reads still appear parallel. */
static struct k_mutex bus_lock;

/*
 * The announced catalog. Most entries are "announced, not present here": the
 * platform knows the type, but this board has no device for it. Attach the
 * matching peripheral (and declare it in the base firmware's devicetree), and
 * the same service becomes live without any app change. The temperature entry
 * is present on this board.
 */
static struct sensor_svc catalog[] = {
	/* Environment */
	{ "temperature",      SENSOR_CHAN_AMBIENT_TEMP, "m.degC",   true  },
	{ "humidity",         SENSOR_CHAN_HUMIDITY,     "m.%RH",    false },
	{ "pressure",         SENSOR_CHAN_PRESS,        "m.kPa",    false },
	{ "altitude",         SENSOR_CHAN_ALTITUDE,     "mm",       false },
	{ "gas-resistance",   SENSOR_CHAN_GAS_RES,      "ohm",      false },
	{ "voc",              SENSOR_CHAN_VOC,          "ppb",      false },

	/* Light / optical */
	{ "ambient-light",    SENSOR_CHAN_AMBIENT_LIGHT, "m.lux",    false },
	{ "ir",               SENSOR_CHAN_IR,           "raw",      false },
	{ "red",              SENSOR_CHAN_RED,          "raw",      false },
	{ "green",            SENSOR_CHAN_GREEN,        "raw",      false },
	{ "blue",             SENSOR_CHAN_BLUE,         "raw",      false },
	{ "proximity",        SENSOR_CHAN_PROX,         "raw",      false },
	{ "distance",         SENSOR_CHAN_DISTANCE,     "mm",       false },

	/* Motion (IMU) */
	{ "accel-x",          SENSOR_CHAN_ACCEL_X,      "m.m/s2",   false },
	{ "accel-y",          SENSOR_CHAN_ACCEL_Y,      "m.m/s2",   false },
	{ "accel-z",          SENSOR_CHAN_ACCEL_Z,      "m.m/s2",   false },
	{ "gyro-x",           SENSOR_CHAN_GYRO_X,       "m.dps",    false },
	{ "gyro-y",           SENSOR_CHAN_GYRO_Y,       "m.dps",    false },
	{ "gyro-z",           SENSOR_CHAN_GYRO_Z,       "m.dps",    false },
	{ "magn-x",           SENSOR_CHAN_MAGN_X,       "m.gauss",  false },
	{ "magn-y",           SENSOR_CHAN_MAGN_Y,       "m.gauss",  false },
	{ "magn-z",           SENSOR_CHAN_MAGN_Z,       "m.gauss",  false },
	{ "rotation",         SENSOR_CHAN_ROTATION,     "m.deg",    false },

	/* Power / electrical */
	{ "voltage",          SENSOR_CHAN_VOLTAGE,      "mV",       false },
	{ "current",          SENSOR_CHAN_CURRENT,      "mA",       false },
	{ "power",            SENSOR_CHAN_POWER,        "mW",       false },
	{ "resistance",       SENSOR_CHAN_RESISTANCE,   "ohm",      false },

	/* Mechanical / rate */
	{ "rpm",              SENSOR_CHAN_RPM,          "rpm",      false },
	{ "frequency",        SENSOR_CHAN_FREQUENCY,    "mHz",      false },
	{ "flow-rate",        SENSOR_CHAN_FLOW_RATE,    "m.L/min",  false },

	/* Battery / fuel gauge */
	{ "batt-voltage",     SENSOR_CHAN_GAUGE_VOLTAGE,        "mV",   false },
	{ "batt-current",     SENSOR_CHAN_GAUGE_AVG_CURRENT,    "mA",   false },
	{ "batt-charge",      SENSOR_CHAN_GAUGE_STATE_OF_CHARGE, "m.%",  false },
	{ "batt-health",      SENSOR_CHAN_GAUGE_STATE_OF_HEALTH, "m.%",  false },
	{ "batt-temp",        SENSOR_CHAN_GAUGE_TEMP,           "m.degC", false },
};

#define CATALOG_COUNT ((int)ARRAY_SIZE(catalog))

void sensor_catalog_init(void)
{
	k_mutex_init(&bus_lock);
}

int sensor_catalog_count(void)
{
	return CATALOG_COUNT;
}

int sensor_catalog_get(int idx, struct sensor_svc *out)
{
	if (idx < 0 || idx >= CATALOG_COUNT) {
		return -EINVAL;
	}
	*out = catalog[idx];
	return 0;
}

int sensor_catalog_read(int idx, int32_t *milli_value)
{
	if (idx < 0 || idx >= CATALOG_COUNT) {
		return -EINVAL;
	}
	if (!catalog[idx].present) {
		return -ENODEV;
	}

#if HAVE_DIE_TEMP
	int rc;

	/* Serialize the real bus transaction; callers still appear parallel. */
	k_mutex_lock(&bus_lock, K_FOREVER);

	rc = sensor_sample_fetch(die_temp);
	if (rc == 0) {
		struct sensor_value val;

		rc = sensor_channel_get(die_temp, SENSOR_CHAN_DIE_TEMP, &val);
		if (rc == 0) {
			*milli_value = val.val1 * 1000 + val.val2 / 1000;
		}
	}

	k_mutex_unlock(&bus_lock);
	return rc;
#else
	return -ENODEV;
#endif
}
```

## src/sensor_catalog.h
```c
/*
 * Copyright (c) 2026 Espressif Systems (Shanghai) Co., Ltd.
 *
 * SPDX-License-Identifier: Apache-2.0
 */

#ifndef SENSOR_SERVICES_SENSOR_CATALOG_H_
#define SENSOR_SERVICES_SENSOR_CATALOG_H_

#include <zephyr/kernel.h>
#include <zephyr/drivers/sensor.h>

/*
 * Sensor service catalog. The platform ANNOUNCES a list of typed sensor
 * services. An app asks for a value by type (e.g. SENSOR_CHAN_AMBIENT_TEMP) and
 * never touches the underlying peripheral, bus, or driver. Read-only sensor
 * services are shared by all apps reading concurrently - like the network
 * service in M2, but simpler because reads cannot conflict.
 *
 * A catalog entry is "present" when this board actually has a device backing
 * that channel (bound from the base firmware's devicetree); otherwise it is
 * "announced" - the platform knows the type but has no hardware for it here.
 * Apps query the catalog to discover what is available before reading.
 */

struct sensor_svc {
	const char         *name;        /* human-facing service name        */
	enum sensor_channel chan;        /* the Zephyr typed channel         */
	const char         *unit;        /* unit of the returned value       */
	bool                present;     /* backed by a real device here?    */
};

/* Initialize the catalog (bus lock). Call once at startup. */
void sensor_catalog_init(void);

/* Number of announced sensor services. */
int sensor_catalog_count(void);

/* Get a catalog entry by index (read-only, copies metadata out). */
int sensor_catalog_get(int idx, struct sensor_svc *out);

/*
 * Read a sensor value by catalog index. Returns the value in milli-units
 * (e.g. milli-degrees C). Safe to call from many apps in parallel; reads are
 * serialized internally on the bus but appear concurrent to callers. Returns
 * -ENODEV if the service is announced but not present on this board.
 */
int sensor_catalog_read(int idx, int32_t *milli_value);

#endif /* SENSOR_SERVICES_SENSOR_CATALOG_H_ */
```
