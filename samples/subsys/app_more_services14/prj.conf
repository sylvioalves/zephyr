## CMakeLists.txt
```
# SPDX-License-Identifier: Apache-2.0

cmake_minimum_required(VERSION 3.20.0)
find_package(Zephyr REQUIRED HINTS $ENV{ZEPHYR_BASE})
project(app_more_services14)

zephyr_syscall_header(${CMAKE_CURRENT_SOURCE_DIR}/src/svc.h)

target_sources(app PRIVATE src/main.c src/svc.c)
```

## prj.conf
```kconfig
CONFIG_USERSPACE=y
CONFIG_APPLICATION_DEFINED_SYSCALL=y

# Networking over IEEE 802.15.4.
CONFIG_NETWORKING=y
CONFIG_NET_SOCKETS=y
CONFIG_NET_IPV6=y
CONFIG_NET_IPV4=n
CONFIG_NET_TCP=n
CONFIG_NET_UDP=y

CONFIG_NET_L2_IEEE802154=y
CONFIG_NET_L2_IEEE802154_SHELL=y
CONFIG_NET_CONFIG_IEEE802154_CHANNEL=26

CONFIG_NET_CONFIG_SETTINGS=y
CONFIG_NET_CONFIG_NEED_IPV6=y
CONFIG_NET_CONFIG_MY_IPV6_ADDR="2001:db8::2"
CONFIG_NET_CONFIG_PEER_IPV6_ADDR="2001:db8::1"

CONFIG_NET_PKT_RX_COUNT=16
CONFIG_NET_PKT_TX_COUNT=16
CONFIG_NET_BUF_RX_COUNT=32
CONFIG_NET_BUF_TX_COUNT=32

CONFIG_LOG=y
CONFIG_LOG_MODE_MINIMAL=y
CONFIG_THREAD_NAME=y

CONFIG_MAIN_STACK_SIZE=4096
CONFIG_HEAP_MEM_POOL_SIZE=16384
```

## boards/esp32c6_devkitc_esp32c6_hpcore.overlay
```dts
/*
 * Copyright (c) 2026 Espressif Systems (Shanghai) Co., Ltd.
 *
 * SPDX-License-Identifier: Apache-2.0
 */

/* Enable the IEEE 802.15.4 radio for the messaging service. */
&ieee802154 {
	status = "okay";
};
```

## src/main.c
```c
/*
 * Copyright (c) 2026 Espressif Systems (Shanghai) Co., Ltd.
 *
 * SPDX-License-Identifier: Apache-2.0
 */

/*
 * An app exchanging messages over IEEE 802.15.4 through a service from user
 * mode. The platform owns the radio interface, the net stack, and a UDP socket
 * to the peer; the app sends payloads and reads the echoes the peer returns,
 * never touching the radio or the socket directly. The peer is an esp32c5
 * running the echo server over 802.15.4.
 */

#include "svc.h"

#include <zephyr/kernel.h>
#include <zephyr/sys/printk.h>
#include <string.h>

#define STACK_SIZE 2048
#define APP_PRIO   5

K_THREAD_STACK_DEFINE(app_stack, STACK_SIZE);
static struct k_thread app_thread;

static void app_entry(void *p1, void *p2, void *p3)
{
	ARG_UNUSED(p1); ARG_UNUSED(p2); ARG_UNUSED(p3);

	for (int round = 0; round < 5; round++) {
		char msg[32];
		int n = snprintk(msg, sizeof(msg), "hello-802154-%d", round);

		int sent = svc_radio_send((const uint8_t *)msg, n);

		printk("  [app] round %d: sent \"%s\" (%d bytes)\n", round, msg, sent);

		uint8_t in[64] = { 0 };
		int got = svc_radio_recv(in, sizeof(in) - 1, 1000);

		if (got > 0) {
			in[got] = '\0';
			printk("  [app] echo back (%d bytes): \"%s\"\n", got, in);
		} else {
			printk("  [app] no echo (rc=%d)\n", got);
		}

		k_msleep(500);
	}

	printk("  [app] done - messaged the peer over 802.15.4\n");
}

int main(void)
{
	printk("\n*** more services 14: IEEE 802.15.4 messaging (C6) ***\n");

	int rc = svc_radio_install();

	printk("  [platform] radio socket install rc=%d\n", rc);

	k_tid_t t = k_thread_create(&app_thread, app_stack, STACK_SIZE, app_entry,
				    NULL, NULL, NULL, APP_PRIO, K_USER, K_FOREVER);

	k_thread_start(t);
	k_thread_join(t, K_FOREVER);

	printk("\n*** done ***\n");
	return 0;
}
```

## src/svc.c
```c
/*
 * Copyright (c) 2026 Espressif Systems (Shanghai) Co., Ltd.
 *
 * SPDX-License-Identifier: Apache-2.0
 */

#include "svc.h"

#include <zephyr/kernel.h>
#include <zephyr/net/socket.h>
#include <zephyr/internal/syscall_handler.h>
#include <string.h>
#include <errno.h>

#define PAYLOAD_MAX 64
#define PEER_ADDR   "2001:db8::1"
#define PEER_PORT   4242

/* The platform owns the radio socket; the app only hands over payloads. */
static int sock = -1;
static struct sockaddr_in6 peer;

/*
 * All socket I/O runs in supervisor threads so the user app never holds the
 * socket kobject. The app hands payloads to a tx queue and reads from an rx
 * queue; the platform's threads move them on and off the radio socket.
 */
struct rx_msg {
	uint8_t data[PAYLOAD_MAX];
	uint16_t len;
};
K_MSGQ_DEFINE(rx_q, sizeof(struct rx_msg), 8, 4);
K_MSGQ_DEFINE(tx_q, sizeof(struct rx_msg), 8, 4);

static K_THREAD_STACK_DEFINE(rx_stack, 2048);
static K_THREAD_STACK_DEFINE(tx_stack, 2048);
static struct k_thread rx_thread;
static struct k_thread tx_thread;

static void rx_loop(void *p1, void *p2, void *p3)
{
	ARG_UNUSED(p1); ARG_UNUSED(p2); ARG_UNUSED(p3);

	while (true) {
		struct rx_msg m;
		int n = zsock_recv(sock, m.data, sizeof(m.data), 0);

		if (n > 0) {
			m.len = (uint16_t)n;
			(void)k_msgq_put(&rx_q, &m, K_NO_WAIT);
		} else {
			k_msleep(20);
		}
	}
}

static void tx_loop(void *p1, void *p2, void *p3)
{
	ARG_UNUSED(p1); ARG_UNUSED(p2); ARG_UNUSED(p3);

	while (true) {
		struct rx_msg m;

		if (k_msgq_get(&tx_q, &m, K_FOREVER) == 0) {
			(void)zsock_send(sock, m.data, m.len, 0);
		}
	}
}

int svc_radio_install(void)
{
	sock = zsock_socket(AF_INET6, SOCK_DGRAM, IPPROTO_UDP);
	if (sock < 0) {
		return -errno;
	}

	peer.sin6_family = AF_INET6;
	peer.sin6_port = htons(PEER_PORT);
	if (zsock_inet_pton(AF_INET6, PEER_ADDR, &peer.sin6_addr) != 1) {
		return -EINVAL;
	}

	if (zsock_connect(sock, (struct sockaddr *)&peer, sizeof(peer)) < 0) {
		return -errno;
	}

	k_thread_create(&rx_thread, rx_stack, K_THREAD_STACK_SIZEOF(rx_stack),
			rx_loop, NULL, NULL, NULL, K_PRIO_COOP(7), 0, K_NO_WAIT);
	k_thread_create(&tx_thread, tx_stack, K_THREAD_STACK_SIZEOF(tx_stack),
			tx_loop, NULL, NULL, NULL, K_PRIO_COOP(7), 0, K_NO_WAIT);
	return 0;
}

int z_impl_svc_radio_send(const uint8_t *buf, size_t len)
{
	if (sock < 0 || len == 0U || len > PAYLOAD_MAX) {
		return -EINVAL;
	}

	struct rx_msg m;

	m.len = (uint16_t)len;
	memcpy(m.data, buf, len);
	if (k_msgq_put(&tx_q, &m, K_MSEC(100)) != 0) {
		return -EAGAIN;
	}
	return (int)len;
}

int z_impl_svc_radio_recv(uint8_t *buf, size_t cap, int32_t timeout_ms)
{
	struct rx_msg m;
	k_timeout_t t = (timeout_ms < 0) ? K_FOREVER : K_MSEC(timeout_ms);

	if (k_msgq_get(&rx_q, &m, t) != 0) {
		return -EAGAIN;
	}

	size_t n = MIN((size_t)m.len, cap);

	memcpy(buf, m.data, n);
	return (int)n;
}

#ifdef CONFIG_USERSPACE
static inline int z_vrfy_svc_radio_send(const uint8_t *buf, size_t len)
{
	if (len > PAYLOAD_MAX) {
		return -EINVAL;
	}
	K_OOPS(K_SYSCALL_MEMORY_READ(buf, len));
	return z_impl_svc_radio_send(buf, len);
}
#include <zephyr/syscalls/svc_radio_send_mrsh.c>

static inline int z_vrfy_svc_radio_recv(uint8_t *buf, size_t cap, int32_t timeout_ms)
{
	if (cap > PAYLOAD_MAX) {
		cap = PAYLOAD_MAX;
	}
	K_OOPS(K_SYSCALL_MEMORY_WRITE(buf, cap));
	return z_impl_svc_radio_recv(buf, cap, timeout_ms);
}
#include <zephyr/syscalls/svc_radio_recv_mrsh.c>
#endif
```

## src/svc.h
```c
/*
 * Copyright (c) 2026 Espressif Systems (Shanghai) Co., Ltd.
 *
 * SPDX-License-Identifier: Apache-2.0
 */

#ifndef APP_MORE_SERVICES14_SVC_H_
#define APP_MORE_SERVICES14_SVC_H_

#include <zephyr/kernel.h>

/*
 * A fourteenth batch: an IEEE 802.15.4 radio messaging service. The platform
 * owns the 802.15.4 interface, the net stack, and a UDP socket bound to a peer
 * over the radio. The app sends and receives raw payloads from user mode; the
 * supervisor carries them over 802.15.4 to the peer and back, the same brokered
 * shape used for MQTT but over the radio instead of Wi-Fi.
 *
 *   svc_radio_send - send @len payload bytes to the peer over 802.15.4.
 *   svc_radio_recv - poll the next received payload; -EAGAIN if none waiting.
 */

/* Scoped: send @buf[0..len) to the peer over the radio. Returns bytes sent. */
__syscall int svc_radio_send(const uint8_t *buf, size_t len);

/* Scoped: poll the next received payload into @buf (cap @cap); -EAGAIN if none. */
__syscall int svc_radio_recv(uint8_t *buf, size_t cap, int32_t timeout_ms);

/* Supervisor-only: bring up the radio socket to the peer before the app runs. */
int svc_radio_install(void);

#include <zephyr/syscalls/svc.h>

#endif /* APP_MORE_SERVICES14_SVC_H_ */
```
