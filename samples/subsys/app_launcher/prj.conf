## CMakeLists.txt
```
# SPDX-License-Identifier: Apache-2.0

cmake_minimum_required(VERSION 3.20.0)
find_package(Zephyr REQUIRED HINTS $ENV{ZEPHYR_BASE})
project(app_launcher)

target_sources(app PRIVATE src/main.c src/launcher_sim.c)
```

## prj.conf
```kconfig
CONFIG_MAIN_STACK_SIZE=8192

CONFIG_DISPLAY=y
CONFIG_INPUT=y

CONFIG_LVGL=y
CONFIG_LV_Z_MEM_POOL_SIZE=32768
CONFIG_LV_FONT_MONTSERRAT_14=y

CONFIG_LOG=y
CONFIG_PRINTK=y
```

## boards/esp32c5_devkitc_esp32c5_hpcore.overlay
```dts
/*
 * Copyright (c) 2026 Espressif Systems (Shanghai) Co., Ltd.
 *
 * SPDX-License-Identifier: Apache-2.0
 */

/* No panel on the devkit: a dummy display controller satisfies the chosen
 * node so the launcher runs headless.
 */

/ {
	chosen {
		zephyr,display = &dummy_dc;
	};

	dummy_dc: dummy_dc {
		compatible = "zephyr,dummy-dc";
		height = <240>;
		width = <320>;
	};
};
```

## boards/qemu_riscv32.overlay
```dts
/*
 * Copyright (c) 2026 Espressif Systems (Shanghai) Co., Ltd.
 *
 * SPDX-License-Identifier: Apache-2.0
 */

/ {
	chosen {
		zephyr,display = &dummy_dc;
	};

	dummy_dc: dummy_dc {
		compatible = "zephyr,dummy-dc";
		height = <240>;
		width = <320>;
	};
};
```

## src/main.c
```c
/*
 * Copyright (c) 2026 Espressif Systems (Shanghai) Co., Ltd.
 *
 * SPDX-License-Identifier: Apache-2.0
 */

/*
 * App launcher: a touch/keypad LVGL UI that lists isolated applications as
 * tiles and lets the user start or kill each one, with live status. The UI
 * talks only to launcher.h, so it runs unchanged on the host simulator and on
 * memory-protected hardware where the tiles control real isolated apps.
 */

#include "launcher.h"

#include <stdio.h>
#include <zephyr/kernel.h>
#include <zephyr/device.h>
#include <zephyr/drivers/display.h>
#include <lvgl.h>

struct tile {
	lv_obj_t *panel;
	lv_obj_t *name_lbl;
	lv_obj_t *state_lbl;
	lv_obj_t *btn_lbl;
	int       idx;
};

static struct tile tiles[LAUNCHER_MAX_APPS];

static const char *state_text(enum launcher_app_state s)
{
	switch (s) {
	case LAUNCHER_RUNNING: return "RUNNING";
	case LAUNCHER_CRASHED: return "CRASHED";
	default:               return "stopped";
	}
}

static uint32_t state_color(enum launcher_app_state s)
{
	switch (s) {
	case LAUNCHER_RUNNING: return 0x2e7d32;  /* green  */
	case LAUNCHER_CRASHED: return 0xc62828;  /* red    */
	default:               return 0x555555;  /* grey   */
	}
}

/* Toggle: start a stopped/crashed app, kill a running one. */
static void tile_btn_cb(lv_event_t *e)
{
	struct tile *t = lv_event_get_user_data(e);
	struct launcher_app_info info;

	if (launcher_app_get(t->idx, &info) != 0) {
		return;
	}
	if (info.state == LAUNCHER_RUNNING) {
		launcher_app_kill(t->idx);
	} else {
		launcher_app_start(t->idx);
	}
}

static void build_ui(void)
{
	lv_obj_t *scr = lv_scr_act();

	lv_obj_t *title = lv_label_create(scr);

	lv_label_set_text(title, "App Launcher");
	lv_obj_align(title, LV_ALIGN_TOP_MID, 0, 4);

	int n = launcher_app_count();

	for (int i = 0; i < n && i < LAUNCHER_MAX_APPS; i++) {
		struct launcher_app_info info;

		launcher_app_get(i, &info);

		lv_obj_t *panel = lv_obj_create(scr);

		lv_obj_set_size(panel, LV_PCT(94), 52);
		lv_obj_align(panel, LV_ALIGN_TOP_MID, 0, 26 + i * 56);
		lv_obj_set_flex_flow(panel, LV_FLEX_FLOW_ROW);
		lv_obj_set_flex_align(panel, LV_FLEX_ALIGN_SPACE_BETWEEN,
				      LV_FLEX_ALIGN_CENTER, LV_FLEX_ALIGN_CENTER);

		lv_obj_t *name_lbl = lv_label_create(panel);

		lv_label_set_text(name_lbl, info.name);

		lv_obj_t *state_lbl = lv_label_create(panel);

		lv_label_set_text(state_lbl, state_text(info.state));

		lv_obj_t *btn = lv_button_create(panel);

		lv_obj_set_size(btn, 70, 34);

		lv_obj_t *btn_lbl = lv_label_create(btn);

		lv_label_set_text(btn_lbl, "Start");
		lv_obj_center(btn_lbl);

		tiles[i].panel = panel;
		tiles[i].name_lbl = name_lbl;
		tiles[i].state_lbl = state_lbl;
		tiles[i].btn_lbl = btn_lbl;
		tiles[i].idx = i;

		lv_obj_add_event_cb(btn, tile_btn_cb, LV_EVENT_CLICKED, &tiles[i]);
	}
}

static void refresh_ui(void)
{
	int n = launcher_app_count();

	for (int i = 0; i < n && i < LAUNCHER_MAX_APPS; i++) {
		struct launcher_app_info info;

		if (launcher_app_get(i, &info) != 0) {
			continue;
		}

		static char buf[24];

		if (info.state == LAUNCHER_RUNNING) {
			snprintf(buf, sizeof(buf), "RUNNING  %u", info.ticks);
		} else {
			snprintf(buf, sizeof(buf), "%s", state_text(info.state));
		}
		lv_label_set_text(tiles[i].state_lbl, buf);
		lv_obj_set_style_text_color(tiles[i].state_lbl,
					    lv_color_hex(state_color(info.state)), 0);
		lv_label_set_text(tiles[i].btn_lbl,
				  info.state == LAUNCHER_RUNNING ? "Kill" : "Start");
	}
}

int main(void)
{
	const struct device *display_dev =
		DEVICE_DT_GET(DT_CHOSEN(zephyr_display));

	if (!device_is_ready(display_dev)) {
		return 0;
	}

	launcher_init();
	build_ui();
	lv_timer_handler();
	display_blanking_off(display_dev);

	/*
	 * Headless self-exercise so the lifecycle is observable without a screen:
	 * start two apps, including the buggy one, and let it crash + be
	 * reclaimed. On hardware with a panel, the user drives this by touch.
	 */
	launcher_app_start(0);
	launcher_app_start(2);   /* the buggy app */

	int prev[LAUNCHER_MAX_APPS] = { -1, -1, -1, -1 };

	while (1) {
		int n = launcher_app_count();

		for (int i = 0; i < n && i < LAUNCHER_MAX_APPS; i++) {
			struct launcher_app_info info;

			launcher_app_get(i, &info);
			if ((int)info.state != prev[i]) {
				printk("launcher: app '%s' -> %s\n", info.name,
				       info.state == LAUNCHER_RUNNING ? "RUNNING" :
				       info.state == LAUNCHER_CRASHED ? "CRASHED" :
				       "stopped");
				prev[i] = info.state;
			}
		}

		refresh_ui();
		uint32_t sleep = lv_timer_handler();

		k_msleep(MIN(sleep, 100));
	}
	return 0;
}
```

## src/launcher.h
```c
/*
 * Copyright (c) 2026 Espressif Systems (Shanghai) Co., Ltd.
 *
 * SPDX-License-Identifier: Apache-2.0
 */

#ifndef APP_LAUNCHER_LAUNCHER_H_
#define APP_LAUNCHER_LAUNCHER_H_

#include <zephyr/kernel.h>
#include <stdbool.h>

/*
 * Display-agnostic application control API. The launcher UI calls only this;
 * the backend drives the real app-group manager (isolated user-mode apps on a
 * memory-protected target) or a host-friendly stand-in on native_sim. Keeping
 * the UI behind this seam lets the same launcher run in the simulator and on
 * hardware unchanged.
 */

#define LAUNCHER_MAX_APPS 4

enum launcher_app_state {
	LAUNCHER_STOPPED = 0,
	LAUNCHER_RUNNING,
	LAUNCHER_CRASHED,
};

struct launcher_app_info {
	const char             *name;
	enum launcher_app_state state;
	uint32_t                ticks;   /* liveness counter the app advances */
};

/** Initialize the backend (app manager). Call once at startup. */
int launcher_init(void);

/** Number of apps in the catalog. */
int launcher_app_count(void);

/** Snapshot an app's current info by index. Returns 0 on success. */
int launcher_app_get(int idx, struct launcher_app_info *out);

/** Start app @p idx. No-op if already running. */
int launcher_app_start(int idx);

/** Stop/kill app @p idx and reclaim it. No-op if already stopped. */
int launcher_app_kill(int idx);

#endif /* APP_LAUNCHER_LAUNCHER_H_ */
```

## src/launcher_sim.c
```c
/*
 * Copyright (c) 2026 Espressif Systems (Shanghai) Co., Ltd.
 *
 * SPDX-License-Identifier: Apache-2.0
 */

/*
 * Launcher backend for native_sim. The simulator does not provide the
 * memory-protected userspace the hardware backend uses, so here each app is a
 * plain supervised thread. This exercises the launcher UI and the full
 * lifecycle (start / run / kill / crash-and-reclaim) so the UI can be built and
 * iterated on the host; the hardware backend swaps this for the real app-group
 * manager behind the same launcher.h API.
 */

#include "launcher.h"

#include <zephyr/kernel.h>

#define APP_STACK_SIZE 1024
#define APP_PRIO       7

struct sim_app {
	const char             *name;
	bool                    crashy;   /* fault a few ticks after start */
	enum launcher_app_state state;
	uint32_t                ticks;
	struct k_thread         thread;
	bool                    stop;
};

K_THREAD_STACK_ARRAY_DEFINE(app_stacks, LAUNCHER_MAX_APPS, APP_STACK_SIZE);

static struct sim_app apps[] = {
	{ .name = "sensors",  .crashy = false },
	{ .name = "telemetry", .crashy = false },
	{ .name = "buggy",    .crashy = true  },
};

#define APP_COUNT ((int)ARRAY_SIZE(apps))

static void app_thread(void *p1, void *p2, void *p3)
{
	ARG_UNUSED(p2); ARG_UNUSED(p3);
	struct sim_app *a = p1;

	a->ticks = 0;
	while (!a->stop) {
		a->ticks++;
		if (a->crashy && a->ticks >= 6) {
			/* Simulate a fault: the supervisor marks it crashed and
			 * reclaims it, mirroring the hardware containment path.
			 */
			a->state = LAUNCHER_CRASHED;
			return;
		}
		k_msleep(500);
	}
	a->state = LAUNCHER_STOPPED;
}

int launcher_init(void)
{
	for (int i = 0; i < APP_COUNT; i++) {
		apps[i].state = LAUNCHER_STOPPED;
		apps[i].ticks = 0;
	}
	return 0;
}

int launcher_app_count(void)
{
	return APP_COUNT;
}

int launcher_app_get(int idx, struct launcher_app_info *out)
{
	if (idx < 0 || idx >= APP_COUNT) {
		return -EINVAL;
	}
	out->name = apps[idx].name;
	out->state = apps[idx].state;
	out->ticks = apps[idx].ticks;
	return 0;
}

int launcher_app_start(int idx)
{
	if (idx < 0 || idx >= APP_COUNT) {
		return -EINVAL;
	}
	struct sim_app *a = &apps[idx];

	if (a->state == LAUNCHER_RUNNING) {
		return 0;
	}

	a->stop = false;
	a->ticks = 0;
	a->state = LAUNCHER_RUNNING;
	k_thread_create(&a->thread, app_stacks[idx], APP_STACK_SIZE,
			app_thread, a, NULL, NULL, APP_PRIO, 0, K_NO_WAIT);
	return 0;
}

int launcher_app_kill(int idx)
{
	if (idx < 0 || idx >= APP_COUNT) {
		return -EINVAL;
	}
	struct sim_app *a = &apps[idx];

	if (a->state == LAUNCHER_STOPPED) {
		return 0;
	}

	a->stop = true;
	k_thread_abort(&a->thread);
	a->state = LAUNCHER_STOPPED;
	a->ticks = 0;
	return 0;
}
```
