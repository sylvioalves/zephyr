## soc/xtensa/esp32/Kconfig.defconfig
```kconfig
# ESP32 board configuration

# Copyright (c) 2017 Intel Corporation
# SPDX-License-Identifier: Apache-2.0

DT_CHOSEN_Z_CONSOLE := zephyr,console
DT_COMPAT_ESPRESSIF_ESP32_UART := espressif,esp32-uart

if SOC_ESP32

if BOOTLOADER_MCUBOOT
	config HAS_FLASH_LOAD_OFFSET
		default y

	config MCUBOOT_GENERATE_UNSIGNED_IMAGE
		default y

	config MCUBOOT_GENERATE_CONFIRMED_IMAGE
		default y

	config ROM_START_OFFSET
		default 0x20

	config HAS_DYNAMIC_DEVICE_HANDLES
		default y
endif

config SOC
	default "esp32"

config SOC_TOOLCHAIN_NAME
	string
	default "espressif_esp32"

if SMP

config SCHED_IPI_SUPPORTED
	default y

config SCHED_CPU_MASK
	default y

config MP_MAX_NUM_CPUS
	default 2

endif

config MINIMAL_LIBC_OPTIMIZE_STRING_FOR_SIZE
	default n

if GDBSTUB

# ESP32 GDB expects 420 bytes G-packet.
# So double for hexadecimal digits.
config GDBSTUB_BUF_SZ
	default 840 if GDBSTUB

endif

config ESP_CONSOLE_UART
	bool
	default $(dt_chosen_enabled,$(DT_CHOSEN_Z_CONSOLE)) && \
		$(dt_chosen_has_compat,$(DT_CHOSEN_Z_CONSOLE),$(DT_COMPAT_ESPRESSIF_ESP32_UART))
	help
	  Hidden configuration to indicate whether ESP32 uart is used. This is required in
	  hal_espressif so that UART can be proper flushed during bootloader and sleep events.

config ESP_CONSOLE_UART_NUM
	int
	default 0
	help
	  Hidden configuration to indicate UART number. During system clock initialization
	  this config is used to avoid data lost during APB frequency switching.

endif
```

## soc/xtensa/esp32/Kconfig.soc
```kconfig
# Copyright (c) 2017 Intel Corporation
# SPDX-License-Identifier: Apache-2.0

config SOC_ESP32
	bool "ESP32"
	select XTENSA
	select CLOCK_CONTROL
	select CLOCK_CONTROL_ESP32

config IDF_TARGET_ESP32
	bool
	default y
	depends on SOC_ESP32

config ESPTOOLPY_FLASHFREQ_40M
	bool
	default y
	depends on IDF_TARGET_ESP32
```

## soc/xtensa/esp32s2/Kconfig.defconfig
```kconfig
# ESP32S2 board configuration

# Copyright (c) 2021 Espressif Systems (Shanghai) Co., Ltd.
# SPDX-License-Identifier: Apache-2.0

DT_CHOSEN_Z_CONSOLE := zephyr,console
DT_COMPAT_ESPRESSIF_ESP32_UART := espressif,esp32-uart

if SOC_ESP32S2

if BOOTLOADER_MCUBOOT

config HAS_FLASH_LOAD_OFFSET
	default y

config MCUBOOT_GENERATE_UNSIGNED_IMAGE
	default y

config MCUBOOT_GENERATE_CONFIRMED_IMAGE
	default y

config ROM_START_OFFSET
	default 0x20

endif

config SOC
	default "esp32s2"

config SOC_TOOLCHAIN_NAME
	string
	default "espressif_esp32s2"

config GEN_ISR_TABLES
	default y

config GEN_IRQ_VECTOR_TABLE
	default n

config ISR_STACK_SIZE
	default 2048

config HEAP_MEM_POOL_SIZE
	default 32768

config MP_MAX_NUM_CPUS
	default 1

config MINIMAL_LIBC_OPTIMIZE_STRING_FOR_SIZE
	default n

config ESP_CONSOLE_UART
	bool
	default $(dt_chosen_enabled,$(DT_CHOSEN_Z_CONSOLE)) && \
		$(dt_chosen_has_compat,$(DT_CHOSEN_Z_CONSOLE),$(DT_COMPAT_ESPRESSIF_ESP32_UART))
	help
	  Hidden configuration to indicate whether ESP32-S2 uart is used. This is required in
	  hal_espressif so that UART can be proper flushed during bootloader and sleep events.

config ESP_CONSOLE_UART_NUM
	int
	default 0
	help
	  Hidden configuration to indicate UART number. During system clock initialization
	  this config is used to avoid data lost during APB frequency switching.

endif
```

## soc/xtensa/esp32s3_net/Kconfig.soc
```kconfig
# Copyright (c) 2022 Espressif Systems (Shanghai) Co., Ltd.
# SPDX-License-Identifier: Apache-2.0

config SOC_ESP32S3_NET
	bool "ESP32S3_NET"
	select XTENSA
	select CLOCK_CONTROL
	select DYNAMIC_INTERRUPTS
	select HAS_ESPRESSIF_HAL
	select PINCTRL

if SOC_ESP32S3_NET

config SOC_FAMILY_ESP32
	bool
	default y

config IDF_TARGET_ESP32S3
	bool "ESP32 as target board"
	default y

config ESPTOOLPY_FLASHFREQ_80M
	bool
	default y

choice ESP32_UNIVERSAL_MAC_ADDRESSES
	bool "Number of universally administered (by IEEE) MAC address"
	default ESP32_UNIVERSAL_MAC_ADDRESSES_FOUR
	help
	  Configure the number of universally administered (by IEEE) MAC addresses.
	  During initialization, MAC addresses for each network interface are generated or
	  derived from a single base MAC address. If the number of universal MAC addresses is four,
	  all four interfaces (WiFi station, WiFi softap, Bluetooth and Ethernet) receive a universally
	  administered MAC address. These are generated sequentially by adding 0, 1, 2 and 3 (respectively)
	  to the final octet of the base MAC address. If the number of universal MAC addresses is two,
	  only two interfaces (WiFi station and Bluetooth) receive a universally administered MAC address.
	  These are generated sequentially by adding 0 and 1 (respectively) to the base MAC address.
	  The remaining two interfaces (WiFi softap and Ethernet) receive local MAC addresses.
	  These are derived from the universal WiFi station and Bluetooth MAC addresses, respectively.
	  When using the default (Espressif-assigned) base MAC address, either setting can be used.
	  When using a custom universal MAC address range, the correct setting will depend on the
	  allocation of MAC addresses in this range (either 2 or 4 per device.)

config ESP32_UNIVERSAL_MAC_ADDRESSES_TWO
	bool "Two"
	select ESP_MAC_ADDR_UNIVERSE_WIFI_STA
	select ESP_MAC_ADDR_UNIVERSE_BT

config ESP32_UNIVERSAL_MAC_ADDRESSES_FOUR
	bool "Four"
	select ESP_MAC_ADDR_UNIVERSE_WIFI_STA
	select ESP_MAC_ADDR_UNIVERSE_WIFI_AP
	select ESP_MAC_ADDR_UNIVERSE_BT
	select ESP_MAC_ADDR_UNIVERSE_ETH

endchoice # ESP32_UNIVERSAL_MAC_ADDRESSES

config ESP_MAC_ADDR_UNIVERSE_WIFI_AP
	bool

config ESP_MAC_ADDR_UNIVERSE_WIFI_STA
	bool

config ESP_MAC_ADDR_UNIVERSE_BT
	bool

config ESP_MAC_ADDR_UNIVERSE_ETH
	bool

config ESP32_UNIVERSAL_MAC_ADDRESSES
	int
	default 2 if ESP32_UNIVERSAL_MAC_ADDRESSES_TWO
	default 4 if ESP32_UNIVERSAL_MAC_ADDRESSES_FOUR

config ESP32_PHY_MAX_WIFI_TX_POWER
	int "Max WiFi/BLE TX power (dBm)"
	range 10 20
	default 20
	help
		Set maximum transmit power for WiFi radio. Actual transmit power for high
		data rates may be lower than this setting.

config ESP32_PHY_MAX_TX_POWER
	int
	default ESP32_PHY_MAX_WIFI_TX_POWER

config ESP_TIMER_STACK_SIZE
	int "ESP Timer Stack Size"
	default 1024

	menu "Cache config"

		choice ESP32S3_INSTRUCTION_CACHE_SIZE
			prompt "Instruction cache size"
			default ESP32S3_INSTRUCTION_CACHE_16KB
			help
			  Instruction cache size to be set on application startup.
			  If you use 16KB instruction cache rather than 32KB instruction cache,
			  then the other 16KB will be managed by heap allocator.

			config ESP32S3_INSTRUCTION_CACHE_16KB
				bool "16KB"
			config ESP32S3_INSTRUCTION_CACHE_32KB
				bool "32KB"
		endchoice

		config ESP32S3_INSTRUCTION_CACHE_SIZE
			hex
			default 0x4000 if ESP32S3_INSTRUCTION_CACHE_16KB
			default 0x8000 if ESP32S3_INSTRUCTION_CACHE_32KB

		choice ESP32S3_ICACHE_ASSOCIATED_WAYS
			prompt "Instruction cache associated ways"
			default ESP32S3_INSTRUCTION_CACHE_8WAYS
			help
			  Instruction cache associated ways to be set on application startup.

			config ESP32S3_INSTRUCTION_CACHE_4WAYS
				bool "4 ways"
			config ESP32S3_INSTRUCTION_CACHE_8WAYS
				bool "8 ways"
		endchoice

		config ESP32S3_ICACHE_ASSOCIATED_WAYS
			int
			default 4 if ESP32S3_INSTRUCTION_CACHE_4WAYS
			default 8 if ESP32S3_INSTRUCTION_CACHE_8WAYS

		choice ESP32S3_INSTRUCTION_CACHE_LINE_SIZE
			prompt "Instruction cache line size"
			default ESP32S3_INSTRUCTION_CACHE_LINE_32B
			help
			  Instruction cache line size to be set on application startup.

			config ESP32S3_INSTRUCTION_CACHE_LINE_16B
				bool "16 Bytes"
				depends on ESP32S3_INSTRUCTION_CACHE_16KB
			config ESP32S3_INSTRUCTION_CACHE_LINE_32B
				bool "32 Bytes"
		endchoice

		config ESP32S3_INSTRUCTION_CACHE_LINE_SIZE
			int
			default 16 if ESP32S3_INSTRUCTION_CACHE_LINE_16B
			default 32 if ESP32S3_INSTRUCTION_CACHE_LINE_32B

		config ESP32S3_INSTRUCTION_CACHE_WRAP
			bool "Define instruction cache wrap mode"
			help
			  If enabled, instruction cache will use wrap mode to read spi flash or spi ram.
			  The wrap length equals to ESP32S3_INSTRUCTION_CACHE_LINE_SIZE.
			  However, it depends on complex conditions.

		choice ESP32S3_DATA_CACHE_SIZE
			prompt "Data cache size"
			default ESP32S3_DATA_CACHE_32KB
			help
			  Data cache size to be set on application startup.
			  If you use 32KB data cache rather than 64KB data cache,
			  the other 32KB will be added to the heap.

			config ESP32S3_DATA_CACHE_16KB
				bool "16KB"
			config ESP32S3_DATA_CACHE_32KB
				bool "32KB"
			config ESP32S3_DATA_CACHE_64KB
				bool "64KB"
		endchoice

		config ESP32S3_DATA_CACHE_SIZE
			hex
			# For 16KB the actual configuration is 32kb cache, but 16kb will be reserved for heap at startup
			default 0x8000 if ESP32S3_DATA_CACHE_16KB
			default 0x8000 if ESP32S3_DATA_CACHE_32KB
			default 0x10000 if ESP32S3_DATA_CACHE_64KB

		choice ESP32S3_DCACHE_ASSOCIATED_WAYS
			prompt "Data cache associated ways"
			default ESP32S3_DATA_CACHE_8WAYS
			help
			  Data cache associated ways to be set on application startup.

			config ESP32S3_DATA_CACHE_4WAYS
				bool "4 ways"
			config ESP32S3_DATA_CACHE_8WAYS
				bool "8 ways"
		endchoice

		config ESP32S3_DCACHE_ASSOCIATED_WAYS
			int
			default 4 if ESP32S3_DATA_CACHE_4WAYS
			default 8 if ESP32S3_DATA_CACHE_8WAYS

		choice ESP32S3_DATA_CACHE_LINE_SIZE
			prompt "Data cache line size"
			default ESP32S3_DATA_CACHE_LINE_32B
			help
			  Data cache line size to be set on application startup.

			config ESP32S3_DATA_CACHE_LINE_16B
				bool "16 Bytes"
				depends on ESP32S3_DATA_CACHE_16KB || ESP32S3_DATA_CACHE_32KB
			config ESP32S3_DATA_CACHE_LINE_32B
				bool "32 Bytes"
			config ESP32S3_DATA_CACHE_LINE_64B
				bool "64 Bytes"
		endchoice

		config ESP32S3_DATA_CACHE_LINE_SIZE
			int
			default 16 if ESP32S3_DATA_CACHE_LINE_16B
			default 32 if ESP32S3_DATA_CACHE_LINE_32B
			default 64 if ESP32S3_DATA_CACHE_LINE_64B

		config ESP32S3_DATA_CACHE_WRAP
			bool "Define data cache wrap mode"
			help
			  If enabled, data cache will use wrap mode to read spi flash or spi ram.
			  The wrap length equals to ESP32S3_DATA_CACHE_LINE_SIZE.
			  However, it depends on complex conditions.

		config MAC_BB_PD
			bool "Power down MAC and baseband of Wi-Fi and Bluetooth when PHY is disabled"
			depends on SOC_ESP32S3 && TICKLESS_KERNEL
			default n
			help
			  If enabled, the MAC and baseband of Wi-Fi and Bluetooth will be powered
			  down when PHY is disabled. Enabling this setting reduces power consumption
			  by a small amount but increases RAM use by approximat

		endmenu  # Cache config

config ESP_NETWORK_CORE_IRAM
	hex "ESP CPU Network core IRAM size"
	default 0x10000

endif # SOC_ESP32
```

## soc/xtensa/espressif_esp32/esp32s3/Kconfig.series
```kconfig
# Copyright (c) 2023 Espressif Systems (Shanghai) Co., Ltd.
# SPDX-License-Identifier: Apache-2.0

config SOC_SERIES_ESP32S3
	bool "ESP32S3 series"
	select XTENSA
	select SOC_FAMILY_ESP32
	select DYNAMIC_INTERRUPTS
	select CLOCK_CONTROL
	select HAS_ESPRESSIF_HAL
	select ARCH_SUPPORTS_COREDUMP

config SOC_ESP32S3
	bool "ESP32S3 default"
	depends on SOC_SERIES_ESP32S3
	select PINCTRL
	select XIP if !MCUBOOT
	select CPU_HAS_FPU
	help
	  Enable support for Espressif ESP32-S3

config SOC_ESP32S3_APPCPU
	bool "ESP32S3 for APPCPU (second core)"
	depends on SOC_SERIES_ESP32S3
	help
	  Enable support for Espressif ESP32S3 APPCPU (second core) in AMP use case.
```
