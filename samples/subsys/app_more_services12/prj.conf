## CMakeLists.txt
```
# SPDX-License-Identifier: Apache-2.0

cmake_minimum_required(VERSION 3.20.0)
find_package(Zephyr REQUIRED HINTS $ENV{ZEPHYR_BASE})
project(app_more_services12)

zephyr_syscall_header(${CMAKE_CURRENT_SOURCE_DIR}/src/svc.h)

target_sources(app PRIVATE src/main.c src/svc.c)
```

## prj.conf
```kconfig
CONFIG_USERSPACE=y
CONFIG_APPLICATION_DEFINED_SYSCALL=y

CONFIG_COUNTER=y
CONFIG_RTC=y
CONFIG_RTC_INIT_PRIORITY=70

CONFIG_LOG=y
CONFIG_LOG_MODE_MINIMAL=y
CONFIG_THREAD_NAME=y

CONFIG_MAIN_STACK_SIZE=4096
```

## boards/esp32c5_devkitc_esp32c5_hpcore.overlay
```dts
/*
 * Copyright (c) 2026 Espressif Systems (Shanghai) Co., Ltd.
 *
 * SPDX-License-Identifier: Apache-2.0
 */

&timer0 {
	status = "okay";

	counter {
		status = "okay";

		counter_rtc: counter-rtc {
			compatible = "zephyr,rtc-counter";
			status = "okay";
			alarms-count = <0>;
		};
	};
};
```

## boards/esp32c6_devkitc_esp32c6_hpcore.overlay
```dts
/*
 * Copyright (c) 2026 Espressif Systems (Shanghai) Co., Ltd.
 *
 * SPDX-License-Identifier: Apache-2.0
 */

/*
 * A counter-backed wall clock: enable timer0's counter and nest a virtual RTC
 * under it (the rtc-counter driver takes its counter from its parent node) so
 * the service can keep calendar time.
 */
&timer0 {
	status = "okay";

	counter {
		status = "okay";

		counter_rtc: counter-rtc {
			compatible = "zephyr,rtc-counter";
			status = "okay";
			alarms-count = <0>;
		};
	};
};
```

## src/main.c
```c
/*
 * Copyright (c) 2026 Espressif Systems (Shanghai) Co., Ltd.
 *
 * SPDX-License-Identifier: Apache-2.0
 */

/*
 * An app using a real-time clock through services from user mode. The platform
 * owns the RTC; the app sets the wall-clock and then reads it back a few times
 * to watch it advance, passing only plain scalar fields across the syscall
 * boundary.
 */

#include "svc.h"

#include <zephyr/kernel.h>
#include <zephyr/sys/printk.h>

#define STACK_SIZE 2048
#define APP_PRIO   5

K_THREAD_STACK_DEFINE(app_stack, STACK_SIZE);
static struct k_thread app_thread;

static void app_entry(void *p1, void *p2, void *p3)
{
	ARG_UNUSED(p1); ARG_UNUSED(p2); ARG_UNUSED(p3);

	/* Set the clock to a known time. */
	int rc = svc_rtc_set(2026, 6, 26, 12, 30, 0);

	printk("  [app] set clock to 2026-06-26 12:30:00 (rc=%d)\n", rc);

	for (int i = 0; i < 4; i++) {
		int y, mo, d, h, mi, s;

		if (svc_rtc_get(&y, &mo, &d, &h, &mi, &s) == 0) {
			printk("  [app] now: %04d-%02d-%02d %02d:%02d:%02d\n",
			       y, mo, d, h, mi, s);
		}
		k_msleep(1100);
	}

	printk("  [app] done - set and read the wall clock\n");
}

int main(void)
{
	printk("\n*** more services 12: real-time clock (C6) ***\n");

	k_tid_t t = k_thread_create(&app_thread, app_stack, STACK_SIZE, app_entry,
				    NULL, NULL, NULL, APP_PRIO, K_USER, K_FOREVER);

	k_thread_start(t);
	k_thread_join(t, K_FOREVER);

	printk("\n*** done ***\n");
	return 0;
}
```

## src/svc.c
```c
/*
 * Copyright (c) 2026 Espressif Systems (Shanghai) Co., Ltd.
 *
 * SPDX-License-Identifier: Apache-2.0
 */

#include "svc.h"

#include <zephyr/kernel.h>
#include <zephyr/device.h>
#include <zephyr/drivers/rtc.h>
#include <zephyr/internal/syscall_handler.h>
#include <errno.h>

/* The platform owns the RTC device (a counter-backed wall clock). */
static const struct device *const rtc = DEVICE_DT_GET(DT_NODELABEL(counter_rtc));

int z_impl_svc_rtc_set(int year, int mon, int mday, int hour, int min, int sec)
{
	if (!device_is_ready(rtc) || mon < 1 || mon > 12) {
		return -EINVAL;
	}

	struct rtc_time t = {
		.tm_year = year - 1900,
		.tm_mon = mon - 1,
		.tm_mday = mday,
		.tm_hour = hour,
		.tm_min = min,
		.tm_sec = sec,
		.tm_wday = -1,
		.tm_yday = -1,
		.tm_isdst = -1,
	};

	return rtc_set_time(rtc, &t);
}

int z_impl_svc_rtc_get(int *year, int *mon, int *mday, int *hour, int *min, int *sec)
{
	if (!device_is_ready(rtc)) {
		return -ENODEV;
	}

	struct rtc_time t;
	int rc = rtc_get_time(rtc, &t);

	if (rc != 0) {
		return rc;
	}

	*year = t.tm_year + 1900;
	*mon = t.tm_mon + 1;
	*mday = t.tm_mday;
	*hour = t.tm_hour;
	*min = t.tm_min;
	*sec = t.tm_sec;
	return 0;
}

#ifdef CONFIG_USERSPACE
static inline int z_vrfy_svc_rtc_set(int year, int mon, int mday, int hour, int min, int sec)
{
	return z_impl_svc_rtc_set(year, mon, mday, hour, min, sec);
}
#include <zephyr/syscalls/svc_rtc_set_mrsh.c>

static inline int z_vrfy_svc_rtc_get(int *year, int *mon, int *mday, int *hour, int *min, int *sec)
{
	K_OOPS(K_SYSCALL_MEMORY_WRITE(year, sizeof(*year)));
	K_OOPS(K_SYSCALL_MEMORY_WRITE(mon, sizeof(*mon)));
	K_OOPS(K_SYSCALL_MEMORY_WRITE(mday, sizeof(*mday)));
	K_OOPS(K_SYSCALL_MEMORY_WRITE(hour, sizeof(*hour)));
	K_OOPS(K_SYSCALL_MEMORY_WRITE(min, sizeof(*min)));
	K_OOPS(K_SYSCALL_MEMORY_WRITE(sec, sizeof(*sec)));
	return z_impl_svc_rtc_get(year, mon, mday, hour, min, sec);
}
#include <zephyr/syscalls/svc_rtc_get_mrsh.c>
#endif
```

## src/svc.h
```c
/*
 * Copyright (c) 2026 Espressif Systems (Shanghai) Co., Ltd.
 *
 * SPDX-License-Identifier: Apache-2.0
 */

#ifndef APP_MORE_SERVICES12_SVC_H_
#define APP_MORE_SERVICES12_SVC_H_

#include <zephyr/kernel.h>

/*
 * A twelfth batch: a real-time-clock wall-clock service, built on a counter that
 * keeps running across the device. The platform owns the RTC; the app sets and
 * reads the calendar time as plain scalars, so the driver time struct never
 * crosses the user/kernel boundary.
 *
 *   svc_rtc_set - set the wall-clock to the given calendar fields.
 *   svc_rtc_get - read the current wall-clock into the given fields.
 */

/* Scoped: set the RTC to @year-@mon-@mday @hour:@min:@sec (mon 1..12). */
__syscall int svc_rtc_set(int year, int mon, int mday, int hour, int min, int sec);

/* Open: read the current wall-clock into the six output fields. */
__syscall int svc_rtc_get(int *year, int *mon, int *mday, int *hour, int *min, int *sec);

#include <zephyr/syscalls/svc.h>

#endif /* APP_MORE_SERVICES12_SVC_H_ */
```
