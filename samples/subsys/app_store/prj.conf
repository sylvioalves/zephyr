## CMakeLists.txt
```
# SPDX-License-Identifier: Apache-2.0

cmake_minimum_required(VERSION 3.20.0)
find_package(Zephyr REQUIRED HINTS $ENV{ZEPHYR_BASE})
project(app_store)

# Identity bound into the signed manifest.
set(APP_NAME    "store")
set(APP_VERSION 1)
set(APP_REQUESTED_CAPS LOG)
set(APP_REQUIRED_CAPS  LOG)

set(ext_name blink_app)
set(ext_src module/src/${ext_name}.c)
set(ext_bin ${PROJECT_BINARY_DIR}/llext/${ext_name}.llext)
set(ext_inc ${ZEPHYR_BINARY_DIR}/include/generated/${ext_name}.inc)
set(ext_mf  ${ZEPHYR_BINARY_DIR}/include/generated/${ext_name}.manifest.inc)
set(ext_sig ${ZEPHYR_BINARY_DIR}/include/generated/${ext_name}.sig.inc)

# Build the downloadable module as an llext.
app_platform_add_module(${ext_name}_ext OUTPUT ${ext_bin} SOURCES ${ext_src})

# Embed the module bytes as a C array.
generate_inc_file_for_target(app ${ext_bin} ${ext_inc})

# Build and sign a manifest binding the name, version and module hash, then
# embed the manifest and signature. The private key is generated once under the
# source tree and never compiled in.
add_custom_command(
  OUTPUT  ${ext_mf} ${ext_sig}
  COMMAND ${CMAKE_COMMAND}
          -DMODULE_BIN=${ext_bin}
          -DKEY_DIR=${CMAKE_CURRENT_SOURCE_DIR}/keys
          -DAPP_NAME=${APP_NAME}
          -DAPP_VERSION=${APP_VERSION}
          -DAPP_REQUESTED_CAPS=${APP_REQUESTED_CAPS}
          -DAPP_REQUIRED_CAPS=${APP_REQUIRED_CAPS}
          -DABI_FILE=${APP_PLATFORM_ABI_FILE}
          -DOUT_MF_INC=${ext_mf}
          -DOUT_SIG_INC=${ext_sig}
          -DPYTHON_EXECUTABLE=${PYTHON_EXECUTABLE}
          -P ${ZEPHYR_BASE}/subsys/app_platform/cmake/sign_module.cmake
  DEPENDS ${ext_bin} ${APP_PLATFORM_ABI_FILE}
)
add_custom_target(${ext_name}_sign DEPENDS ${ext_mf} ${ext_sig})
add_dependencies(${ext_name}_sign app_platform_abi)
add_dependencies(app ${ext_name}_sign)

target_sources(app PRIVATE src/main.c)
```

## prj.conf
```kconfig
CONFIG_APPLICATION_DEFINED_SYSCALL=y

CONFIG_APP_PLATFORM=y
CONFIG_APP_PLATFORM_MAX_APPS=4
CONFIG_APP_PLATFORM_LOADER=y
# Modules are signed with the development key, generated under keys/.
CONFIG_APP_PLATFORM_DEV_KEY=y
CONFIG_APP_PLATFORM_SERVICES=y

CONFIG_TASK_WDT=y
CONFIG_TASK_WDT_CHANNELS=6
CONFIG_TASK_WDT_HW_FALLBACK=n

CONFIG_MODULES=y
CONFIG_LLEXT=y
CONFIG_LLEXT_HEAP_SIZE=64
CONFIG_LLEXT_TYPE_ELF_RELOCATABLE=y

CONFIG_PSA_CRYPTO=y
CONFIG_MBEDTLS_ENABLE_HEAP=y
CONFIG_PSA_WANT_ALG_SHA_256=y

# Authenticate the downloaded module: ECDSA P-256 signature verification.
CONFIG_PSA_WANT_ALG_ECDSA=y
CONFIG_PSA_WANT_ECC_SECP_R1_256=y
CONFIG_PSA_WANT_KEY_TYPE_ECC_PUBLIC_KEY=y
CONFIG_MBEDTLS_PSA_P256M_DRIVER_ENABLED=y

CONFIG_ENTROPY_GENERATOR=y

CONFIG_LOG=y
CONFIG_LOG_MODE_MINIMAL=y
CONFIG_THREAD_NAME=y

CONFIG_MAIN_STACK_SIZE=4096
CONFIG_HEAP_MEM_POOL_SIZE=32768
```

## src/main.c
```c
/*
 * Copyright (c) 2026 Espressif Systems (Shanghai) Co., Ltd.
 *
 * SPDX-License-Identifier: Apache-2.0
 */

/*
 * App store: install and run an application module at runtime. The download is
 * a signed manifest plus the module it binds. The manifest's ECDSA P-256
 * signature is verified against the public key compiled into the firmware, and
 * the module is accepted only if it matches the signed hash - so a tampered or
 * forged module is rejected and never linked. A verified module is then
 * launched through the platform, which refuses to run any extension that did
 * not pass the loader. The bytes are embedded here for the demo, but the path -
 * verify manifest, bind module, launch isolated - is exactly what a
 * network-downloaded module follows.
 */

#include <zephyr/app_platform/app_platform.h>
#include <zephyr/app_platform/app_loader.h>
#include <zephyr/app_platform/app_manifest.h>
#include <zephyr/app_platform/app_caps.h>
#include <zephyr/kernel.h>
#include <zephyr/sys/printk.h>
#include <zephyr/llext/llext.h>
#include <zephyr/llext/buf_loader.h>
#include <errno.h>

/* The "downloaded" release: module bytes, the signed manifest binding name,
 * version and hash, and its signature.
 */
static uint8_t module_buf[] __aligned(8) = {
#include "blink_app.inc"
};
static const uint8_t module_manifest[] = {
#include "blink_app.manifest.inc"
};
static const uint8_t module_sig[] = {
#include "blink_app.sig.inc"
};

/* The most a loaded application may hold; its manifest requests its own. */
#define APP_CAPS_CEILING (APP_CAP_LOG | APP_CAP_TIME)

static int install_and_run(const struct app_manifest *mf, size_t mf_len, const uint8_t *sig,
			   uint8_t *buf, size_t len)
{
	struct llext *ext = NULL;
	void *entry = NULL;

	printk("app-store: installing '%s' v%u (%zu bytes)\n", mf->name,
	       mf->version, len);

	int rc = app_loader_verify_load_manifest(mf, mf_len, sig, APP_MANIFEST_SIG_LEN, buf, len,
						 "app_main", &ext, &entry);

	if (rc != 0) {
		printk("app-store: VERIFY FAILED (rc=%d) - install REJECTED\n",
		       rc);
		return rc;
	}

	rc = app_platform_launch_llext(mf->name, ext, (app_entry_t)entry, NULL,
				       APP_CAPS_CEILING);
	if (rc < 0) {
		printk("app-store: launch refused (rc=%d)\n", rc);
		return rc;
	}
	printk("app-store: '%s' installed and running (isolated app %d)\n",
	       mf->name, rc);
	return 0;
}

int main(void)
{
	const struct app_manifest *mf =
		(const struct app_manifest *)module_manifest;
	size_t len = ARRAY_SIZE(module_buf);

	printk("\n*** app store: verify + install + run a signed module ***\n");

	if (app_platform_init() != 0) {
		printk("platform init failed\n");
		return 0;
	}

	/* 1. A genuine module: the manifest verifies, it installs and runs. */
	printk("\n=== case 1: genuine signed module ===\n");
	install_and_run(mf, ARRAY_SIZE(module_manifest), module_sig, module_buf, len);

	k_msleep(3000);

	/* 2. A tampered module: flip a byte; the module no longer matches the
	 * signed manifest hash, so install must be rejected.
	 */
	printk("\n=== case 2: tampered module ===\n");
	uint8_t saved = module_buf[len / 2];

	module_buf[len / 2] ^= 0xff;
	install_and_run(mf, ARRAY_SIZE(module_manifest), module_sig, module_buf, len);
	module_buf[len / 2] = saved;

	/* 3. Bypass attempt: load the module raw, skipping the verifier, and try
	 * to launch it directly. The platform must refuse an extension that did
	 * not pass the loader, so verification cannot be side-stepped.
	 */
	printk("\n=== case 3: launch a module that skipped verification ===\n");
	struct llext_buf_loader bl = LLEXT_BUF_LOADER(module_buf, len);
	struct llext_load_param parm = LLEXT_LOAD_PARAM_DEFAULT;
	struct llext *raw = NULL;

	if (llext_load(&bl.loader, "rogue", &raw, &parm) == 0) {
		const void *entry = llext_find_sym(&raw->exp_tab, "app_main");
		int rc = app_platform_launch_llext("rogue", raw,
						   (app_entry_t)entry, NULL, APP_CAPS_CEILING);

		if (rc == -EPERM) {
			printk("app-store: unverified module refused at launch OK\n");
		} else {
			printk("SECURITY FAIL: unverified module launched (rc=%d)\n",
			       rc);
		}
	}

	printk("\n*** done: signed module ran; tampered and unverified "
	       "modules rejected ***\n");
	return 0;
}
```
