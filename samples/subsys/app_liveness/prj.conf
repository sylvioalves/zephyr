## CMakeLists.txt
```
# SPDX-License-Identifier: Apache-2.0

cmake_minimum_required(VERSION 3.20.0)
find_package(Zephyr REQUIRED HINTS $ENV{ZEPHYR_BASE})
project(app_liveness)

zephyr_syscall_header(${CMAKE_CURRENT_SOURCE_DIR}/src/svc.h)

target_sources(app PRIVATE
  src/main.c
  src/svc.c
  src/apps.c
)
```

## prj.conf
```kconfig
CONFIG_USERSPACE=y
CONFIG_APPLICATION_DEFINED_SYSCALL=y

CONFIG_APP_PLATFORM=y
CONFIG_APP_PLATFORM_MAX_APPS=4

CONFIG_TASK_WDT=y
CONFIG_TASK_WDT_CHANNELS=6

CONFIG_LOG=y
CONFIG_LOG_MODE_MINIMAL=y
CONFIG_THREAD_NAME=y

CONFIG_MAX_DOMAIN_PARTITIONS=8
CONFIG_MAIN_STACK_SIZE=4096
CONFIG_HEAP_MEM_POOL_SIZE=8192
```

## src/main.c
```c
/*
 * Copyright (c) 2026 Espressif Systems (Shanghai) Co., Ltd.
 *
 * SPDX-License-Identifier: Apache-2.0
 */

/*
 * Liveness model demo. The platform reclaims a misbehaving app two ways:
 * passively when its thread dies (crash or exit, no app cooperation), and - only
 * if the app opted in - when it stops feeding a heartbeat watchdog (hang). This
 * launches three apps side by side to show each case, and proves a busy app that
 * never heartbeats is left alone.
 */

#include "svc.h"

#include <zephyr/app_platform/app_platform.h>
#include <zephyr/kernel.h>
#include <zephyr/sys/printk.h>

extern void app_busy(void *arg);
extern void app_crasher(void *arg);
extern void app_hanger(void *arg);

int main(void)
{
	printk("\n*** app platform: liveness model (C6) ***\n");

	if (app_platform_init() != 0) {
		printk("platform init failed\n");
		return 0;
	}

	const struct app_def busy = {
		.name = "busy", .source = APP_BUILTIN, .entry = app_busy,
		.caps = 0, .monitored = false,
	};
	const struct app_def crasher = {
		.name = "crasher", .source = APP_BUILTIN, .entry = app_crasher,
		.caps = 0, .monitored = false,
	};
	const struct app_def hanger = {
		.name = "hanger", .source = APP_BUILTIN, .entry = app_hanger,
		.caps = 0, .monitored = true,
	};

	app_platform_launch(&busy);
	app_platform_launch(&crasher);
	app_platform_launch(&hanger);

	k_msleep(8000);

	printk("\n*** done: crash and hang reclaimed, busy app left running ***\n");
	return 0;
}
```

## src/apps.c
```c
/*
 * Copyright (c) 2026 Espressif Systems (Shanghai) Co., Ltd.
 *
 * SPDX-License-Identifier: Apache-2.0
 */

/*
 * Three apps that exercise the platform's liveness model:
 *
 *   busy    - an unmonitored app that runs forever without ever calling
 *             heartbeat. It must never be reclaimed: being busy is not a fault.
 *   crasher - an unmonitored app that dereferences NULL. The platform reclaims
 *             it passively, with no cooperation, the moment its thread dies.
 *   hanger  - a monitored app that opts in to hang detection, feeds the
 *             watchdog for a while, then stops feeding and blocks forever. Only
 *             a monitored app is reclaimed for hanging.
 */

#include "svc.h"

#include <zephyr/kernel.h>

void app_busy(void *arg)
{
	ARG_UNUSED(arg);

	app_log("busy: running real work, never heartbeats");
	for (;;) {
		volatile uint32_t x = 0;

		for (uint32_t i = 0; i < 200000; i++) {
			x += i;
		}
		app_log("busy: still working (not reclaimed)");
		k_msleep(700);
	}
}

void app_crasher(void *arg)
{
	ARG_UNUSED(arg);

	app_log("crasher: about to fault");
	k_msleep(300);

	volatile uint32_t *p = NULL;
	*p = 0xdead;
}

void app_hanger(void *arg)
{
	ARG_UNUSED(arg);

	app_log("hanger: monitored, feeding watchdog");
	for (int i = 0; i < 3; i++) {
		app_beat();
		k_msleep(500);
	}

	app_log("hanger: stopped responding (simulated hang)");
	for (;;) {
		k_msleep(K_TICKS_FOREVER);
	}
}
```

## src/svc.c
```c
/*
 * Copyright (c) 2026 Espressif Systems (Shanghai) Co., Ltd.
 *
 * SPDX-License-Identifier: Apache-2.0
 */

#include "svc.h"

#include <zephyr/kernel.h>
#include <zephyr/sys/printk.h>
#include <zephyr/internal/syscall_handler.h>
#include <zephyr/app_platform/app_platform.h>

void z_impl_app_log(const char *msg)
{
	printk("    [app %d] %s\n", app_platform_id_current(), msg);
}

void z_impl_app_beat(void)
{
	app_platform_heartbeat();
}

#ifdef CONFIG_USERSPACE
static inline void z_vrfy_app_log(const char *msg)
{
	char buf[64];

	if (k_usermode_string_copy(buf, (char *)msg, sizeof(buf)) == 0) {
		z_impl_app_log(buf);
	}
}
#include <zephyr/syscalls/app_log_mrsh.c>

static inline void z_vrfy_app_beat(void)
{
	z_impl_app_beat();
}
#include <zephyr/syscalls/app_beat_mrsh.c>
#endif
```

## src/svc.h
```c
/*
 * Copyright (c) 2026 Espressif Systems (Shanghai) Co., Ltd.
 *
 * SPDX-License-Identifier: Apache-2.0
 */

#ifndef APP_LIVENESS_SVC_H_
#define APP_LIVENESS_SVC_H_

#include <zephyr/kernel.h>

/* Minimal services for the liveness demo apps. */
__syscall void app_log(const char *msg);
__syscall void app_beat(void);

#include <zephyr/syscalls/svc.h>

#endif /* APP_LIVENESS_SVC_H_ */
```
