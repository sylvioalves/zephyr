## CMakeLists.txt
```
# SPDX-License-Identifier: Apache-2.0

cmake_minimum_required(VERSION 3.20.0)
find_package(Zephyr REQUIRED HINTS $ENV{ZEPHYR_BASE})
project(app_more_services2)

zephyr_syscall_header(${CMAKE_CURRENT_SOURCE_DIR}/src/svc.h)

target_sources(app PRIVATE src/main.c src/svc.c)
```

## prj.conf
```kconfig
CONFIG_USERSPACE=y
CONFIG_APPLICATION_DEFINED_SYSCALL=y

# crypto
CONFIG_PSA_CRYPTO=y
CONFIG_MBEDTLS_ENABLE_HEAP=y
CONFIG_PSA_WANT_ALG_SHA_256=y

# persistent key-value via settings over NVS on flash
CONFIG_FLASH=y
CONFIG_FLASH_MAP=y
CONFIG_NVS=y
CONFIG_SETTINGS=y
CONFIG_SETTINGS_NVS=y

CONFIG_LOG=y
CONFIG_LOG_MODE_MINIMAL=y
CONFIG_THREAD_NAME=y

CONFIG_MAIN_STACK_SIZE=4096
CONFIG_HEAP_MEM_POOL_SIZE=16384
```

## src/main.c
```c
/*
 * Copyright (c) 2026 Espressif Systems (Shanghai) Co., Ltd.
 *
 * SPDX-License-Identifier: Apache-2.0
 */

/*
 * An app using crypto and a persistent key-value store. It hashes a string with
 * SHA-256, then stores a boot counter in its key-value namespace, reads it back,
 * and increments it - so the value survives reboots. Both are reached only
 * through service syscalls from user mode.
 */

#include "svc.h"

#include <zephyr/kernel.h>
#include <zephyr/sys/printk.h>
#include <string.h>

#define STACK_SIZE 2048
#define APP_PRIO   5

extern void svc_init(void);

K_THREAD_STACK_DEFINE(app_stack, STACK_SIZE);
static struct k_thread app_thread;

static void app_entry(void *p1, void *p2, void *p3)
{
	ARG_UNUSED(p1); ARG_UNUSED(p2); ARG_UNUSED(p3);

	/* crypto: hash a string. */
	const char *msg = "hello platform";
	uint8_t digest[32];

	if (svc_sha256((const uint8_t *)msg, strlen(msg), digest) == 0) {
		printk("  [app] sha256(\"%s\") = %02x%02x%02x%02x...\n",
		       msg, digest[0], digest[1], digest[2], digest[3]);
	}

	/* key-value: read a persistent boot counter, increment, store. */
	uint32_t boots = 0;
	int rc = svc_kv_get("boots", &boots);

	if (rc == 0) {
		printk("  [app] persistent boot counter = %u (loaded from KV)\n",
		       boots);
	} else {
		printk("  [app] no boot counter yet (first run)\n");
	}

	boots++;
	svc_kv_set("boots", boots);
	printk("  [app] stored boot counter = %u (will survive reboot)\n", boots);

	printk("  [app] done - used crypto + persistent key-value store\n");
}

int main(void)
{
	printk("\n*** more services 2: crypto + persistent KV (C6) ***\n");
	svc_init();

	k_tid_t t = k_thread_create(&app_thread, app_stack, STACK_SIZE, app_entry,
				    NULL, NULL, NULL, APP_PRIO, K_USER, K_FOREVER);

	k_thread_start(t);
	k_thread_join(t, K_FOREVER);

	printk("\n*** reset the board: the boot counter advances ***\n");
	return 0;
}
```

## src/svc.c
```c
/*
 * Copyright (c) 2026 Espressif Systems (Shanghai) Co., Ltd.
 *
 * SPDX-License-Identifier: Apache-2.0
 */

#include "svc.h"

#include <zephyr/kernel.h>
#include <zephyr/sys/printk.h>
#include <zephyr/settings/settings.h>
#include <psa/crypto.h>
#include <zephyr/internal/syscall_handler.h>
#include <string.h>

#define KEY_MAX 32

void svc_init(void)
{
	psa_crypto_init();
	settings_subsys_init();
}

/* ---- crypto: SHA-256 ---- */
int z_impl_svc_sha256(const uint8_t *in, size_t in_len, uint8_t *out)
{
	size_t olen;
	psa_status_t st = psa_hash_compute(PSA_ALG_SHA_256, in, in_len,
					   out, 32, &olen);

	return (st == PSA_SUCCESS && olen == 32) ? 0 : -EIO;
}

/* ---- key-value store over settings, namespaced under "app/" ---- */
struct kv_ctx {

	uint32_t    val;
	bool        found;
};

static int kv_direct_cb(const char *key, size_t len, settings_read_cb read_cb,
			void *cb_arg, void *param)
{
	struct kv_ctx *c = param;

	ARG_UNUSED(key);
	/* The subtree is the exact key, so any invocation is our value. */
	if (len == sizeof(uint32_t)) {
		read_cb(cb_arg, &c->val, sizeof(c->val));
		c->found = true;
	}
	return 0;
}

int z_impl_svc_kv_set(const char *key, uint32_t value)
{
	char path[KEY_MAX + 8];

	(void)snprintk(path, sizeof(path), "app/%s", key);
	return settings_save_one(path, &value, sizeof(value));
}

int z_impl_svc_kv_get(const char *key, uint32_t *out)
{
	char path[KEY_MAX + 8];

	(void)snprintk(path, sizeof(path), "app/%s", key);

	struct kv_ctx c = { .found = false };

	settings_load_subtree_direct(path, kv_direct_cb, &c);
	if (!c.found) {
		return -ENOENT;
	}
	*out = c.val;
	return 0;
}

#ifdef CONFIG_USERSPACE
static inline int z_vrfy_svc_sha256(const uint8_t *in, size_t in_len,
				    uint8_t *out)
{
	K_OOPS(K_SYSCALL_MEMORY_READ(in, in_len));
	K_OOPS(K_SYSCALL_MEMORY_WRITE(out, 32));
	return z_impl_svc_sha256(in, in_len, out);
}
#include <zephyr/syscalls/svc_sha256_mrsh.c>

static inline int z_vrfy_svc_kv_set(const char *key, uint32_t value)
{
	char kbuf[KEY_MAX];

	if (k_usermode_string_copy(kbuf, (char *)key, sizeof(kbuf)) != 0) {
		return -EFAULT;
	}
	return z_impl_svc_kv_set(kbuf, value);
}
#include <zephyr/syscalls/svc_kv_set_mrsh.c>

static inline int z_vrfy_svc_kv_get(const char *key, uint32_t *out)
{
	char kbuf[KEY_MAX];

	if (k_usermode_string_copy(kbuf, (char *)key, sizeof(kbuf)) != 0) {
		return -EFAULT;
	}
	K_OOPS(K_SYSCALL_MEMORY_WRITE(out, sizeof(*out)));
	return z_impl_svc_kv_get(kbuf, out);
}
#include <zephyr/syscalls/svc_kv_get_mrsh.c>
#endif
```

## src/svc.h
```c
/*
 * Copyright (c) 2026 Espressif Systems (Shanghai) Co., Ltd.
 *
 * SPDX-License-Identifier: Apache-2.0
 */

#ifndef APP_MORE_SERVICES2_SVC_H_
#define APP_MORE_SERVICES2_SVC_H_

#include <zephyr/kernel.h>

/*
 * A second batch of services, touching subsystems not covered elsewhere:
 *
 *   crypto (PSA)   - svc_sha256: hash a buffer; an open, stateless service.
 *   key-value store - svc_kv_set / svc_kv_get over the settings subsystem; a
 *                     per-app keyspace persisted across reboots (namespaced).
 *
 * An app stores a value, reads it back, and hashes data, all through service
 * syscalls; the keyed data survives a reboot.
 */

/* Open: SHA-256 of @in (len @in_len) into the 32-byte @out. */
__syscall int svc_sha256(const uint8_t *in, size_t in_len, uint8_t *out);

/* Namespaced KV: persist a small value under @key (within the app's keyspace). */
__syscall int svc_kv_set(const char *key, uint32_t value);
/* Read it back; writes the value to @out. Returns 0 or -ENOENT. */
__syscall int svc_kv_get(const char *key, uint32_t *out);

#include <zephyr/syscalls/svc.h>

#endif /* APP_MORE_SERVICES2_SVC_H_ */
```
