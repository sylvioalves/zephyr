## CMakeLists.txt
```
# SPDX-License-Identifier: Apache-2.0

cmake_minimum_required(VERSION 3.20.0)
find_package(Zephyr REQUIRED HINTS $ENV{ZEPHYR_BASE})
project(ipc_multi)

target_sources(app PRIVATE
  src/main.c
)

# Build the one module three times as three roles, each a verified llext.
set(ext_src ${PROJECT_SOURCE_DIR}/module/src/ipc_app.c)

function(build_role name role)
  set(bin ${PROJECT_BINARY_DIR}/llext/${name}.llext)
  set(inc ${ZEPHYR_BINARY_DIR}/include/generated/${name}.inc)
  set(sha ${ZEPHYR_BINARY_DIR}/include/generated/${name}.sha256.inc)

  app_platform_add_module(${name}_ext OUTPUT ${bin} SOURCES ${ext_src})
  llext_compile_definitions(${name}_ext ROLE=${role})
  llext_include_directories(${name}_ext
    ${ZEPHYR_BINARY_DIR}/include/generated
  )
  generate_inc_file_for_target(app ${bin} ${inc})

  add_custom_command(
    OUTPUT  ${sha}
    COMMAND ${CMAKE_COMMAND}
      -DMODULE_BIN=${bin}
      -DOUT_INC=${sha}
      -P ${CMAKE_CURRENT_SOURCE_DIR}/cmake/gen_sha256_inc.cmake
    DEPENDS ${bin}
  )
  add_custom_target(${name}_sha DEPENDS ${sha})
  add_dependencies(app ${name}_sha)
endfunction()

build_role(producer 1)
build_role(consumer 2)
build_role(logger 3)
```

## prj.conf
```kconfig
CONFIG_APPLICATION_DEFINED_SYSCALL=y

CONFIG_APP_PLATFORM=y
CONFIG_APP_PLATFORM_MAX_APPS=4
CONFIG_APP_PLATFORM_LOADER=y
CONFIG_APP_PLATFORM_SERVICES=y

CONFIG_TASK_WDT=y
CONFIG_TASK_WDT_CHANNELS=6

CONFIG_LLEXT=y
CONFIG_LLEXT_HEAP_SIZE=64
CONFIG_LLEXT_TYPE_ELF_RELOCATABLE=y

CONFIG_PSA_CRYPTO=y
CONFIG_MBEDTLS_ENABLE_HEAP=y
CONFIG_PSA_WANT_ALG_SHA_256=y

CONFIG_LOG=y
CONFIG_LOG_MODE_MINIMAL=y
CONFIG_THREAD_NAME=y

CONFIG_MAIN_STACK_SIZE=4096
CONFIG_HEAP_MEM_POOL_SIZE=32768
```

## src/main.c
```c
/*
 * Copyright (c) 2026 Espressif Systems (Shanghai) Co., Ltd.
 *
 * SPDX-License-Identifier: Apache-2.0
 */

/*
 * Three isolated llext apps messaging each other. Each is verified and launched
 * into its own memory domain; they reach each other only through the platform's
 * capability-gated messaging services. This shows directed-by-name delivery and
 * topic publish/subscribe working across separate apps, not an app talking to
 * itself.
 */

#include <zephyr/app_platform/app_platform.h>
#include <zephyr/app_platform/app_loader.h>
#include <zephyr/app_platform/app_caps.h>
#include <zephyr/kernel.h>
#include <zephyr/sys/printk.h>

static const uint8_t consumer_app[] __aligned(8) = {
#include "consumer.inc"
};
static const uint8_t consumer_hash[32] = {
#include "consumer.sha256.inc"
};
static const uint8_t logger_app[] __aligned(8) = {
#include "logger.inc"
};
static const uint8_t logger_hash[32] = {
#include "logger.sha256.inc"
};
static const uint8_t producer_app[] __aligned(8) = {
#include "producer.inc"
};
static const uint8_t producer_hash[32] = {
#include "producer.sha256.inc"
};

static int install(const char *name, const uint8_t *buf, size_t len,
		   const uint8_t hash[32])
{
	struct llext *ext = NULL;
	void *entry = NULL;
	int rc = app_loader_verify_load(name, buf, len, hash, "app_main",
					&ext, &entry);

	if (rc != 0) {
		printk("%s of %s failed: %d\n", __func__, name, rc);
		return rc;
	}
	return app_platform_launch_llext(name, ext, (app_entry_t)entry, NULL,
					 APP_CAP_LOG | APP_CAP_IPC);
}

int main(void)
{
	printk("\n*** three isolated llext apps messaging (C6) ***\n");

	if (app_platform_init() != 0) {
		printk("platform init failed\n");
		return 0;
	}

	/* Receivers first so they register and subscribe before the producer. */
	install("consumer", consumer_app, ARRAY_SIZE(consumer_app), consumer_hash);
	install("logger", logger_app, ARRAY_SIZE(logger_app), logger_hash);
	install("producer", producer_app, ARRAY_SIZE(producer_app), producer_hash);

	k_msleep(5000);

	printk("\n*** done: apps exchanged directed and published messages ***\n");
	return 0;
}
```
