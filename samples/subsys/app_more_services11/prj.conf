## CMakeLists.txt
```
# SPDX-License-Identifier: Apache-2.0

cmake_minimum_required(VERSION 3.20.0)
find_package(Zephyr REQUIRED HINTS $ENV{ZEPHYR_BASE})
project(app_more_services11)

zephyr_syscall_header(${CMAKE_CURRENT_SOURCE_DIR}/src/svc.h)

target_sources(app PRIVATE src/main.c src/svc.c)
```

## prj.conf
```kconfig
CONFIG_USERSPACE=y
CONFIG_APPLICATION_DEFINED_SYSCALL=y

CONFIG_FLASH=y
CONFIG_FLASH_MAP=y
CONFIG_FLASH_PAGE_LAYOUT=y

CONFIG_LOG=y
CONFIG_LOG_MODE_MINIMAL=y
CONFIG_THREAD_NAME=y

CONFIG_MAIN_STACK_SIZE=4096
```

## src/main.c
```c
/*
 * Copyright (c) 2026 Espressif Systems (Shanghai) Co., Ltd.
 *
 * SPDX-License-Identifier: Apache-2.0
 */

/*
 * An app using a raw flash partition through services from user mode. The
 * platform owns the partition and confines every access to it; the app erases a
 * sector, writes a pattern, reads it back, and confirms a write past the
 * partition end is rejected. It never touches the flash device directly.
 */

#include "svc.h"

#include <zephyr/kernel.h>
#include <zephyr/sys/printk.h>
#include <errno.h>
#include <string.h>

#define STACK_SIZE 2048
#define APP_PRIO   5

K_THREAD_STACK_DEFINE(app_stack, STACK_SIZE);
static struct k_thread app_thread;

static void app_entry(void *p1, void *p2, void *p3)
{
	ARG_UNUSED(p1); ARG_UNUSED(p2); ARG_UNUSED(p3);

	uint8_t out[16];
	uint8_t in[16] = { 0 };

	for (int i = 0; i < (int)sizeof(out); i++) {
		out[i] = (uint8_t)(0xA0 + i);
	}

	/* Erase one sector, write a pattern, read it back. */
	int re = svc_flash_erase(0, 4096);
	int rw = svc_flash_write(0, out, sizeof(out));
	int rr = svc_flash_read(0, in, sizeof(in));

	printk("  [app] erase rc=%d, write rc=%d, read rc=%d\n", re, rw, rr);

	bool match = (memcmp(out, in, sizeof(in)) == 0);

	printk("  [app] read back: %02x %02x %02x %02x ... (match=%d)\n",
	       in[0], in[1], in[2], in[3], match);

	/* A write past the partition end is bounds-rejected. */
	int rb = svc_flash_write(0xFFFFFFF0U, out, sizeof(out));

	printk("  [app] out-of-bounds write -> rc=%d (expected -EINVAL=%d)\n",
	       rb, -EINVAL);

	printk("  [app] done - erased, wrote, read, confined to partition\n");
}

int main(void)
{
	printk("\n*** more services 11: raw flash partition (C6) ***\n");

	int rc = svc_flash_install();

	printk("  [platform] flash area open rc=%d\n", rc);

	k_tid_t t = k_thread_create(&app_thread, app_stack, STACK_SIZE, app_entry,
				    NULL, NULL, NULL, APP_PRIO, K_USER, K_FOREVER);

	k_thread_start(t);
	k_thread_join(t, K_FOREVER);

	printk("\n*** done ***\n");
	return 0;
}
```

## src/svc.c
```c
/*
 * Copyright (c) 2026 Espressif Systems (Shanghai) Co., Ltd.
 *
 * SPDX-License-Identifier: Apache-2.0
 */

#include "svc.h"

#include <zephyr/kernel.h>
#include <zephyr/storage/flash_map.h>
#include <zephyr/internal/syscall_handler.h>
#include <string.h>
#include <errno.h>

#define XFER_MAX 256

/* The platform owns the storage partition; the app is confined to it. */
#define PART_ID PARTITION_ID(storage_partition)

static const struct flash_area *fa;

int svc_flash_install(void)
{
	return flash_area_open(PART_ID, &fa);
}

/* Bounds: offset + len must stay inside the partition. */
static bool in_part(uint32_t off, size_t len)
{
	return fa != NULL && (uint64_t)off + len <= (uint64_t)fa->fa_size;
}

/* For read/write the payload also cannot exceed the copy buffer cap. */
static bool in_bounds(uint32_t off, size_t len)
{
	return in_part(off, len) && len <= XFER_MAX;
}

int z_impl_svc_flash_erase(uint32_t off, size_t len)
{
	/* Erase spans whole sectors, so it is bounded only by the partition. */
	if (!in_part(off, len)) {
		return -EINVAL;
	}
	return flash_area_erase(fa, off, len);
}

int z_impl_svc_flash_write(uint32_t off, const uint8_t *buf, size_t len)
{
	if (!in_bounds(off, len)) {
		return -EINVAL;
	}
	int rc = flash_area_write(fa, off, buf, len);

	return (rc == 0) ? (int)len : rc;
}

int z_impl_svc_flash_read(uint32_t off, uint8_t *buf, size_t len)
{
	if (!in_bounds(off, len)) {
		return -EINVAL;
	}
	int rc = flash_area_read(fa, off, buf, len);

	return (rc == 0) ? (int)len : rc;
}

#ifdef CONFIG_USERSPACE
static inline int z_vrfy_svc_flash_erase(uint32_t off, size_t len)
{
	return z_impl_svc_flash_erase(off, len);
}
#include <zephyr/syscalls/svc_flash_erase_mrsh.c>

static inline int z_vrfy_svc_flash_write(uint32_t off, const uint8_t *buf, size_t len)
{
	if (len > XFER_MAX) {
		return -EINVAL;
	}
	K_OOPS(K_SYSCALL_MEMORY_READ(buf, len));
	return z_impl_svc_flash_write(off, buf, len);
}
#include <zephyr/syscalls/svc_flash_write_mrsh.c>

static inline int z_vrfy_svc_flash_read(uint32_t off, uint8_t *buf, size_t len)
{
	if (len > XFER_MAX) {
		return -EINVAL;
	}
	K_OOPS(K_SYSCALL_MEMORY_WRITE(buf, len));
	return z_impl_svc_flash_read(off, buf, len);
}
#include <zephyr/syscalls/svc_flash_read_mrsh.c>
#endif
```

## src/svc.h
```c
/*
 * Copyright (c) 2026 Espressif Systems (Shanghai) Co., Ltd.
 *
 * SPDX-License-Identifier: Apache-2.0
 */

#ifndef APP_MORE_SERVICES11_SVC_H_
#define APP_MORE_SERVICES11_SVC_H_

#include <zephyr/kernel.h>

/*
 * An eleventh batch: a raw flash-partition service. The platform owns a flash
 * partition and confines the app to it - every offset is bounds-checked against
 * the partition size, so the app can never read or write outside its granted
 * region. The app erases, writes, and reads back raw bytes from user mode.
 *
 *   svc_flash_erase - erase @len bytes at partition offset @off.
 *   svc_flash_write - write @len bytes at partition offset @off.
 *   svc_flash_read  - read @len bytes from partition offset @off.
 */

/* Scoped: erase @len bytes at @off within the granted partition. */
__syscall int svc_flash_erase(uint32_t off, size_t len);

/* Scoped: write @buf[0..len) at @off within the granted partition. */
__syscall int svc_flash_write(uint32_t off, const uint8_t *buf, size_t len);

/* Scoped: read @len bytes from @off within the granted partition into @buf. */
__syscall int svc_flash_read(uint32_t off, uint8_t *buf, size_t len);

/* Supervisor-only: open the partition before launching the app. */
int svc_flash_install(void);

#include <zephyr/syscalls/svc.h>

#endif /* APP_MORE_SERVICES11_SVC_H_ */
```
