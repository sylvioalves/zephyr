## CMakeLists.txt
```
# SPDX-License-Identifier: Apache-2.0

cmake_minimum_required(VERSION 3.20.0)
find_package(Zephyr REQUIRED HINTS $ENV{ZEPHYR_BASE})
project(app_recovery)

target_sources(app PRIVATE
  src/main.c
  src/apps.c
)
```

## prj.conf
```kconfig
CONFIG_APPLICATION_DEFINED_SYSCALL=y

CONFIG_APP_PLATFORM=y
CONFIG_APP_PLATFORM_MAX_APPS=4
CONFIG_APP_PLATFORM_SERVICES=y
CONFIG_APP_PLATFORM_IO=y

CONFIG_GPIO=y
CONFIG_ENTROPY_GENERATOR=y

CONFIG_TASK_WDT=y
CONFIG_TASK_WDT_CHANNELS=6

CONFIG_LOG=y
CONFIG_LOG_MODE_MINIMAL=y
CONFIG_THREAD_NAME=y

CONFIG_MAIN_STACK_SIZE=4096
CONFIG_HEAP_MEM_POOL_SIZE=8192
```

## src/main.c
```c
/*
 * Copyright (c) 2026 Espressif Systems (Shanghai) Co., Ltd.
 *
 * SPDX-License-Identifier: Apache-2.0
 */

/*
 * Crash recovery with persisted state. A resilient app counts upward, saving a
 * checkpoint each step, and deliberately crashes part-way. The platform reclaims
 * the faulting app and restarts it; the new instance resumes from the saved
 * checkpoint rather than starting over. State survived the crash because the
 * platform held it outside the app's memory domain.
 */

#include <zephyr/app_platform/app_platform.h>
#include <zephyr/app_platform/app_caps.h>
#include <zephyr/kernel.h>
#include <zephyr/sys/printk.h>

extern void app_worker(void *arg);

int main(void)
{
	printk("\n*** app platform: crash recovery with state (C6) ***\n");

	if (app_platform_init() != 0) {
		printk("platform init failed\n");
		return 0;
	}

	const struct app_def worker = {
		.name = "worker",
		.source = APP_BUILTIN,
		.entry = app_worker,
		.caps = APP_CAP_LOG,
		.stopped = true,
	};
	int id = app_platform_launch(&worker);

	/* Make the worker resilient: the platform restarts it after a fault. */
	app_platform_set_restart(id, true);
	(void)app_platform_start(id);

	k_msleep(6000);

	printk("\n*** done: app crashed, was restarted, and resumed its work ***\n");
	return 0;
}
```

## src/apps.c
```c
/*
 * Copyright (c) 2026 Espressif Systems (Shanghai) Co., Ltd.
 *
 * SPDX-License-Identifier: Apache-2.0
 */

/*
 * A resilient app. It resumes from a saved checkpoint, counts upward saving its
 * progress, and deliberately crashes once. The platform restarts it, and the
 * new instance picks up from the checkpoint instead of starting over - state
 * survived the crash because it was held outside the app's memory domain.
 */

#include <zephyr/app_platform/app_services.h>
#include <zephyr/kernel.h>

void app_worker(void *arg)
{
	ARG_UNUSED(arg);

	uint32_t count = app_svc_checkpoint_get();

	if (count == 0U) {
		app_svc_log("worker: fresh start, count = 0");
	} else {
		app_svc_log("worker: resumed from checkpoint after a crash");
	}

	for (;;) {
		count++;
		app_svc_checkpoint_set(count);

		if (count == 4U) {
			app_svc_log("worker: at count 4, about to crash...");
			/* Deliberate fault: write through a null pointer. */
			volatile uint32_t *bad = (volatile uint32_t *)0;

			*bad = 0xdead;
		}

		if (count >= 8U) {
			app_svc_log("worker: reached count 8, finished cleanly");
			return;
		}

		k_msleep(400);
	}
}
```

## src/svc.c
```c
/*
 * Copyright (c) 2026 Espressif Systems (Shanghai) Co., Ltd.
 *
 * SPDX-License-Identifier: Apache-2.0
 */

#include "svc.h"

#include <zephyr/kernel.h>
#include <zephyr/sys/printk.h>
#include <zephyr/internal/syscall_handler.h>
#include <zephyr/app_platform/app_platform.h>

/*
 * Per-app checkpoint store, owned by the platform (supervisor side). It lives
 * outside any app's memory domain, so it survives an app crashing and being
 * restarted - which is exactly the point.
 */
static uint32_t checkpoints[CONFIG_APP_PLATFORM_MAX_APPS];

void z_impl_app_log(const char *msg)
{
	printk("    [app %d] %s\n", app_platform_id_current(), msg);
}

void z_impl_svc_checkpoint_set(uint32_t value)
{
	int id = app_platform_id_current();

	if (id >= 0) {
		checkpoints[id] = value;
	}
}

uint32_t z_impl_svc_checkpoint_get(void)
{
	int id = app_platform_id_current();

	return (id >= 0) ? checkpoints[id] : 0U;
}

#ifdef CONFIG_USERSPACE
static inline void z_vrfy_app_log(const char *msg)
{
	char buf[64];

	if (k_usermode_string_copy(buf, (char *)msg, sizeof(buf)) == 0) {
		z_impl_app_log(buf);
	}
}
#include <zephyr/syscalls/app_log_mrsh.c>

static inline void z_vrfy_svc_checkpoint_set(uint32_t value)
{
	z_impl_svc_checkpoint_set(value);
}
#include <zephyr/syscalls/svc_checkpoint_set_mrsh.c>

static inline uint32_t z_vrfy_svc_checkpoint_get(void)
{
	return z_impl_svc_checkpoint_get();
}
#include <zephyr/syscalls/svc_checkpoint_get_mrsh.c>
#endif
```

## src/svc.h
```c
/*
 * Copyright (c) 2026 Espressif Systems (Shanghai) Co., Ltd.
 *
 * SPDX-License-Identifier: Apache-2.0
 */

#ifndef APP_RECOVERY_SVC_H_
#define APP_RECOVERY_SVC_H_

#include <zephyr/kernel.h>

/*
 * A checkpoint service: an app saves a small state value that the platform
 * holds outside the app's memory domain, so it survives the app crashing and
 * being restarted. The restarted instance reads it back and resumes.
 *
 *   app_log            - log a line.
 *   svc_checkpoint_set - save this app's state value.
 *   svc_checkpoint_get - read this app's saved state value (0 if none).
 */

__syscall void app_log(const char *msg);
__syscall void svc_checkpoint_set(uint32_t value);
__syscall uint32_t svc_checkpoint_get(void);

#include <zephyr/syscalls/svc.h>

#endif /* APP_RECOVERY_SVC_H_ */
```
