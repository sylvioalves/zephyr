## CMakeLists.txt
```
# SPDX-License-Identifier: Apache-2.0

cmake_minimum_required(VERSION 3.20.0)
find_package(Zephyr REQUIRED HINTS $ENV{ZEPHYR_BASE})
project(mqtt_llext)

target_sources(app PRIVATE
  src/main.c
)

# Build the die-temp reporter as a loadable llext, embedded and SHA-256 verified.
set(ext_src ${PROJECT_SOURCE_DIR}/module/src/temp_app.c)
set(bin ${PROJECT_BINARY_DIR}/llext/temp_app.llext)
set(inc ${ZEPHYR_BINARY_DIR}/include/generated/temp_app.inc)
set(sha ${ZEPHYR_BINARY_DIR}/include/generated/temp_app.sha256.inc)

app_platform_add_module(temp_app_ext OUTPUT ${bin} SOURCES ${ext_src})
llext_include_directories(temp_app_ext
  ${CMAKE_CURRENT_SOURCE_DIR}/src
  ${ZEPHYR_BINARY_DIR}/include/generated
)
generate_inc_file_for_target(app ${bin} ${inc})

add_custom_command(
  OUTPUT  ${sha}
  COMMAND ${CMAKE_COMMAND}
    -DMODULE_BIN=${bin}
    -DOUT_INC=${sha}
    -P ${CMAKE_CURRENT_SOURCE_DIR}/cmake/gen_sha256_inc.cmake
  DEPENDS ${bin}
)
add_custom_target(temp_app_sha DEPENDS ${sha})
add_dependencies(app temp_app_sha)
```

## prj.conf
```kconfig
CONFIG_APPLICATION_DEFINED_SYSCALL=y

# The application platform subsystem with the verified loader.
CONFIG_APP_PLATFORM=y
CONFIG_APP_PLATFORM_MAX_APPS=4
CONFIG_APP_PLATFORM_LOADER=y
CONFIG_APP_PLATFORM_SERVICES=y
CONFIG_APP_PLATFORM_NET=y

CONFIG_TASK_WDT=y
CONFIG_TASK_WDT_CHANNELS=6

# Runtime-loaded app verification (SHA-256 via PSA crypto).
CONFIG_LLEXT=y
CONFIG_LLEXT_HEAP_SIZE=64
CONFIG_LLEXT_TYPE_ELF_RELOCATABLE=y
CONFIG_PSA_CRYPTO=y
CONFIG_MBEDTLS_ENABLE_HEAP=y
CONFIG_PSA_WANT_ALG_SHA_256=y

CONFIG_SENSOR=y

CONFIG_WIFI=y
CONFIG_WIFI_USAGE_MODE_STA=y
CONFIG_WIFI_STA_AUTO_DHCPV4=y

CONFIG_NETWORKING=y
CONFIG_NET_IPV4=y
CONFIG_NET_IPV6=n
CONFIG_NET_DHCPV4=y
CONFIG_NET_DHCPV4_OPTION_DNS_ADDRESS=y
CONFIG_NET_UDP=y
CONFIG_NET_TCP=y
CONFIG_NET_SOCKETS=y
CONFIG_DNS_RESOLVER=y
CONFIG_DNS_SERVER_IP_ADDRESSES=y
CONFIG_DNS_SERVER1="8.8.8.8"
CONFIG_NET_MAX_CONTEXTS=10

CONFIG_NET_MGMT=y
CONFIG_NET_MGMT_EVENT=y
CONFIG_NET_MGMT_EVENT_INFO=y
CONFIG_NET_MGMT_EVENT_STACK_SIZE=4096

CONFIG_MQTT_LIB=y

CONFIG_LOG=y
CONFIG_LOG_MODE_MINIMAL=y
CONFIG_NET_LOG=y
CONFIG_THREAD_NAME=y

CONFIG_MAIN_STACK_SIZE=6144
CONFIG_HEAP_MEM_POOL_SIZE=153600
```

## src/main.c
```c
/*
 * Copyright (c) 2026 Espressif Systems (Shanghai) Co., Ltd.
 *
 * SPDX-License-Identifier: Apache-2.0
 */

/*
 * A downloadable MQTT app over the shared service library. The platform owns the
 * Wi-Fi, network and MQTT stacks and the die-temperature sensor; the reporter
 * arrives as a verified llext module, runs isolated, and reaches all of it
 * through capability-gated app_svc_ calls. The module is embedded here to stand in
 * for a downloaded release.
 */

#include <zephyr/app_platform/app_platform.h>
#include <zephyr/app_platform/app_loader.h>
#include <zephyr/app_platform/app_caps.h>
#include <zephyr/kernel.h>
#include <zephyr/sys/printk.h>

static const uint8_t temp_app[] __aligned(8) = {
#include "temp_app.inc"
};
static const uint8_t temp_app_hash[32] = {
#include "temp_app.sha256.inc"
};

int main(void)
{
	printk("\n*** downloadable MQTT die-temp app over shared services (C6) ***\n");

	if (app_platform_init() != 0) {
		printk("platform init failed\n");
		return 0;
	}

	struct llext *ext = NULL;
	void *entry = NULL;
	int rc = app_loader_verify_load("temp-app", temp_app, ARRAY_SIZE(temp_app),
					temp_app_hash, "app_main", &ext, &entry);

	if (rc != 0) {
		printk("install failed: %d\n", rc);
		return 0;
	}

	uint32_t caps = APP_CAP_LOG | APP_CAP_SENSOR | APP_CAP_NET;
	int id = app_platform_launch_llext("temp-app", ext, (app_entry_t)entry, NULL, caps);

	printk("temp-app launched as isolated group %d\n", id);

	k_msleep(40000);

	printk("\n*** done: a downloadable app published die temp over MQTT ***\n");
	return 0;
}
```

## src/net.c
```c
/*
 * Copyright (c) 2026 Espressif Systems (Shanghai) Co., Ltd.
 *
 * SPDX-License-Identifier: Apache-2.0
 */

/*
 * The supervisor-side MQTT service. It owns the Wi-Fi interface, the network
 * stack, the socket, the MQTT client and the die-temperature sensor. A loadable
 * app opens a session, subscribes to a command topic and publishes through the
 * brokered svc_ calls below; a supervisor net thread runs the socket I/O and
 * prints anything received on the subscribed topic. The app holds none of this.
 */

#include "svc.h"

#include <zephyr/kernel.h>
#include <zephyr/sys/printk.h>
#include <zephyr/internal/syscall_handler.h>
#include <zephyr/app_platform/app_platform.h>
#include <zephyr/net/net_if.h>
#include <zephyr/net/wifi.h>
#include <zephyr/net/wifi_mgmt.h>
#include <zephyr/net/net_mgmt.h>
#include <zephyr/net/socket.h>
#include <zephyr/net/mqtt.h>
#include <zephyr/drivers/sensor.h>
#include <zephyr/random/random.h>
#include <string.h>
#include <errno.h>

#define BROKER_HOST "test.mosquitto.org"
#define BROKER_PORT 1883
#define ID_MAX      24
#define TOPIC_MAX   48
#define PAYLOAD_MAX 64

static const struct device *const die_temp = DEVICE_DT_GET(DT_ALIAS(die_temp0));

static struct mqtt_client client;
static struct sockaddr_storage broker;
static uint8_t rx_buf[256], tx_buf[256];
static bool mqtt_connected;
static char pub_topic[TOPIC_MAX];
static char sub_topic[TOPIC_MAX];

static K_SEM_DEFINE(net_ready, 0, 1);
static K_MUTEX_DEFINE(mqtt_lock);
static struct net_mgmt_event_callback ipv4_cb;

struct pub_req {
	char payload[PAYLOAD_MAX];
};
K_MSGQ_DEFINE(pub_q, sizeof(struct pub_req), 8, 4);

static void ipv4_evt(struct net_mgmt_event_callback *cb, uint64_t ev,
		     struct net_if *iface)
{
	ARG_UNUSED(cb);
	ARG_UNUSED(iface);
	if (ev == NET_EVENT_IPV4_ADDR_ADD) {
		printk("net: IP acquired - shared stack ready\n");
		k_sem_give(&net_ready);
	}
}

static int wifi_up(void)
{
	struct net_if *iface = net_if_get_first_wifi();

	if (!iface) {
		return -ENODEV;
	}
	net_mgmt_init_event_callback(&ipv4_cb, ipv4_evt, NET_EVENT_IPV4_ADDR_ADD);
	net_mgmt_add_event_callback(&ipv4_cb);

	static struct wifi_connect_req_params p;

	p.ssid = CONFIG_APP_WIFI_SSID; p.ssid_length = strlen(CONFIG_APP_WIFI_SSID);
	p.psk = CONFIG_APP_WIFI_PSK;   p.psk_length = strlen(CONFIG_APP_WIFI_PSK);
	p.security = WIFI_SECURITY_TYPE_PSK; p.band = WIFI_FREQ_BAND_2_4_GHZ;
	p.channel = WIFI_CHANNEL_ANY; p.mfp = WIFI_MFP_OPTIONAL;

	printk("net: connecting to '%s'...\n", CONFIG_APP_WIFI_SSID);
	return net_mgmt(NET_REQUEST_WIFI_CONNECT, iface, &p, sizeof(p));
}

static int resolve_broker(void)
{
	struct zsock_addrinfo *res, hints = { .ai_family = AF_INET,
					      .ai_socktype = SOCK_STREAM };
	int rc = zsock_getaddrinfo(BROKER_HOST, "1883", &hints, &res);

	if (rc != 0 || !res) {
		return -EIO;
	}
	struct sockaddr_in *b = (struct sockaddr_in *)&broker;
	struct sockaddr_in *r = (struct sockaddr_in *)res->ai_addr;

	b->sin_family = AF_INET;
	b->sin_port = htons(BROKER_PORT);
	b->sin_addr = r->sin_addr;
	zsock_freeaddrinfo(res);
	return 0;
}

static void mqtt_evt(struct mqtt_client *c, const struct mqtt_evt *e)
{
	switch (e->type) {
	case MQTT_EVT_CONNACK:
		mqtt_connected = (e->result == 0);
		printk("mqtt: %s\n", mqtt_connected ? "CONNECTED" : "refused");
		break;
	case MQTT_EVT_PUBLISH: {
		const struct mqtt_publish_param *p = &e->param.publish;
		uint8_t buf[64];
		int len = MIN(p->message.payload.len, sizeof(buf) - 1);

		mqtt_read_publish_payload(c, buf, len);
		buf[len] = '\0';
		printk("mqtt: RX on '%s': '%s'\n", sub_topic, buf);
		break;
	}
	case MQTT_EVT_DISCONNECT:
		mqtt_connected = false;
		break;
	default:
		break;
	}
}

static void subscribe(void)
{
	struct mqtt_topic t = { .topic = { .utf8 = sub_topic,
					   .size = strlen(sub_topic) },
				.qos = MQTT_QOS_0_AT_MOST_ONCE };
	struct mqtt_subscription_list s = { .list = &t, .list_count = 1,
					    .message_id = 1 };
	int rc = mqtt_subscribe(&client, &s);

	printk("mqtt: subscribed to '%s' rc=%d\n", sub_topic, rc);
}

static void net_thread(void *a, void *b, void *c)
{
	ARG_UNUSED(a); ARG_UNUSED(b); ARG_UNUSED(c);

	for (;;) {
		struct pub_req req;

		if (k_msgq_get(&pub_q, &req, K_MSEC(500)) == 0 && mqtt_connected) {
			struct mqtt_publish_param p = { 0 };

			p.message.topic.topic.utf8 = pub_topic;
			p.message.topic.topic.size = strlen(pub_topic);
			p.message.topic.qos = MQTT_QOS_0_AT_MOST_ONCE;
			p.message.payload.data = (uint8_t *)req.payload;
			p.message.payload.len = strlen(req.payload);
			p.message_id = sys_rand16_get();

			k_mutex_lock(&mqtt_lock, K_FOREVER);
			int rc = mqtt_publish(&client, &p);

			k_mutex_unlock(&mqtt_lock);
			printk("mqtt: published '%s' to %s rc=%d\n",
			       req.payload, pub_topic, rc);
		}

		if (mqtt_connected) {
			struct zsock_pollfd fd = {
				.fd = client.transport.tcp.sock,
				.events = ZSOCK_POLLIN };

			zsock_poll(&fd, 1, 0);
			k_mutex_lock(&mqtt_lock, K_FOREVER);
			mqtt_input(&client);
			mqtt_live(&client);
			k_mutex_unlock(&mqtt_lock);
		}
	}
}

K_THREAD_DEFINE(net_tid, 4096, net_thread, NULL, NULL, NULL, 6, 0, 0);

int net_link_up(void)
{
	if (wifi_up() != 0 || k_sem_take(&net_ready, K_SECONDS(30)) != 0) {
		printk("net: Wi-Fi/IP not ready\n");
		return -EIO;
	}
	for (int i = 0; i < 5 && resolve_broker() != 0; i++) {
		k_sleep(K_SECONDS(1));
	}
	return 0;
}

/* ---- brokered services (supervisor side) ---- */

int z_impl_svc_mqtt_open(const char *client_id, const char *p_topic,
			 const char *s_topic)
{
	strncpy(pub_topic, p_topic, sizeof(pub_topic) - 1);
	strncpy(sub_topic, s_topic, sizeof(sub_topic) - 1);

	mqtt_client_init(&client);
	client.broker = &broker;
	client.evt_cb = mqtt_evt;
	client.client_id.utf8 = (uint8_t *)client_id;
	client.client_id.size = strlen(client_id);
	client.protocol_version = MQTT_VERSION_3_1_1;
	client.rx_buf = rx_buf; client.rx_buf_size = sizeof(rx_buf);
	client.tx_buf = tx_buf; client.tx_buf_size = sizeof(tx_buf);
	client.transport.type = MQTT_TRANSPORT_NON_SECURE;

	if (mqtt_connect(&client) != 0) {
		return -EIO;
	}

	struct zsock_pollfd fd = { .fd = client.transport.tcp.sock,
				   .events = ZSOCK_POLLIN };

	for (int i = 0; i < 50 && !mqtt_connected; i++) {
		zsock_poll(&fd, 1, 100);
		mqtt_input(&client);
	}
	if (!mqtt_connected) {
		return -ETIMEDOUT;
	}
	subscribe();
	return 0;
}

int z_impl_svc_mqtt_publish(const char *payload)
{
	if (!mqtt_connected) {
		return -EIO;
	}
	struct pub_req req;

	strncpy(req.payload, payload, sizeof(req.payload) - 1);
	req.payload[sizeof(req.payload) - 1] = '\0';
	return k_msgq_put(&pub_q, &req, K_NO_WAIT);
}

int z_impl_svc_die_temp_milli(void)
{
	if (!device_is_ready(die_temp) || sensor_sample_fetch(die_temp) != 0) {
		return 0;
	}
	struct sensor_value v;

	sensor_channel_get(die_temp, SENSOR_CHAN_DIE_TEMP, &v);
	return v.val1 * 1000 + v.val2 / 1000;
}

void z_impl_svc_log(const char *msg)
{
	printk("    [app %d] %s\n", app_platform_id_current(), msg);
}

void z_impl_svc_heartbeat(void)
{
	app_platform_heartbeat();
}

#ifdef CONFIG_USERSPACE
static inline void z_vrfy_svc_log(const char *msg)
{
	char buf[64];

	if (k_usermode_string_copy(buf, (char *)msg, sizeof(buf)) == 0) {
		z_impl_svc_log(buf);
	}
}
#include <zephyr/syscalls/svc_log_mrsh.c>

static inline void z_vrfy_svc_heartbeat(void)
{
	z_impl_svc_heartbeat();
}
#include <zephyr/syscalls/svc_heartbeat_mrsh.c>

static inline int z_vrfy_svc_mqtt_open(const char *client_id,
				       const char *p_topic, const char *s_topic)
{
	char cid[ID_MAX], pt[TOPIC_MAX], st[TOPIC_MAX];

	if (k_usermode_string_copy(cid, (char *)client_id, sizeof(cid)) != 0 ||
	    k_usermode_string_copy(pt, (char *)p_topic, sizeof(pt)) != 0 ||
	    k_usermode_string_copy(st, (char *)s_topic, sizeof(st)) != 0) {
		return -EFAULT;
	}
	return z_impl_svc_mqtt_open(cid, pt, st);
}
#include <zephyr/syscalls/svc_mqtt_open_mrsh.c>

static inline int z_vrfy_svc_mqtt_publish(const char *payload)
{
	char buf[PAYLOAD_MAX];

	if (k_usermode_string_copy(buf, (char *)payload, sizeof(buf)) != 0) {
		return -EFAULT;
	}
	return z_impl_svc_mqtt_publish(buf);
}
#include <zephyr/syscalls/svc_mqtt_publish_mrsh.c>

static inline int z_vrfy_svc_die_temp_milli(void)
{
	return z_impl_svc_die_temp_milli();
}
#include <zephyr/syscalls/svc_die_temp_milli_mrsh.c>
#endif
```

## src/svc.h
```c
/*
 * Copyright (c) 2026 Espressif Systems (Shanghai) Co., Ltd.
 *
 * SPDX-License-Identifier: Apache-2.0
 */

#ifndef MQTT_LLEXT_SVC_H_
#define MQTT_LLEXT_SVC_H_

#include <zephyr/kernel.h>

/*
 * Services available to the loadable app. The Wi-Fi, socket, MQTT client and
 * die-temperature sensor all live in the supervisor; the app reaches them only
 * through these calls, so it carries none of that code and stays tiny.
 */
__syscall void svc_log(const char *msg);
__syscall void svc_heartbeat(void);

/* Open this app's MQTT session with a publish topic and a subscribe topic. */
__syscall int svc_mqtt_open(const char *client_id, const char *pub_topic,
			    const char *sub_topic);

/* Publish a payload on this app's session. */
__syscall int svc_mqtt_publish(const char *payload);

/* Read the SoC die temperature in milli-degrees Celsius. */
__syscall int svc_die_temp_milli(void);

#include <zephyr/syscalls/svc.h>

#endif /* MQTT_LLEXT_SVC_H_ */
```
